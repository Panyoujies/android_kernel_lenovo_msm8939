/* Copyright (c) 2013-2014, The Linux Foundation. All rights reserved.
 *
 * This program is free software; you can redistribute it and/or modify
 * it under the terms of the GNU General Public License version 2 and
 * only version 2 as published by the Free Software Foundation.
 *
 * This program is distributed in the hope that it will be useful,
 * but WITHOUT ANY WARRANTY; without even the implied warranty of
 * MERCHANTABILITY or FITNESS FOR A PARTICULAR PURPOSE.  See the
 * GNU General Public License for more details.
 */

/*---------------------------------------------------------------------------
 * This file is autogenerated file using gcdb parser. Please do not edit it.
 * Update input XML file to add a new entry or update variable in this file
 * VERSION = "1.0"
 *---------------------------------------------------------------------------*/
&mdss_mdp {
	dsi_lgd_1080_vid_dvt1: qcom,mdss_dsi_lgd_1080p_cmd_dvt1 {
		qcom,mdss-dsi-panel-name = "lgd 1080p dvt1 cmd mode dsi panel";
		qcom,mdss-dsi-panel-controller = <&mdss_dsi0>;
		qcom,mdss-dsi-panel-type = "dsi_cmd_mode";
		qcom,mdss-dsi-panel-destination = "display_1";
		qcom,mdss-dsi-panel-framerate = <60>;
		qcom,mdss-dsi-virtual-channel-id = <0>;
		qcom,mdss-dsi-stream = <0>;
		qcom,mdss-dsi-panel-width = <1080>;
		qcom,mdss-dsi-panel-height = <1920>;
		qcom,mdss-dsi-h-front-porch = <47>;
		qcom,mdss-dsi-h-back-porch = <47>;
		qcom,mdss-dsi-h-pulse-width = <47>;
		qcom,mdss-dsi-h-sync-skew = <0>;
		qcom,mdss-dsi-v-back-porch = <16>;
		qcom,mdss-dsi-v-front-porch = <10>;
		qcom,mdss-dsi-v-pulse-width = <2>;
		qcom,mdss-dsi-h-left-border = <0>;
		qcom,mdss-dsi-h-right-border = <0>;
		qcom,mdss-dsi-v-top-border = <0>;
		qcom,mdss-dsi-v-bottom-border = <0>;
		qcom,mdss-dsi-bpp = <24>;
		qcom,mdss-dsi-underflow-color = <0xff>;
		qcom,mdss-dsi-border-color = <0>;
		qcom,mdss-dsi-on-command = [
			23 00 00 00 00 00 02 B0 00
			29 00 00 00 00 00 06 B3 04 10 00 00 00
			29 00 00 00 00 00 03 B4 0C 00
			29 00 00 00 00 00 04 B6 3B D3 00
			//29 01 00 00 00 00 07 B9 07 75 61 20 16 87
			29 00 00 00 00 00 20 C1 84 00 10 EF CB F8 FF FF DF 9C C5 9A 73 8D AD 63 FE FF FF 8B F1 01 00 AA 40 00 C2 01 08 00 01
			29 00 00 00 00 00 0B C2 01 F7 80 04 63 00 60 00 01 30
			29 00 00 00 00 00 07 C3 55 01 00 01 00 00
			29 00 00 00 00 00 12 C4 70 00 00 00 00 00 00 00 00 02 01 00 05 01 00 00 00
			29 00 00 00 00 00 0F C6 59 07 4A 07 4A 01 0E 01 02 01 02 09 15 07
			29 00 00 00 00 00 1F C7 00 17 1F 2C 3A 47 50 5D 3F 48 55 62 6B 71 78 00 17 20 2C 3A 47 50 5D 3F 48 55 62 6B 71 78
			29 00 00 00 00 00 14 C8 00 00 00 00 00 FC 00 00 00 00 00 FC 00 00 00 00 00 FC 00
			29 00 00 00 00 00 09 C9 1F 68 1F 68 4C 4C C4 11
			29 00 00 00 00 00 0A CB 0D FE 1F 2C 00 00 00 00 00
			23 00 00 00 00 00 02 CC 04
			29 00 00 00 00 00 19 CE 75 40 48 56 67 78 88 98 A7 B5 C3 D1 DE E9 F2 FA FF 04 00 0A 07 46 04 00
			29 00 00 00 00 00 11 D0 3B 01 91 0B D9 19 19 00 00 00 99 99 00 00 00 00
			29 00 00 00 00 00 1D D3 1B 3B BB AD A5 33 33 33 00 80 A2 A4 6F 6F 33 33 33 F7 F2 1F 7D 7C FF 0F 99 00 FF FF
			29 00 00 00 00 00 04 D4 57 33 03
			29 00 00 00 00 00 0C D5 66 00 00 01 4A 01 4A 00 6E 00 6E
			29 00 00 00 00 00 02 D6 01
			39 00 00 00 00 00 02 53 2C
                        39 00 00 00 00 00 02 5E 1F
			23 00 00 00 00 00 02 B0 03
                        15 00 00 00 00 00 02 36 00
			05 01 00 00 28 00 01 29
			05 01 00 00 78 00 01 11
			];
		qcom,mdss-dsi-off-command = [39 01 00 00 00 00 02 51 00
				 05 01 00 00 20 00 02 28 00
				 05 01 00 00 79 00 02 10 00];
		qcom,mdss-dsi-on-command-state = "dsi_lp_mode";
		qcom,mdss-dsi-off-command-state = "dsi_hs_mode";
		qcom,mdss-dsi-h-sync-pulse = <0>;
		qcom,mdss-dsi-traffic-mode = "non_burst_sync_event";
		qcom,mdss-dsi-te-pin-select = <1>;
		qcom,mdss-dsi-te-dcs-command = <1>;
		qcom,mdss-dsi-te-check-enable;
		qcom,mdss-dsi-te-using-te-pin;
		qcom,mdss-dsi-bllp-eof-power-mode;
		qcom,mdss-dsi-bllp-power-mode;
		qcom,mdss-dsi-lane-0-state;
		qcom,mdss-dsi-lane-1-state;
        qcom,mdss-dsi-lane-2-state;
        qcom,mdss-dsi-lane-3-state;
		qcom,mdss-tear-check-sync-threshold-start=<10>;
		qcom,mdss-tear-check-sync-threshold-continue=<4>;
		qcom,mdss-tear-check-start-pos=<0x78A>;
        qcom,mdss-dsi-panel-timings = [e6 38 26 00 68 6c 2a 3c 2c 03 04 00];
		qcom,mdss-dsi-panel-clockrate = <895000000>;
		qcom,mdss-dsi-t-clk-post = <0x04>;
		qcom,mdss-dsi-t-clk-pre = <0x28>;
		qcom,mdss-dsi-bl-min-level = <1>;
		qcom,mdss-dsi-bl-max-level = <255>;
		qcom,mdss-dsi-dma-trigger = "trigger_sw";
		qcom,mdss-dsi-mdp-trigger = "none";
		qcom,mdss-dsi-bl-pmic-control-type = "bl_ctrl_dcs";
		qcom,mdss-dsi-reset-sequence = <1 20>, <0 200>, <1 20>;
        qcom,mdss-dsi-lp11-init;
		qcom,mdss-pan-physical-width-dimension = <61>;
		qcom,mdss-pan-physical-height-dimension = <110>;
                qcom,mdss-dsi-hfp-power-mode;
                qcom,mdss-dsi-hsa-power-mode;
                qcom,mdss-dsi-hbp-power-mode;
                qcom,ulps-enabled;
                qcom,suspend-ulps-enabled;
                //qcom,esd-check-enabled;
                //qcom,mdss-dsi-panel-status-check-mode = "te_signal_check";
		//qcom,mdss-dsi-panel-status-check-mode = "te_check";
		//qcom,esd-check-enabled;
	};
};
