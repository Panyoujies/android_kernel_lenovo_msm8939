/* Copyright (c) 2013, The Linux Foundation. All rights reserved.
 *
 * This program is free software; you can redistribute it and/or modify
 * it under the terms of the GNU General Public License version 2 and
 * only version 2 as published by the Free Software Foundation.
 *
 * This program is distributed in the hope that it will be useful,
 * but WITHOUT ANY WARRANTY; without even the implied warranty of
 * MERCHANTABILITY or FITNESS FOR A PARTICULAR PURPOSE.  See the
 * GNU General Public License for more details.
 */

/*---------------------------------------------------------------------------
 * This file is autogenerated file using gcdb parser. Please do not edit it.
 * Update input XML file to add a new entry or update variable in this file
 * VERSION = "1.0"
 *---------------------------------------------------------------------------*/
&mdss_mdp {
	dsi_nt35596_yassy_1080p_video: qcom,mdss_dsi_nt35596_yassy_1080p_video {
		qcom,mdss-dsi-panel-name = "nt35596 yassy 1080p video mode dsi panel";
		qcom,mdss-dsi-panel-controller = <&mdss_dsi0>;
		qcom,mdss-dsi-panel-type = "dsi_video_mode";
		qcom,mdss-dsi-panel-destination = "display_1";
		qcom,mdss-dsi-panel-framerate = <60>;
		qcom,mdss-dsi-virtual-channel-id = <0>;
		qcom,mdss-dsi-stream = <0>;
		qcom,mdss-dsi-panel-width = <1080>;
		qcom,mdss-dsi-panel-height = <1920>;
		qcom,mdss-dsi-h-front-porch = <140>;
		qcom,mdss-dsi-h-back-porch = <100>;
		qcom,mdss-dsi-h-pulse-width = <8>;
		qcom,mdss-dsi-h-sync-skew = <0>;
		qcom,mdss-dsi-v-back-porch = <5>;
		qcom,mdss-dsi-v-front-porch = <15>;
		qcom,mdss-dsi-v-pulse-width = <2>;
		qcom,mdss-dsi-h-left-border = <0>;
		qcom,mdss-dsi-h-right-border = <0>;
		qcom,mdss-dsi-v-top-border = <0>;
		qcom,mdss-dsi-v-bottom-border = <0>;
		qcom,mdss-dsi-bpp = <24>;
		qcom,mdss-dsi-underflow-color = <0xff>;
		qcom,mdss-dsi-border-color = <0>;
		qcom,mdss-dsi-on-command = [39 00 00 00 00 00 02 FF EE
39 00 00 00 00 00 02 FB 01
39 00 00 00 0A 00 02 18 40
39 00 00 00 14 00 02 18 00
39 00 00 00 00 00 02 7C 31
39 00 00 00 00 00 02 FF 04
39 00 00 00 00 00 02 FB 01
39 00 00 00 00 00 02 08 36
39 00 00 00 00 00 02 00 00
39 00 00 00 00 00 02 FF 05
39 00 00 00 00 00 02 FB 01
39 00 00 00 00 00 02 C5 31
39 00 00 00 00 00 02 FF 01
39 00 00 00 00 00 02 FB 01
39 00 00 00 00 00 02 75 00
39 00 00 00 00 00 02 76 B2
39 00 00 00 00 00 02 77 00
39 00 00 00 00 00 02 78 BB
39 00 00 00 00 00 02 79 00
39 00 00 00 00 00 02 7A CC
39 00 00 00 00 00 02 7B 00
39 00 00 00 00 00 02 7C DB
39 00 00 00 00 00 02 7D 00
39 00 00 00 00 00 02 7E E7
39 00 00 00 00 00 02 7F 00
39 00 00 00 00 00 02 80 F4
39 00 00 00 00 00 02 81 01
39 00 00 00 00 00 02 82 00
39 00 00 00 00 00 02 83 01
39 00 00 00 00 00 02 84 0B
39 00 00 00 00 00 02 85 01
39 00 00 00 00 00 02 86 16
39 00 00 00 00 00 02 87 01
39 00 00 00 00 00 02 88 3B
39 00 00 00 00 00 02 89 01
39 00 00 00 00 00 02 8A 5A
39 00 00 00 00 00 02 8B 01
39 00 00 00 00 00 02 8C 90
39 00 00 00 00 00 02 8D 01
39 00 00 00 00 00 02 8E BC
39 00 00 00 00 00 02 8F 02
39 00 00 00 00 00 02 90 01
39 00 00 00 00 00 02 91 02
39 00 00 00 00 00 02 92 38
39 00 00 00 00 00 02 93 02
39 00 00 00 00 00 02 94 3A
39 00 00 00 00 00 02 95 02
39 00 00 00 00 00 02 96 6B
39 00 00 00 00 00 02 97 02
39 00 00 00 00 00 02 98 9E
39 00 00 00 00 00 02 99 02
39 00 00 00 00 00 02 9A C0
39 00 00 00 00 00 02 9B 02
39 00 00 00 00 00 02 9C F1
39 00 00 00 00 00 02 9D 03
39 00 00 00 00 00 02 9E 11
39 00 00 00 00 00 02 9F 03
39 00 00 00 00 00 02 A0 3B
39 00 00 00 00 00 02 A2 03
39 00 00 00 00 00 02 A3 47
39 00 00 00 00 00 02 A4 03
39 00 00 00 00 00 02 A5 53
39 00 00 00 00 00 02 A6 03
39 00 00 00 00 00 02 A7 54
39 00 00 00 00 00 02 A9 03
39 00 00 00 00 00 02 AA 55
39 00 00 00 00 00 02 AB 03
39 00 00 00 00 00 02 AC 56
39 00 00 00 00 00 02 AD 03
39 00 00 00 00 00 02 AE 57
39 00 00 00 00 00 02 AF 03
39 00 00 00 00 00 02 B0 58
39 00 00 00 00 00 02 B1 03
39 00 00 00 00 00 02 B2 59
39 00 00 00 00 00 02 B3 00
39 00 00 00 00 00 02 B4 B2
39 00 00 00 00 00 02 B5 00
39 00 00 00 00 00 02 B6 BB
39 00 00 00 00 00 02 B7 00
39 00 00 00 00 00 02 B8 CC
39 00 00 00 00 00 02 B9 00
39 00 00 00 00 00 02 BA DB
39 00 00 00 00 00 02 BB 00
39 00 00 00 00 00 02 BC E7
39 00 00 00 00 00 02 BD 00
39 00 00 00 00 00 02 BE F4
39 00 00 00 00 00 02 BF 01
39 00 00 00 00 00 02 C0 00
39 00 00 00 00 00 02 C1 01
39 00 00 00 00 00 02 C2 0B
39 00 00 00 00 00 02 C3 01
39 00 00 00 00 00 02 C4 16
39 00 00 00 00 00 02 C5 01
39 00 00 00 00 00 02 C6 3B
39 00 00 00 00 00 02 C7 01
39 00 00 00 00 00 02 C8 5A
39 00 00 00 00 00 02 C9 01
39 00 00 00 00 00 02 CA 90
39 00 00 00 00 00 02 CB 01
39 00 00 00 00 00 02 CC BC
39 00 00 00 00 00 02 CD 02
39 00 00 00 00 00 02 CE 01
39 00 00 00 00 00 02 CF 02
39 00 00 00 00 00 02 D0 38
39 00 00 00 00 00 02 D1 02
39 00 00 00 00 00 02 D2 3A
39 00 00 00 00 00 02 D3 02
39 00 00 00 00 00 02 D4 6B
39 00 00 00 00 00 02 D5 02
39 00 00 00 00 00 02 D6 9E
39 00 00 00 00 00 02 D7 02
39 00 00 00 00 00 02 D8 C0
39 00 00 00 00 00 02 D9 02
39 00 00 00 00 00 02 DA F1
39 00 00 00 00 00 02 DB 03
39 00 00 00 00 00 02 DC 11
39 00 00 00 00 00 02 DD 03
39 00 00 00 00 00 02 DE 3B
39 00 00 00 00 00 02 DF 03
39 00 00 00 00 00 02 E0 47
39 00 00 00 00 00 02 E1 03
39 00 00 00 00 00 02 E2 53
39 00 00 00 00 00 02 E3 03
39 00 00 00 00 00 02 E4 54
39 00 00 00 00 00 02 E5 03
39 00 00 00 00 00 02 E6 55
39 00 00 00 00 00 02 E7 03
39 00 00 00 00 00 02 E8 56
39 00 00 00 00 00 02 E9 03
39 00 00 00 00 00 02 EA 57
39 00 00 00 00 00 02 EB 03
39 00 00 00 00 00 02 EC 58
39 00 00 00 00 00 02 ED 03
39 00 00 00 00 00 02 EE 59
39 00 00 00 00 00 02 EF 00
39 00 00 00 00 00 02 F0 C4
39 00 00 00 00 00 02 F1 00
39 00 00 00 00 00 02 F2 CC
39 00 00 00 00 00 02 F3 00
39 00 00 00 00 00 02 F4 DA
39 00 00 00 00 00 02 F5 00
39 00 00 00 00 00 02 F6 E8
39 00 00 00 00 00 02 F7 00
39 00 00 00 00 00 02 F8 F4
39 00 00 00 00 00 02 F9 01
39 00 00 00 00 00 02 FA 00
39 00 00 00 00 00 02 FF 02
39 00 00 00 00 00 02 FB 01
39 00 00 00 00 00 02 00 01
39 00 00 00 00 00 02 01 0B
39 00 00 00 00 00 02 02 01
39 00 00 00 00 00 02 03 14
39 00 00 00 00 00 02 04 01
39 00 00 00 00 00 02 05 1F
39 00 00 00 00 00 02 06 01
39 00 00 00 00 00 02 07 41
39 00 00 00 00 00 02 08 01
39 00 00 00 00 00 02 09 5E
39 00 00 00 00 00 02 0A 01
39 00 00 00 00 00 02 0B 91
39 00 00 00 00 00 02 0C 01
39 00 00 00 00 00 02 0D BC
39 00 00 00 00 00 02 0E 01
39 00 00 00 00 00 02 0F FF
39 00 00 00 00 00 02 10 02
39 00 00 00 00 00 02 11 35
39 00 00 00 00 00 02 12 02
39 00 00 00 00 00 02 13 37
39 00 00 00 00 00 02 14 02
39 00 00 00 00 00 02 15 68
39 00 00 00 00 00 02 16 02
39 00 00 00 00 00 02 17 9C
39 00 00 00 00 00 02 18 02
39 00 00 00 00 00 02 19 BE
39 00 00 00 00 00 02 1A 02
39 00 00 00 00 00 02 1B F0
39 00 00 00 00 00 02 1C 03
39 00 00 00 00 00 02 1D 11
39 00 00 00 00 00 02 1E 03
39 00 00 00 00 00 02 1F 3B
39 00 00 00 00 00 02 20 03
39 00 00 00 00 00 02 21 48
39 00 00 00 00 00 02 22 03
39 00 00 00 00 00 02 23 4D
39 00 00 00 00 00 02 24 03
39 00 00 00 00 00 02 25 4E
39 00 00 00 00 00 02 26 03
39 00 00 00 00 00 02 27 4F
39 00 00 00 00 00 02 28 03
39 00 00 00 00 00 02 29 50
39 00 00 00 00 00 02 2A 03
39 00 00 00 00 00 02 2B 51
39 00 00 00 00 00 02 2D 03
39 00 00 00 00 00 02 2F 52
39 00 00 00 00 00 02 30 03
39 00 00 00 00 00 02 31 53
39 00 00 00 00 00 02 32 00
39 00 00 00 00 00 02 33 C4
39 00 00 00 00 00 02 34 00
39 00 00 00 00 00 02 35 CC
39 00 00 00 00 00 02 36 00
39 00 00 00 00 00 02 37 DA
39 00 00 00 00 00 02 38 00
39 00 00 00 00 00 02 39 E8
39 00 00 00 00 00 02 3A 00
39 00 00 00 00 00 02 3B F4
39 00 00 00 00 00 02 3D 01
39 00 00 00 00 00 02 3F 00
39 00 00 00 00 00 02 40 01
39 00 00 00 00 00 02 41 0B
39 00 00 00 00 00 02 42 01
39 00 00 00 00 00 02 43 14
39 00 00 00 00 00 02 44 01
39 00 00 00 00 00 02 45 1F
39 00 00 00 00 00 02 46 01
39 00 00 00 00 00 02 47 41
39 00 00 00 00 00 02 48 01
39 00 00 00 00 00 02 49 5E
39 00 00 00 00 00 02 4A 01
39 00 00 00 00 00 02 4B 91
39 00 00 00 00 00 02 4C 01
39 00 00 00 00 00 02 4D BC
39 00 00 00 00 00 02 4E 01
39 00 00 00 00 00 02 4F FF
39 00 00 00 00 00 02 50 02
39 00 00 00 00 00 02 51 35
39 00 00 00 00 00 02 52 02
39 00 00 00 00 00 02 53 37
39 00 00 00 00 00 02 54 02
39 00 00 00 00 00 02 55 68
39 00 00 00 00 00 02 56 02
39 00 00 00 00 00 02 58 9C
39 00 00 00 00 00 02 59 02
39 00 00 00 00 00 02 5A BE
39 00 00 00 00 00 02 5B 02
39 00 00 00 00 00 02 5C F0
39 00 00 00 00 00 02 5D 03
39 00 00 00 00 00 02 5E 11
39 00 00 00 00 00 02 5F 03
39 00 00 00 00 00 02 60 3B
39 00 00 00 00 00 02 61 03
39 00 00 00 00 00 02 62 48
39 00 00 00 00 00 02 63 03
39 00 00 00 00 00 02 64 4D
39 00 00 00 00 00 02 65 03
39 00 00 00 00 00 02 66 4E
39 00 00 00 00 00 02 67 03
39 00 00 00 00 00 02 68 4F
39 00 00 00 00 00 02 69 03
39 00 00 00 00 00 02 6A 50
39 00 00 00 00 00 02 6B 03
39 00 00 00 00 00 02 6C 51
39 00 00 00 00 00 02 6D 03
39 00 00 00 00 00 02 6E 52
39 00 00 00 00 00 02 6F 03
39 00 00 00 00 00 02 70 53
39 00 00 00 00 00 02 71 00
39 00 00 00 00 00 02 72 01
39 00 00 00 00 00 02 73 00
39 00 00 00 00 00 02 74 1A
39 00 00 00 00 00 02 75 00
39 00 00 00 00 00 02 76 45
39 00 00 00 00 00 02 77 00
39 00 00 00 00 00 02 78 65
39 00 00 00 00 00 02 79 00
39 00 00 00 00 00 02 7A 7C
39 00 00 00 00 00 02 7B 00
39 00 00 00 00 00 02 7C 93
39 00 00 00 00 00 02 7D 00
39 00 00 00 00 00 02 7E A6
39 00 00 00 00 00 02 7F 00
39 00 00 00 00 00 02 80 B7
39 00 00 00 00 00 02 81 00
39 00 00 00 00 00 02 82 C8
39 00 00 00 00 00 02 83 00
39 00 00 00 00 00 02 84 FD
39 00 00 00 00 00 02 85 01
39 00 00 00 00 00 02 86 27
39 00 00 00 00 00 02 87 01
39 00 00 00 00 00 02 88 69
39 00 00 00 00 00 02 89 01
39 00 00 00 00 00 02 8A 9E
39 00 00 00 00 00 02 8B 01
39 00 00 00 00 00 02 8C ED
39 00 00 00 00 00 02 8D 02
39 00 00 00 00 00 02 8E 2A
39 00 00 00 00 00 02 8F 02
39 00 00 00 00 00 02 90 2C
39 00 00 00 00 00 02 91 02
39 00 00 00 00 00 02 92 61
39 00 00 00 00 00 02 93 02
39 00 00 00 00 00 02 94 97
39 00 00 00 00 00 02 95 02
39 00 00 00 00 00 02 96 BB
39 00 00 00 00 00 02 97 02
39 00 00 00 00 00 02 98 F1
39 00 00 00 00 00 02 99 03
39 00 00 00 00 00 02 9A 19
39 00 00 00 00 00 02 9B 03
39 00 00 00 00 00 02 9C 5F
39 00 00 00 00 00 02 9D 03
39 00 00 00 00 00 02 9E 87
39 00 00 00 00 00 02 9F 03
39 00 00 00 00 00 02 A0 C6
39 00 00 00 00 00 02 A2 03
39 00 00 00 00 00 02 A3 C7
39 00 00 00 00 00 02 A4 03
39 00 00 00 00 00 02 A5 C8
39 00 00 00 00 00 02 A6 03
39 00 00 00 00 00 02 A7 C9
39 00 00 00 00 00 02 A9 03
39 00 00 00 00 00 02 AA CA
39 00 00 00 00 00 02 AB 03
39 00 00 00 00 00 02 AC CB
39 00 00 00 00 00 02 AD 03
39 00 00 00 00 00 02 AE CC
39 00 00 00 00 00 02 AF 00
39 00 00 00 00 00 02 B0 01
39 00 00 00 00 00 02 B1 00
39 00 00 00 00 00 02 B2 1A
39 00 00 00 00 00 02 B3 00
39 00 00 00 00 00 02 B4 45
39 00 00 00 00 00 02 B5 00
39 00 00 00 00 00 02 B6 65
39 00 00 00 00 00 02 B7 00
39 00 00 00 00 00 02 B8 7C
39 00 00 00 00 00 02 B9 00
39 00 00 00 00 00 02 BA 93
39 00 00 00 00 00 02 BB 00
39 00 00 00 00 00 02 BC A6
39 00 00 00 00 00 02 BD 00
39 00 00 00 00 00 02 BE B7
39 00 00 00 00 00 02 BF 00
39 00 00 00 00 00 02 C0 C8
39 00 00 00 00 00 02 C1 00
39 00 00 00 00 00 02 C2 FD
39 00 00 00 00 00 02 C3 01
39 00 00 00 00 00 02 C4 27
39 00 00 00 00 00 02 C5 01
39 00 00 00 00 00 02 C6 69
39 00 00 00 00 00 02 C7 01
39 00 00 00 00 00 02 C8 9E
39 00 00 00 00 00 02 C9 01
39 00 00 00 00 00 02 CA ED
39 00 00 00 00 00 02 CB 02
39 00 00 00 00 00 02 CC 2A
39 00 00 00 00 00 02 CD 02
39 00 00 00 00 00 02 CE 2C
39 00 00 00 00 00 02 CF 02
39 00 00 00 00 00 02 D0 61
39 00 00 00 00 00 02 D1 02
39 00 00 00 00 00 02 D2 97
39 00 00 00 00 00 02 D3 02
39 00 00 00 00 00 02 D4 BB
39 00 00 00 00 00 02 D5 02
39 00 00 00 00 00 02 D6 F1
39 00 00 00 00 00 02 D7 03
39 00 00 00 00 00 02 D8 19
39 00 00 00 00 00 02 D9 03
39 00 00 00 00 00 02 DA 5F
39 00 00 00 00 00 02 DB 03
39 00 00 00 00 00 02 DC 87
39 00 00 00 00 00 02 DD 03
39 00 00 00 00 00 02 DE C6
39 00 00 00 00 00 02 DF 03
39 00 00 00 00 00 02 E0 C7
39 00 00 00 00 00 02 E1 03
39 00 00 00 00 00 02 E2 C8
39 00 00 00 00 00 02 E3 03
39 00 00 00 00 00 02 E4 C9
39 00 00 00 00 00 02 E5 03
39 00 00 00 00 00 02 E6 CA
39 00 00 00 00 00 02 E7 03
39 00 00 00 00 00 02 E8 CB
39 00 00 00 00 00 02 E9 03
39 00 00 00 00 00 02 EA CC
39 00 00 00 00 00 02 FF 03
39 00 00 00 00 00 02 FB 01
39 00 00 00 00 00 02 00 23
39 00 00 00 00 00 02 01 26
39 00 00 00 00 00 02 02 2B
39 00 00 00 00 00 02 03 2C
39 00 00 00 00 00 02 04 2D
39 00 00 00 00 00 02 05 2D
39 00 00 00 00 00 02 06 30
39 00 00 00 00 00 02 07 30
39 00 00 00 00 00 02 08 32
39 00 00 00 00 00 02 09 32
39 00 00 00 00 00 02 0A 32
39 00 00 00 00 00 02 0B 32
39 00 00 00 00 00 02 0C 37
39 00 00 00 00 00 02 0D 32
39 00 00 00 00 00 02 0E 28
39 00 00 00 00 00 02 0F 20
39 00 00 00 00 00 02 10 0A
39 00 00 00 00 00 02 11 08
39 00 00 00 00 00 02 12 06
39 00 00 00 00 00 02 13 02
39 00 00 00 00 00 02 1B 19
39 00 00 00 00 00 02 1C 1C
39 00 00 00 00 00 02 1D 21
39 00 00 00 00 00 02 1E 22
39 00 00 00 00 00 02 1F 23
39 00 00 00 00 00 02 20 23
39 00 00 00 00 00 02 21 26
39 00 00 00 00 00 02 22 28
39 00 00 00 00 00 02 23 28
39 00 00 00 00 00 02 24 28
39 00 00 00 00 00 02 25 28
39 00 00 00 00 00 02 26 1E
39 00 00 00 00 00 02 27 14
39 00 00 00 00 00 02 28 0A
39 00 00 00 00 00 02 29 0A
39 00 00 00 00 00 02 2A 08
39 00 00 00 00 00 02 2B 08
39 00 00 00 00 00 02 2F 08
39 00 00 00 00 00 02 30 08
39 00 00 00 00 00 02 31 08
39 00 00 00 00 00 02 32 82
39 00 00 00 00 00 02 33 84
39 00 00 00 00 00 02 34 86
39 00 00 00 00 00 02 35 08
39 00 00 00 00 00 02 36 0A
39 00 00 00 00 00 02 37 0C
39 00 00 00 00 00 02 38 0E
39 00 00 00 00 00 02 39 10
39 00 00 00 00 00 02 3A 12
39 00 00 00 00 00 02 3B 14
39 00 00 00 00 00 02 3F 16
39 00 00 00 00 00 02 40 18
39 00 00 00 00 00 02 41 1A
39 00 00 00 00 00 02 42 18
39 00 00 00 00 00 02 43 16
39 00 00 00 00 00 02 44 14
39 00 00 00 00 00 02 45 10
39 00 00 00 00 00 02 46 0E
39 00 00 00 00 00 02 47 0C
39 00 00 00 00 00 02 48 0A
39 00 00 00 00 00 02 49 09
39 00 00 00 00 00 02 4A 08
39 00 00 00 00 00 02 4B 86
39 00 00 00 00 00 02 4C 84
39 00 00 00 00 00 02 4D 04
39 00 00 00 00 00 02 4E 0A
39 00 00 00 00 00 02 4F 1F
39 00 00 00 00 00 02 1A 00
39 00 00 00 00 00 02 53 07
39 00 00 00 00 00 02 54 00
39 00 00 00 00 00 02 55 77
39 00 00 00 00 00 02 5B 70
39 00 00 00 00 00 02 58 EF
39 00 00 00 00 00 02 5F 24
39 00 00 00 00 00 02 63 00
39 00 00 00 00 00 02 FF 00
39 00 00 00 00 00 02 35 00
39 00 00 00 00 00 02 D3 07
39 00 00 00 00 00 02 D4 05
39 00 00 00 00 00 02 55 B0
39 00 00 00 00 00 02 53 24
39 00 00 00 00 00 02 51 FF
39 00 00 00 00 00 02 36 C0
05 00 00 00 78 00 02 11 00
05 01 00 00 00 00 02 29 00
];
		qcom,mdss-dsi-off-command = [39 01 00 00 00 00 02 FF 05
39 00 00 00 00 00 02 FB 01
39 00 00 00 00 00 02 E7 80
39 01 00 00 00 00 02 FF 00
05 00 00 00 0a 00 02 28 00
05 01 00 00 64 00 02 10 00];
		qcom,mdss-dsi-on-command-state = "dsi_lp_mode";
		qcom,mdss-dsi-off-command-state = "dsi_hs_mode";
		qcom,mdss-dsi-h-sync-pulse = <1>;
		qcom,mdss-dsi-traffic-mode = "burst_mode";
		qcom,mdss-dsi-lane-map = "lane_map_0123";
		qcom,mdss-dsi-bllp-eof-power-mode;
		qcom,mdss-dsi-bllp-power-mode;
		qcom,mdss-dsi-lane-0-state;
		qcom,mdss-dsi-lane-1-state;
		qcom,mdss-dsi-lane-2-state;
		qcom,mdss-dsi-lane-3-state;
		qcom,mdss-dsi-panel-timings = [F0 3A 28 00 6C 6E 2C 3E 2E 03 04 00];
		qcom,mdss-pan-physical-width-dimension = <69>;
                qcom,mdss-pan-physical-height-dimension = <121>;
		qcom,mdss-dsi-t-clk-post = <0x2>;
		qcom,mdss-dsi-t-clk-pre = <0x23>;
		qcom,mdss-dsi-dma-trigger = "trigger_sw";
		qcom,mdss-dsi-mdp-trigger = "none";
		qcom,mdss-dsi-reset-sequence = <1 5>, <0 5>, <1 5>, <0 5>, <1 20>;
	};
};
