

&dsi_nt35596_tianma_1080p_video {

	lenovo,lcd-effect-custom-mode-command = [
	//T6920 03070323
		//page selection cmd start
		39 01 00 00 00 00 02 FF 01
		39 00 00 00 00 00 02 FB 01
		//page selection cmd end
		//R(+) MCR cmd
		39 00 00 00 00 00 02 75 00
		39 00 00 00 00 00 02 76 01
		39 00 00 00 00 00 02 77 00
		39 00 00 00 00 00 02 78 22
		39 00 00 00 00 00 02 79 00
		39 00 00 00 00 00 02 7A 4C
		39 00 00 00 00 00 02 7B 00
		39 00 00 00 00 00 02 7C 6B
		39 00 00 00 00 00 02 7D 00
		39 00 00 00 00 00 02 7E 84
		39 00 00 00 00 00 02 7F 00
		39 00 00 00 00 00 02 80 98
		39 00 00 00 00 00 02 81 00
		39 00 00 00 00 00 02 82 AB
		39 00 00 00 00 00 02 83 00
		39 00 00 00 00 00 02 84 BB
		39 00 00 00 00 00 02 85 00
		39 00 00 00 00 00 02 86 C9
		39 00 00 00 00 00 02 87 00
		39 00 00 00 00 00 02 88 FA
		39 00 00 00 00 00 02 89 01
		39 00 00 00 00 00 02 8A 21
		39 00 00 00 00 00 02 8B 01
		39 00 00 00 00 00 02 8C 5E
		39 00 00 00 00 00 02 8D 01
		39 00 00 00 00 00 02 8E 8E
		39 00 00 00 00 00 02 8F 01
		39 00 00 00 00 00 02 90 DA
		39 00 00 00 00 00 02 91 02
		39 00 00 00 00 00 02 92 16
		39 00 00 00 00 00 02 93 02
		39 00 00 00 00 00 02 94 18
		39 00 00 00 00 00 02 95 02
		39 00 00 00 00 00 02 96 50
		39 00 00 00 00 00 02 97 02
		39 00 00 00 00 00 02 98 8D
		39 00 00 00 00 00 02 99 02
		39 00 00 00 00 00 02 9A B4
		39 00 00 00 00 00 02 9B 02
		39 00 00 00 00 00 02 9C E9
		39 00 00 00 00 00 02 9D 03
		39 00 00 00 00 00 02 9E 0C
		39 00 00 00 00 00 02 9F 03
		39 00 00 00 00 00 02 A0 3B
		39 00 00 00 00 00 02 A2 03
		39 00 00 00 00 00 02 A3 4A
		39 00 00 00 00 00 02 A4 03
		39 00 00 00 00 00 02 A5 5A
		39 00 00 00 00 00 02 A6 03
		39 00 00 00 00 00 02 A7 69
		39 00 00 00 00 00 02 A9 03
		39 00 00 00 00 00 02 AA 7A
		39 00 00 00 00 00 02 AB 03
		39 00 00 00 00 00 02 AC 91
		39 00 00 00 00 00 02 AD 03
		39 00 00 00 00 00 02 AE AD
		39 00 00 00 00 00 02 AF 03
		39 00 00 00 00 00 02 B0 C9
		39 00 00 00 00 00 02 B1 03
		39 00 00 00 00 00 02 B2 CD
		//R(-) MCR cmd
		39 00 00 00 00 00 02 B3 00
		39 00 00 00 00 00 02 B4 01
		39 00 00 00 00 00 02 B5 00
		39 00 00 00 00 00 02 B6 22
		39 00 00 00 00 00 02 B7 00
		39 00 00 00 00 00 02 B8 4C
		39 00 00 00 00 00 02 B9 00
		39 00 00 00 00 00 02 BA 6B
		39 00 00 00 00 00 02 BB 00
		39 00 00 00 00 00 02 BC 84
		39 00 00 00 00 00 02 BD 00
		39 00 00 00 00 00 02 BE 98
		39 00 00 00 00 00 02 BF 00
		39 00 00 00 00 00 02 C0 AB
		39 00 00 00 00 00 02 C1 00
		39 00 00 00 00 00 02 C2 BB
		39 00 00 00 00 00 02 C3 00
		39 00 00 00 00 00 02 C4 C9
		39 00 00 00 00 00 02 C5 00
		39 00 00 00 00 00 02 C6 FA
		39 00 00 00 00 00 02 C7 01
		39 00 00 00 00 00 02 C8 21
		39 00 00 00 00 00 02 C9 01
		39 00 00 00 00 00 02 CA 5E
		39 00 00 00 00 00 02 CB 01
		39 00 00 00 00 00 02 CC 8E
		39 00 00 00 00 00 02 CD 01
		39 00 00 00 00 00 02 CE DA
		39 00 00 00 00 00 02 CF 02
		39 00 00 00 00 00 02 D0 16
		39 00 00 00 00 00 02 D1 02
		39 00 00 00 00 00 02 D2 18
		39 00 00 00 00 00 02 D3 02
		39 00 00 00 00 00 02 D4 50
		39 00 00 00 00 00 02 D5 02
		39 00 00 00 00 00 02 D6 8D
		39 00 00 00 00 00 02 D7 02
		39 00 00 00 00 00 02 D8 B4
		39 00 00 00 00 00 02 D9 02
		39 00 00 00 00 00 02 DA E9
		39 00 00 00 00 00 02 DB 03
		39 00 00 00 00 00 02 DC 0C
		39 00 00 00 00 00 02 DD 03
		39 00 00 00 00 00 02 DE 3B
		39 00 00 00 00 00 02 DF 03
		39 00 00 00 00 00 02 E0 4A
		39 00 00 00 00 00 02 E1 03
		39 00 00 00 00 00 02 E2 5A
		39 00 00 00 00 00 02 E3 03
		39 00 00 00 00 00 02 E4 69
		39 00 00 00 00 00 02 E5 03
		39 00 00 00 00 00 02 E6 7A
		39 00 00 00 00 00 02 E7 03
		39 00 00 00 00 00 02 E8 91
		39 00 00 00 00 00 02 E9 03
		39 00 00 00 00 00 02 EA AD
		39 00 00 00 00 00 02 EB 03
		39 00 00 00 00 00 02 EC C9
		39 00 00 00 00 00 02 ED 03
		39 01 00 00 00 00 02 EE CD
		//G(+) MCR cmd
		39 00 00 00 00 00 02 EF 00
		39 00 00 00 00 00 02 F0 F1
		39 00 00 00 00 00 02 F1 00
		39 00 00 00 00 00 02 F2 F6
		39 00 00 00 00 00 02 F3 01
		39 00 00 00 00 00 02 F4 00
		39 00 00 00 00 00 02 F5 01
		39 00 00 00 00 00 02 F6 09
		39 00 00 00 00 00 02 F7 01
		39 00 00 00 00 00 02 F8 12
		39 00 00 00 00 00 02 F9 01
		39 00 00 00 00 00 02 FA 1A
		//page selection cmd start
		39 00 00 00 00 00 02 FF 02
		//page selection cmd end
		09 00 00 00 00 00 02 00 00
		09 00 00 00 00 00 02 00 00
		09 00 00 00 00 00 02 00 00
		39 00 00 00 00 00 02 FB 01
		39 00 00 00 00 00 02 00 01
		39 00 00 00 00 00 02 01 22
		39 00 00 00 00 00 02 02 01
		39 00 00 00 00 00 02 03 2A
		39 00 00 00 00 00 02 04 01
		39 00 00 00 00 00 02 05 32
		39 00 00 00 00 00 02 06 01
		39 00 00 00 00 00 02 07 4D
		39 00 00 00 00 00 02 08 01
		39 00 00 00 00 00 02 09 66
		39 00 00 00 00 00 02 0A 01
		39 00 00 00 00 00 02 0B 92
		39 00 00 00 00 00 02 0C 01
		39 00 00 00 00 00 02 0D B6
		39 00 00 00 00 00 02 0E 01
		39 00 00 00 00 00 02 0F F4
		39 00 00 00 00 00 02 10 02
		39 00 00 00 00 00 02 11 2A
		39 00 00 00 00 00 02 12 02
		39 00 00 00 00 00 02 13 2B
		39 00 00 00 00 00 02 14 02
		39 00 00 00 00 00 02 15 5E
		39 00 00 00 00 00 02 16 02
		39 00 00 00 00 00 02 17 99
		39 00 00 00 00 00 02 18 02
		39 00 00 00 00 00 02 19 BF
		39 00 00 00 00 00 02 1A 02
		39 00 00 00 00 00 02 1B F5
		39 00 00 00 00 00 02 1C 03
		39 00 00 00 00 00 02 1D 16
		39 00 00 00 00 00 02 1E 03
		39 00 00 00 00 00 02 1F 43
		39 00 00 00 00 00 02 20 03
		39 00 00 00 00 00 02 21 55
		39 00 00 00 00 00 02 22 03
		39 00 00 00 00 00 02 23 66
		39 00 00 00 00 00 02 24 03
		39 00 00 00 00 00 02 25 71
		39 00 00 00 00 00 02 26 03
		39 00 00 00 00 00 02 27 82
		39 00 00 00 00 00 02 28 03
		39 00 00 00 00 00 02 29 9A
		39 00 00 00 00 00 02 2A 03
		39 00 00 00 00 00 02 2B B5
		39 00 00 00 00 00 02 2D 03
		39 00 00 00 00 00 02 2F CA
		39 00 00 00 00 00 02 30 03
		39 00 00 00 00 00 02 31 CD
		//G(-) MCR cmd
		39 00 00 00 00 00 02 32 00
		39 00 00 00 00 00 02 33 F1
		39 00 00 00 00 00 02 34 00
		39 00 00 00 00 00 02 35 F6
		39 00 00 00 00 00 02 36 01
		39 00 00 00 00 00 02 37 00
		39 00 00 00 00 00 02 38 01
		39 00 00 00 00 00 02 39 09
		39 00 00 00 00 00 02 3A 01
		39 00 00 00 00 00 02 3B 12
		39 00 00 00 00 00 02 3D 01
		39 00 00 00 00 00 02 3F 1A
		39 00 00 00 00 00 02 40 01
		39 00 00 00 00 00 02 41 22
		39 00 00 00 00 00 02 42 01
		39 00 00 00 00 00 02 43 2A
		39 00 00 00 00 00 02 44 01
		39 00 00 00 00 00 02 45 32
		39 00 00 00 00 00 02 46 01
		39 00 00 00 00 00 02 47 4D
		39 00 00 00 00 00 02 48 01
		39 00 00 00 00 00 02 49 66
		39 00 00 00 00 00 02 4A 01
		39 00 00 00 00 00 02 4B 92
		39 00 00 00 00 00 02 4C 01
		39 00 00 00 00 00 02 4D B6
		39 00 00 00 00 00 02 4E 01
		39 00 00 00 00 00 02 4F F4
		39 00 00 00 00 00 02 50 02
		39 00 00 00 00 00 02 51 2A
		39 00 00 00 00 00 02 52 02
		39 00 00 00 00 00 02 53 2B
		39 00 00 00 00 00 02 54 02
		39 00 00 00 00 00 02 55 5E
		39 00 00 00 00 00 02 56 02
		39 00 00 00 00 00 02 58 99
		39 00 00 00 00 00 02 59 02
		39 00 00 00 00 00 02 5A BF
		39 00 00 00 00 00 02 5B 02
		39 00 00 00 00 00 02 5C F5
		39 00 00 00 00 00 02 5D 03
		39 00 00 00 00 00 02 5E 16
		39 00 00 00 00 00 02 5F 03
		39 00 00 00 00 00 02 60 43
		39 00 00 00 00 00 02 61 03
		39 00 00 00 00 00 02 62 55
		39 00 00 00 00 00 02 63 03
		39 00 00 00 00 00 02 64 66
		39 00 00 00 00 00 02 65 03
		39 00 00 00 00 00 02 66 71
		39 00 00 00 00 00 02 67 03
		39 00 00 00 00 00 02 68 82
		39 00 00 00 00 00 02 69 03
		39 00 00 00 00 00 02 6A 9A
		39 00 00 00 00 00 02 6B 03
		39 00 00 00 00 00 02 6C B5
		39 00 00 00 00 00 02 6D 03
		39 00 00 00 00 00 02 6E CA
		39 00 00 00 00 00 02 6F 03
		39 01 00 00 00 00 02 70 CD
		//B(+) MCR cmd
		39 00 00 00 00 00 02 71 00
		39 00 00 00 00 00 02 72 AC
		39 00 00 00 00 00 02 73 00
		39 00 00 00 00 00 02 74 B3
		39 00 00 00 00 00 02 75 00
		39 00 00 00 00 00 02 76 C0
		39 00 00 00 00 00 02 77 00
		39 00 00 00 00 00 02 78 CC
		39 00 00 00 00 00 02 79 00
		39 00 00 00 00 00 02 7A D8
		39 00 00 00 00 00 02 7B 00
		39 00 00 00 00 00 02 7C E2
		39 00 00 00 00 00 02 7D 00
		39 00 00 00 00 00 02 7E EC
		39 00 00 00 00 00 02 7F 00
		39 00 00 00 00 00 02 80 F6
		39 00 00 00 00 00 02 81 01
		39 00 00 00 00 00 02 82 00
		39 00 00 00 00 00 02 83 01
		39 00 00 00 00 00 02 84 21
		39 00 00 00 00 00 02 85 01
		39 00 00 00 00 00 02 86 3F
		39 00 00 00 00 00 02 87 01
		39 00 00 00 00 00 02 88 73
		39 00 00 00 00 00 02 89 01
		39 00 00 00 00 00 02 8A 9C
		39 00 00 00 00 00 02 8B 01
		39 00 00 00 00 00 02 8C E3
		39 00 00 00 00 00 02 8D 02
		39 00 00 00 00 00 02 8E 1E
		39 00 00 00 00 00 02 8F 02
		39 00 00 00 00 00 02 90 1F
		39 00 00 00 00 00 02 91 02
		39 00 00 00 00 00 02 92 55
		39 00 00 00 00 00 02 93 02
		39 00 00 00 00 00 02 94 92
		39 00 00 00 00 00 02 95 02
		39 00 00 00 00 00 02 96 BA
		39 00 00 00 00 00 02 97 02
		39 00 00 00 00 00 02 98 F6
		39 00 00 00 00 00 02 99 03
		39 00 00 00 00 00 02 9A 26
		39 00 00 00 00 00 02 9B 03
		39 00 00 00 00 00 02 9C 4B
		39 00 00 00 00 00 02 9D 03
		39 00 00 00 00 00 02 9E 4C
		39 00 00 00 00 00 02 9F 03
		39 00 00 00 00 00 02 A0 4D
		39 00 00 00 00 00 02 A2 03
		39 00 00 00 00 00 02 A3 4E
		39 00 00 00 00 00 02 A4 03
		39 00 00 00 00 00 02 A5 5D
		39 00 00 00 00 00 02 A6 03
		39 00 00 00 00 00 02 A7 7B
		39 00 00 00 00 00 02 A9 03
		39 00 00 00 00 00 02 AA A0
		39 00 00 00 00 00 02 AB 03
		39 00 00 00 00 00 02 AC C5
		39 00 00 00 00 00 02 AD 03
		39 00 00 00 00 00 02 AE CD
		//B(-) MCR cmd
		39 00 00 00 00 00 02 AF 00
		39 00 00 00 00 00 02 B0 AC
		39 00 00 00 00 00 02 B1 00
		39 00 00 00 00 00 02 B2 B3
		39 00 00 00 00 00 02 B3 00
		39 00 00 00 00 00 02 B4 C0
		39 00 00 00 00 00 02 B5 00
		39 00 00 00 00 00 02 B6 CC
		39 00 00 00 00 00 02 B7 00
		39 00 00 00 00 00 02 B8 D8
		39 00 00 00 00 00 02 B9 00
		39 00 00 00 00 00 02 BA E2
		39 00 00 00 00 00 02 BB 00
		39 00 00 00 00 00 02 BC EC
		39 00 00 00 00 00 02 BD 00
		39 00 00 00 00 00 02 BE F6
		39 00 00 00 00 00 02 BF 01
		39 00 00 00 00 00 02 C0 00
		39 00 00 00 00 00 02 C1 01
		39 00 00 00 00 00 02 C2 21
		39 00 00 00 00 00 02 C3 01
		39 00 00 00 00 00 02 C4 3F
		39 00 00 00 00 00 02 C5 01
		39 00 00 00 00 00 02 C6 73
		39 00 00 00 00 00 02 C7 01
		39 00 00 00 00 00 02 C8 9C
		39 00 00 00 00 00 02 C9 01
		39 00 00 00 00 00 02 CA E3
		39 00 00 00 00 00 02 CB 02
		39 00 00 00 00 00 02 CC 1E
		39 00 00 00 00 00 02 CD 02
		39 00 00 00 00 00 02 CE 1F
		39 00 00 00 00 00 02 CF 02
		39 00 00 00 00 00 02 D0 55
		39 00 00 00 00 00 02 D1 02
		39 00 00 00 00 00 02 D2 92
		39 00 00 00 00 00 02 D3 02
		39 00 00 00 00 00 02 D4 BA
		39 00 00 00 00 00 02 D5 02
		39 00 00 00 00 00 02 D6 F6
		39 00 00 00 00 00 02 D7 03
		39 00 00 00 00 00 02 D8 26
		39 00 00 00 00 00 02 D9 03
		39 00 00 00 00 00 02 DA 4B
		39 00 00 00 00 00 02 DB 03
		39 00 00 00 00 00 02 DC 4C
		39 00 00 00 00 00 02 DD 03
		39 00 00 00 00 00 02 DE 4D
		39 00 00 00 00 00 02 DF 03
		39 00 00 00 00 00 02 E0 4E
		39 00 00 00 00 00 02 E1 03
		39 00 00 00 00 00 02 E2 5D
		39 00 00 00 00 00 02 E3 03
		39 00 00 00 00 00 02 E4 7B
		39 00 00 00 00 00 02 E5 03
		39 00 00 00 00 00 02 E6 A0
		39 00 00 00 00 00 02 E7 03
		39 00 00 00 00 00 02 E8 C5
		39 00 00 00 00 00 02 E9 03
		39 01 00 00 00 00 02 EA CD
		39 01 00 00 00 00 02 FF 00
		39 01 00 00 00 00 02 55 B3];
	lenovo,lcd-effect-custom-mode-command-state = "dsi_hs_mode";

	lenovo,lcd-effect-default-mode-command = [
		//T6920 03070323
			//page selection cmd start
			39 01 00 00 00 00 02 FF 01
			39 00 00 00 00 00 02 FB 01
			//page selection cmd end
			//R(+) MCR cmd
			39 00 00 00 00 00 02 75 00
			39 00 00 00 00 00 02 76 01
			39 00 00 00 00 00 02 77 00
			39 00 00 00 00 00 02 78 22
			39 00 00 00 00 00 02 79 00
			39 00 00 00 00 00 02 7A 4C
			39 00 00 00 00 00 02 7B 00
			39 00 00 00 00 00 02 7C 6B
			39 00 00 00 00 00 02 7D 00
			39 00 00 00 00 00 02 7E 84
			39 00 00 00 00 00 02 7F 00
			39 00 00 00 00 00 02 80 98
			39 00 00 00 00 00 02 81 00
			39 00 00 00 00 00 02 82 AB
			39 00 00 00 00 00 02 83 00
			39 00 00 00 00 00 02 84 BB
			39 00 00 00 00 00 02 85 00
			39 00 00 00 00 00 02 86 C9
			39 00 00 00 00 00 02 87 00
			39 00 00 00 00 00 02 88 FA
			39 00 00 00 00 00 02 89 01
			39 00 00 00 00 00 02 8A 21
			39 00 00 00 00 00 02 8B 01
			39 00 00 00 00 00 02 8C 5E
			39 00 00 00 00 00 02 8D 01
			39 00 00 00 00 00 02 8E 8E
			39 00 00 00 00 00 02 8F 01
			39 00 00 00 00 00 02 90 DA
			39 00 00 00 00 00 02 91 02
			39 00 00 00 00 00 02 92 16
			39 00 00 00 00 00 02 93 02
			39 00 00 00 00 00 02 94 18
			39 00 00 00 00 00 02 95 02
			39 00 00 00 00 00 02 96 50
			39 00 00 00 00 00 02 97 02
			39 00 00 00 00 00 02 98 8D
			39 00 00 00 00 00 02 99 02
			39 00 00 00 00 00 02 9A B4
			39 00 00 00 00 00 02 9B 02
			39 00 00 00 00 00 02 9C E9
			39 00 00 00 00 00 02 9D 03
			39 00 00 00 00 00 02 9E 0C
			39 00 00 00 00 00 02 9F 03
			39 00 00 00 00 00 02 A0 3B
			39 00 00 00 00 00 02 A2 03
			39 00 00 00 00 00 02 A3 4A
			39 00 00 00 00 00 02 A4 03
			39 00 00 00 00 00 02 A5 5A
			39 00 00 00 00 00 02 A6 03
			39 00 00 00 00 00 02 A7 69
			39 00 00 00 00 00 02 A9 03
			39 00 00 00 00 00 02 AA 7A
			39 00 00 00 00 00 02 AB 03
			39 00 00 00 00 00 02 AC 91
			39 00 00 00 00 00 02 AD 03
			39 00 00 00 00 00 02 AE AD
			39 00 00 00 00 00 02 AF 03
			39 00 00 00 00 00 02 B0 C9
			39 00 00 00 00 00 02 B1 03
			39 00 00 00 00 00 02 B2 CD
			//R(-) MCR cmd
			39 00 00 00 00 00 02 B3 00
			39 00 00 00 00 00 02 B4 01
			39 00 00 00 00 00 02 B5 00
			39 00 00 00 00 00 02 B6 22
			39 00 00 00 00 00 02 B7 00
			39 00 00 00 00 00 02 B8 4C
			39 00 00 00 00 00 02 B9 00
			39 00 00 00 00 00 02 BA 6B
			39 00 00 00 00 00 02 BB 00
			39 00 00 00 00 00 02 BC 84
			39 00 00 00 00 00 02 BD 00
			39 00 00 00 00 00 02 BE 98
			39 00 00 00 00 00 02 BF 00
			39 00 00 00 00 00 02 C0 AB
			39 00 00 00 00 00 02 C1 00
			39 00 00 00 00 00 02 C2 BB
			39 00 00 00 00 00 02 C3 00
			39 00 00 00 00 00 02 C4 C9
			39 00 00 00 00 00 02 C5 00
			39 00 00 00 00 00 02 C6 FA
			39 00 00 00 00 00 02 C7 01
			39 00 00 00 00 00 02 C8 21
			39 00 00 00 00 00 02 C9 01
			39 00 00 00 00 00 02 CA 5E
			39 00 00 00 00 00 02 CB 01
			39 00 00 00 00 00 02 CC 8E
			39 00 00 00 00 00 02 CD 01
			39 00 00 00 00 00 02 CE DA
			39 00 00 00 00 00 02 CF 02
			39 00 00 00 00 00 02 D0 16
			39 00 00 00 00 00 02 D1 02
			39 00 00 00 00 00 02 D2 18
			39 00 00 00 00 00 02 D3 02
			39 00 00 00 00 00 02 D4 50
			39 00 00 00 00 00 02 D5 02
			39 00 00 00 00 00 02 D6 8D
			39 00 00 00 00 00 02 D7 02
			39 00 00 00 00 00 02 D8 B4
			39 00 00 00 00 00 02 D9 02
			39 00 00 00 00 00 02 DA E9
			39 00 00 00 00 00 02 DB 03
			39 00 00 00 00 00 02 DC 0C
			39 00 00 00 00 00 02 DD 03
			39 00 00 00 00 00 02 DE 3B
			39 00 00 00 00 00 02 DF 03
			39 00 00 00 00 00 02 E0 4A
			39 00 00 00 00 00 02 E1 03
			39 00 00 00 00 00 02 E2 5A
			39 00 00 00 00 00 02 E3 03
			39 00 00 00 00 00 02 E4 69
			39 00 00 00 00 00 02 E5 03
			39 00 00 00 00 00 02 E6 7A
			39 00 00 00 00 00 02 E7 03
			39 00 00 00 00 00 02 E8 91
			39 00 00 00 00 00 02 E9 03
			39 00 00 00 00 00 02 EA AD
			39 00 00 00 00 00 02 EB 03
			39 00 00 00 00 00 02 EC C9
			39 00 00 00 00 00 02 ED 03
			39 01 00 00 00 00 02 EE CD
			//G(+) MCR cmd
			39 00 00 00 00 00 02 EF 00
			39 00 00 00 00 00 02 F0 F1
			39 00 00 00 00 00 02 F1 00
			39 00 00 00 00 00 02 F2 F6
			39 00 00 00 00 00 02 F3 01
			39 00 00 00 00 00 02 F4 00
			39 00 00 00 00 00 02 F5 01
			39 00 00 00 00 00 02 F6 09
			39 00 00 00 00 00 02 F7 01
			39 00 00 00 00 00 02 F8 12
			39 00 00 00 00 00 02 F9 01
			39 00 00 00 00 00 02 FA 1A
			//page selection cmd start
			39 00 00 00 00 00 02 FF 02
			//page selection cmd end
			09 00 00 00 00 00 02 00 00
			09 00 00 00 00 00 02 00 00
			09 00 00 00 00 00 02 00 00
			39 00 00 00 00 00 02 FB 01
			39 00 00 00 00 00 02 00 01
			39 00 00 00 00 00 02 01 22
			39 00 00 00 00 00 02 02 01
			39 00 00 00 00 00 02 03 2A
			39 00 00 00 00 00 02 04 01
			39 00 00 00 00 00 02 05 32
			39 00 00 00 00 00 02 06 01
			39 00 00 00 00 00 02 07 4D
			39 00 00 00 00 00 02 08 01
			39 00 00 00 00 00 02 09 66
			39 00 00 00 00 00 02 0A 01
			39 00 00 00 00 00 02 0B 92
			39 00 00 00 00 00 02 0C 01
			39 00 00 00 00 00 02 0D B6
			39 00 00 00 00 00 02 0E 01
			39 00 00 00 00 00 02 0F F4
			39 00 00 00 00 00 02 10 02
			39 00 00 00 00 00 02 11 2A
			39 00 00 00 00 00 02 12 02
			39 00 00 00 00 00 02 13 2B
			39 00 00 00 00 00 02 14 02
			39 00 00 00 00 00 02 15 5E
			39 00 00 00 00 00 02 16 02
			39 00 00 00 00 00 02 17 99
			39 00 00 00 00 00 02 18 02
			39 00 00 00 00 00 02 19 BF
			39 00 00 00 00 00 02 1A 02
			39 00 00 00 00 00 02 1B F5
			39 00 00 00 00 00 02 1C 03
			39 00 00 00 00 00 02 1D 16
			39 00 00 00 00 00 02 1E 03
			39 00 00 00 00 00 02 1F 43
			39 00 00 00 00 00 02 20 03
			39 00 00 00 00 00 02 21 55
			39 00 00 00 00 00 02 22 03
			39 00 00 00 00 00 02 23 66
			39 00 00 00 00 00 02 24 03
			39 00 00 00 00 00 02 25 71
			39 00 00 00 00 00 02 26 03
			39 00 00 00 00 00 02 27 82
			39 00 00 00 00 00 02 28 03
			39 00 00 00 00 00 02 29 9A
			39 00 00 00 00 00 02 2A 03
			39 00 00 00 00 00 02 2B B5
			39 00 00 00 00 00 02 2D 03
			39 00 00 00 00 00 02 2F CA
			39 00 00 00 00 00 02 30 03
			39 00 00 00 00 00 02 31 CD
			//G(-) MCR cmd
			39 00 00 00 00 00 02 32 00
			39 00 00 00 00 00 02 33 F1
			39 00 00 00 00 00 02 34 00
			39 00 00 00 00 00 02 35 F6
			39 00 00 00 00 00 02 36 01
			39 00 00 00 00 00 02 37 00
			39 00 00 00 00 00 02 38 01
			39 00 00 00 00 00 02 39 09
			39 00 00 00 00 00 02 3A 01
			39 00 00 00 00 00 02 3B 12
			39 00 00 00 00 00 02 3D 01
			39 00 00 00 00 00 02 3F 1A
			39 00 00 00 00 00 02 40 01
			39 00 00 00 00 00 02 41 22
			39 00 00 00 00 00 02 42 01
			39 00 00 00 00 00 02 43 2A
			39 00 00 00 00 00 02 44 01
			39 00 00 00 00 00 02 45 32
			39 00 00 00 00 00 02 46 01
			39 00 00 00 00 00 02 47 4D
			39 00 00 00 00 00 02 48 01
			39 00 00 00 00 00 02 49 66
			39 00 00 00 00 00 02 4A 01
			39 00 00 00 00 00 02 4B 92
			39 00 00 00 00 00 02 4C 01
			39 00 00 00 00 00 02 4D B6
			39 00 00 00 00 00 02 4E 01
			39 00 00 00 00 00 02 4F F4
			39 00 00 00 00 00 02 50 02
			39 00 00 00 00 00 02 51 2A
			39 00 00 00 00 00 02 52 02
			39 00 00 00 00 00 02 53 2B
			39 00 00 00 00 00 02 54 02
			39 00 00 00 00 00 02 55 5E
			39 00 00 00 00 00 02 56 02
			39 00 00 00 00 00 02 58 99
			39 00 00 00 00 00 02 59 02
			39 00 00 00 00 00 02 5A BF
			39 00 00 00 00 00 02 5B 02
			39 00 00 00 00 00 02 5C F5
			39 00 00 00 00 00 02 5D 03
			39 00 00 00 00 00 02 5E 16
			39 00 00 00 00 00 02 5F 03
			39 00 00 00 00 00 02 60 43
			39 00 00 00 00 00 02 61 03
			39 00 00 00 00 00 02 62 55
			39 00 00 00 00 00 02 63 03
			39 00 00 00 00 00 02 64 66
			39 00 00 00 00 00 02 65 03
			39 00 00 00 00 00 02 66 71
			39 00 00 00 00 00 02 67 03
			39 00 00 00 00 00 02 68 82
			39 00 00 00 00 00 02 69 03
			39 00 00 00 00 00 02 6A 9A
			39 00 00 00 00 00 02 6B 03
			39 00 00 00 00 00 02 6C B5
			39 00 00 00 00 00 02 6D 03
			39 00 00 00 00 00 02 6E CA
			39 00 00 00 00 00 02 6F 03
			39 01 00 00 00 00 02 70 CD
			//B(+) MCR cmd
			39 00 00 00 00 00 02 71 00
			39 00 00 00 00 00 02 72 AC
			39 00 00 00 00 00 02 73 00
			39 00 00 00 00 00 02 74 B3
			39 00 00 00 00 00 02 75 00
			39 00 00 00 00 00 02 76 C0
			39 00 00 00 00 00 02 77 00
			39 00 00 00 00 00 02 78 CC
			39 00 00 00 00 00 02 79 00
			39 00 00 00 00 00 02 7A D8
			39 00 00 00 00 00 02 7B 00
			39 00 00 00 00 00 02 7C E2
			39 00 00 00 00 00 02 7D 00
			39 00 00 00 00 00 02 7E EC
			39 00 00 00 00 00 02 7F 00
			39 00 00 00 00 00 02 80 F6
			39 00 00 00 00 00 02 81 01
			39 00 00 00 00 00 02 82 00
			39 00 00 00 00 00 02 83 01
			39 00 00 00 00 00 02 84 21
			39 00 00 00 00 00 02 85 01
			39 00 00 00 00 00 02 86 3F
			39 00 00 00 00 00 02 87 01
			39 00 00 00 00 00 02 88 73
			39 00 00 00 00 00 02 89 01
			39 00 00 00 00 00 02 8A 9C
			39 00 00 00 00 00 02 8B 01
			39 00 00 00 00 00 02 8C E3
			39 00 00 00 00 00 02 8D 02
			39 00 00 00 00 00 02 8E 1E
			39 00 00 00 00 00 02 8F 02
			39 00 00 00 00 00 02 90 1F
			39 00 00 00 00 00 02 91 02
			39 00 00 00 00 00 02 92 55
			39 00 00 00 00 00 02 93 02
			39 00 00 00 00 00 02 94 92
			39 00 00 00 00 00 02 95 02
			39 00 00 00 00 00 02 96 BA
			39 00 00 00 00 00 02 97 02
			39 00 00 00 00 00 02 98 F6
			39 00 00 00 00 00 02 99 03
			39 00 00 00 00 00 02 9A 26
			39 00 00 00 00 00 02 9B 03
			39 00 00 00 00 00 02 9C 4B
			39 00 00 00 00 00 02 9D 03
			39 00 00 00 00 00 02 9E 4C
			39 00 00 00 00 00 02 9F 03
			39 00 00 00 00 00 02 A0 4D
			39 00 00 00 00 00 02 A2 03
			39 00 00 00 00 00 02 A3 4E
			39 00 00 00 00 00 02 A4 03
			39 00 00 00 00 00 02 A5 5D
			39 00 00 00 00 00 02 A6 03
			39 00 00 00 00 00 02 A7 7B
			39 00 00 00 00 00 02 A9 03
			39 00 00 00 00 00 02 AA A0
			39 00 00 00 00 00 02 AB 03
			39 00 00 00 00 00 02 AC C5
			39 00 00 00 00 00 02 AD 03
			39 00 00 00 00 00 02 AE CD
			//B(-) MCR cmd
			39 00 00 00 00 00 02 AF 00
			39 00 00 00 00 00 02 B0 AC
			39 00 00 00 00 00 02 B1 00
			39 00 00 00 00 00 02 B2 B3
			39 00 00 00 00 00 02 B3 00
			39 00 00 00 00 00 02 B4 C0
			39 00 00 00 00 00 02 B5 00
			39 00 00 00 00 00 02 B6 CC
			39 00 00 00 00 00 02 B7 00
			39 00 00 00 00 00 02 B8 D8
			39 00 00 00 00 00 02 B9 00
			39 00 00 00 00 00 02 BA E2
			39 00 00 00 00 00 02 BB 00
			39 00 00 00 00 00 02 BC EC
			39 00 00 00 00 00 02 BD 00
			39 00 00 00 00 00 02 BE F6
			39 00 00 00 00 00 02 BF 01
			39 00 00 00 00 00 02 C0 00
			39 00 00 00 00 00 02 C1 01
			39 00 00 00 00 00 02 C2 21
			39 00 00 00 00 00 02 C3 01
			39 00 00 00 00 00 02 C4 3F
			39 00 00 00 00 00 02 C5 01
			39 00 00 00 00 00 02 C6 73
			39 00 00 00 00 00 02 C7 01
			39 00 00 00 00 00 02 C8 9C
			39 00 00 00 00 00 02 C9 01
			39 00 00 00 00 00 02 CA E3
			39 00 00 00 00 00 02 CB 02
			39 00 00 00 00 00 02 CC 1E
			39 00 00 00 00 00 02 CD 02
			39 00 00 00 00 00 02 CE 1F
			39 00 00 00 00 00 02 CF 02
			39 00 00 00 00 00 02 D0 55
			39 00 00 00 00 00 02 D1 02
			39 00 00 00 00 00 02 D2 92
			39 00 00 00 00 00 02 D3 02
			39 00 00 00 00 00 02 D4 BA
			39 00 00 00 00 00 02 D5 02
			39 00 00 00 00 00 02 D6 F6
			39 00 00 00 00 00 02 D7 03
			39 00 00 00 00 00 02 D8 26
			39 00 00 00 00 00 02 D9 03
			39 00 00 00 00 00 02 DA 4B
			39 00 00 00 00 00 02 DB 03
			39 00 00 00 00 00 02 DC 4C
			39 00 00 00 00 00 02 DD 03
			39 00 00 00 00 00 02 DE 4D
			39 00 00 00 00 00 02 DF 03
			39 00 00 00 00 00 02 E0 4E
			39 00 00 00 00 00 02 E1 03
			39 00 00 00 00 00 02 E2 5D
			39 00 00 00 00 00 02 E3 03
			39 00 00 00 00 00 02 E4 7B
			39 00 00 00 00 00 02 E5 03
			39 00 00 00 00 00 02 E6 A0
			39 00 00 00 00 00 02 E7 03
			39 00 00 00 00 00 02 E8 C5
			39 00 00 00 00 00 02 E9 03
			39 01 00 00 00 00 02 EA CD
			39 01 00 00 00 00 02 FF 00
			39 01 00 00 00 00 02 55 B3];
	lenovo,lcd-effect-default-mode-command-state = "dsi_hs_mode";


	lenovo,lcd-effect-comfort-mode-command = [
			//T5000 03460359
			//page selection cmd start
			39 01 00 00 00 00 02 FF 01
			39 00 00 00 00 00 02 FB 01
			//page selection cmd end
			//R(+) MCR cmd
			39 00 00 00 00 00 02 75 00
			39 00 00 00 00 00 02 76 01
			39 00 00 00 00 00 02 77 00
			39 00 00 00 00 00 02 78 22
			39 00 00 00 00 00 02 79 00
			39 00 00 00 00 00 02 7A 4C
			39 00 00 00 00 00 02 7B 00
			39 00 00 00 00 00 02 7C 6B
			39 00 00 00 00 00 02 7D 00
			39 00 00 00 00 00 02 7E 84
			39 00 00 00 00 00 02 7F 00
			39 00 00 00 00 00 02 80 98
			39 00 00 00 00 00 02 81 00
			39 00 00 00 00 00 02 82 AA
			39 00 00 00 00 00 02 83 00
			39 00 00 00 00 00 02 84 BB
			39 00 00 00 00 00 02 85 00
			39 00 00 00 00 00 02 86 C9
			39 00 00 00 00 00 02 87 00
			39 00 00 00 00 00 02 88 FA
			39 00 00 00 00 00 02 89 01
			39 00 00 00 00 00 02 8A 21
			39 00 00 00 00 00 02 8B 01
			39 00 00 00 00 00 02 8C 5E
			39 00 00 00 00 00 02 8D 01
			39 00 00 00 00 00 02 8E 8E
			39 00 00 00 00 00 02 8F 01
			39 00 00 00 00 00 02 90 DA
			39 00 00 00 00 00 02 91 02
			39 00 00 00 00 00 02 92 16
			39 00 00 00 00 00 02 93 02
			39 00 00 00 00 00 02 94 18
			39 00 00 00 00 00 02 95 02
			39 00 00 00 00 00 02 96 4F
			39 00 00 00 00 00 02 97 02
			39 00 00 00 00 00 02 98 8D
			39 00 00 00 00 00 02 99 02
			39 00 00 00 00 00 02 9A B4
			39 00 00 00 00 00 02 9B 02
			39 00 00 00 00 00 02 9C E9
			39 00 00 00 00 00 02 9D 03
			39 00 00 00 00 00 02 9E 0C
			39 00 00 00 00 00 02 9F 03
			39 00 00 00 00 00 02 A0 3B
			39 00 00 00 00 00 02 A2 03
			39 00 00 00 00 00 02 A3 52
			39 00 00 00 00 00 02 A4 03
			39 00 00 00 00 00 02 A5 61
			39 00 00 00 00 00 02 A6 03
			39 00 00 00 00 00 02 A7 67
			39 00 00 00 00 00 02 A9 03
			39 00 00 00 00 00 02 AA 7A
			39 00 00 00 00 00 02 AB 03
			39 00 00 00 00 00 02 AC 91
			39 00 00 00 00 00 02 AD 03
			39 00 00 00 00 00 02 AE AD
			39 00 00 00 00 00 02 AF 03
			39 00 00 00 00 00 02 B0 C9
			39 00 00 00 00 00 02 B1 03
			39 00 00 00 00 00 02 B2 CD
			//R(-) MCR cmd
			39 00 00 00 00 00 02 B3 00
			39 00 00 00 00 00 02 B4 01
			39 00 00 00 00 00 02 B5 00
			39 00 00 00 00 00 02 B6 22
			39 00 00 00 00 00 02 B7 00
			39 00 00 00 00 00 02 B8 4C
			39 00 00 00 00 00 02 B9 00
			39 00 00 00 00 00 02 BA 6B
			39 00 00 00 00 00 02 BB 00
			39 00 00 00 00 00 02 BC 84
			39 00 00 00 00 00 02 BD 00
			39 00 00 00 00 00 02 BE 98
			39 00 00 00 00 00 02 BF 00
			39 00 00 00 00 00 02 C0 AA
			39 00 00 00 00 00 02 C1 00
			39 00 00 00 00 00 02 C2 BB
			39 00 00 00 00 00 02 C3 00
			39 00 00 00 00 00 02 C4 C9
			39 00 00 00 00 00 02 C5 00
			39 00 00 00 00 00 02 C6 FA
			39 00 00 00 00 00 02 C7 01
			39 00 00 00 00 00 02 C8 21
			39 00 00 00 00 00 02 C9 01
			39 00 00 00 00 00 02 CA 5E
			39 00 00 00 00 00 02 CB 01
			39 00 00 00 00 00 02 CC 8E
			39 00 00 00 00 00 02 CD 01
			39 00 00 00 00 00 02 CE DA
			39 00 00 00 00 00 02 CF 02
			39 00 00 00 00 00 02 D0 16
			39 00 00 00 00 00 02 D1 02
			39 00 00 00 00 00 02 D2 18
			39 00 00 00 00 00 02 D3 02
			39 00 00 00 00 00 02 D4 4F
			39 00 00 00 00 00 02 D5 02
			39 00 00 00 00 00 02 D6 8D
			39 00 00 00 00 00 02 D7 02
			39 00 00 00 00 00 02 D8 B4
			39 00 00 00 00 00 02 D9 02
			39 00 00 00 00 00 02 DA E9
			39 00 00 00 00 00 02 DB 03
			39 00 00 00 00 00 02 DC 0C
			39 00 00 00 00 00 02 DD 03
			39 00 00 00 00 00 02 DE 3B
			39 00 00 00 00 00 02 DF 03
			39 00 00 00 00 00 02 E0 52
			39 00 00 00 00 00 02 E1 03
			39 00 00 00 00 00 02 E2 61
			39 00 00 00 00 00 02 E3 03
			39 00 00 00 00 00 02 E4 67
			39 00 00 00 00 00 02 E5 03
			39 00 00 00 00 00 02 E6 7A
			39 00 00 00 00 00 02 E7 03
			39 00 00 00 00 00 02 E8 91
			39 00 00 00 00 00 02 E9 03
			39 00 00 00 00 00 02 EA AD
			39 00 00 00 00 00 02 EB 03
			39 00 00 00 00 00 02 EC C9
			39 00 00 00 00 00 02 ED 03
			39 01 00 00 00 00 02 EE CD
			//G(+) MCR cmd
			39 00 00 00 00 00 02 EF 01
			39 00 00 00 00 00 02 F0 56
			39 00 00 00 00 00 02 F1 01
			39 00 00 00 00 00 02 F2 59
			39 00 00 00 00 00 02 F3 01
			39 00 00 00 00 00 02 F4 5E
			39 00 00 00 00 00 02 F5 01
			39 00 00 00 00 00 02 F6 64
			39 00 00 00 00 00 02 F7 01
			39 00 00 00 00 00 02 F8 69
			39 00 00 00 00 00 02 F9 01
			39 00 00 00 00 00 02 FA 6E
			//page selection cmd start
			39 00 00 00 00 00 02 FF 02
			//page selection cmd end
			09 00 00 00 00 00 02 00 00
			09 00 00 00 00 00 02 00 00
			09 00 00 00 00 00 02 00 00
			39 00 00 00 00 00 02 FB 01
			39 00 00 00 00 00 02 00 01
			39 00 00 00 00 00 02 01 73
			39 00 00 00 00 00 02 02 01
			39 00 00 00 00 00 02 03 78
			39 00 00 00 00 00 02 04 01
			39 00 00 00 00 00 02 05 7D
			39 00 00 00 00 00 02 06 01
			39 00 00 00 00 00 02 07 90
			39 00 00 00 00 00 02 08 01
			39 00 00 00 00 00 02 09 A1
			39 00 00 00 00 00 02 0A 01
			39 00 00 00 00 00 02 0B C1
			39 00 00 00 00 00 02 0C 01
			39 00 00 00 00 00 02 0D DD
			39 00 00 00 00 00 02 0E 02
			39 00 00 00 00 00 02 0F 0F
			39 00 00 00 00 00 02 10 02
			39 00 00 00 00 00 02 11 3D
			39 00 00 00 00 00 02 12 02
			39 00 00 00 00 00 02 13 3F
			39 00 00 00 00 00 02 14 02
			39 00 00 00 00 00 02 15 6E
			39 00 00 00 00 00 02 16 02
			39 00 00 00 00 00 02 17 A7
			39 00 00 00 00 00 02 18 02
			39 00 00 00 00 00 02 19 CD
			39 00 00 00 00 00 02 1A 03
			39 00 00 00 00 00 02 1B 01
			39 00 00 00 00 00 02 1C 03
			39 00 00 00 00 00 02 1D 23
			39 00 00 00 00 00 02 1E 03
			39 00 00 00 00 00 02 1F 4D
			39 00 00 00 00 00 02 20 03
			39 00 00 00 00 00 02 21 63
			39 00 00 00 00 00 02 22 03
			39 00 00 00 00 00 02 23 70
			39 00 00 00 00 00 02 24 03
			39 00 00 00 00 00 02 25 77
			39 00 00 00 00 00 02 26 03
			39 00 00 00 00 00 02 27 8A
			39 00 00 00 00 00 02 28 03
			39 00 00 00 00 00 02 29 A1
			39 00 00 00 00 00 02 2A 03
			39 00 00 00 00 00 02 2B B9
			39 00 00 00 00 00 02 2D 03
			39 00 00 00 00 00 02 2F CB
			39 00 00 00 00 00 02 30 03
			39 00 00 00 00 00 02 31 CD
			//G(-) MCR cmd
			39 00 00 00 00 00 02 32 01
			39 00 00 00 00 00 02 33 56
			39 00 00 00 00 00 02 34 01
			39 00 00 00 00 00 02 35 59
			39 00 00 00 00 00 02 36 01
			39 00 00 00 00 00 02 37 5E
			39 00 00 00 00 00 02 38 01
			39 00 00 00 00 00 02 39 64
			39 00 00 00 00 00 02 3A 01
			39 00 00 00 00 00 02 3B 69
			39 00 00 00 00 00 02 3D 01
			39 00 00 00 00 00 02 3F 6E
			39 00 00 00 00 00 02 40 01
			39 00 00 00 00 00 02 41 73
			39 00 00 00 00 00 02 42 01
			39 00 00 00 00 00 02 43 78
			39 00 00 00 00 00 02 44 01
			39 00 00 00 00 00 02 45 7D
			39 00 00 00 00 00 02 46 01
			39 00 00 00 00 00 02 47 90
			39 00 00 00 00 00 02 48 01
			39 00 00 00 00 00 02 49 A1
			39 00 00 00 00 00 02 4A 01
			39 00 00 00 00 00 02 4B C1
			39 00 00 00 00 00 02 4C 01
			39 00 00 00 00 00 02 4D DD
			39 00 00 00 00 00 02 4E 02
			39 00 00 00 00 00 02 4F 0F
			39 00 00 00 00 00 02 50 02
			39 00 00 00 00 00 02 51 3D
			39 00 00 00 00 00 02 52 02
			39 00 00 00 00 00 02 53 3F
			39 00 00 00 00 00 02 54 02
			39 00 00 00 00 00 02 55 6E
			39 00 00 00 00 00 02 56 02
			39 00 00 00 00 00 02 58 A7
			39 00 00 00 00 00 02 59 02
			39 00 00 00 00 00 02 5A CD
			39 00 00 00 00 00 02 5B 03
			39 00 00 00 00 00 02 5C 01
			39 00 00 00 00 00 02 5D 03
			39 00 00 00 00 00 02 5E 23
			39 00 00 00 00 00 02 5F 03
			39 00 00 00 00 00 02 60 4D
			39 00 00 00 00 00 02 61 03
			39 00 00 00 00 00 02 62 63
			39 00 00 00 00 00 02 63 03
			39 00 00 00 00 00 02 64 70
			39 00 00 00 00 00 02 65 03
			39 00 00 00 00 00 02 66 77
			39 00 00 00 00 00 02 67 03
			39 00 00 00 00 00 02 68 8A
			39 00 00 00 00 00 02 69 03
			39 00 00 00 00 00 02 6A A1
			39 00 00 00 00 00 02 6B 03
			39 00 00 00 00 00 02 6C B9
			39 00 00 00 00 00 02 6D 03
			39 00 00 00 00 00 02 6E CB
			39 00 00 00 00 00 02 6F 03
			39 01 00 00 00 00 02 70 CD
			//B(+) MCR cmd
			39 00 00 00 00 00 02 71 01
			39 00 00 00 00 00 02 72 8F
			39 00 00 00 00 00 02 73 01
			39 00 00 00 00 00 02 74 91
			39 00 00 00 00 00 02 75 01
			39 00 00 00 00 00 02 76 95
			39 00 00 00 00 00 02 77 01
			39 00 00 00 00 00 02 78 99
			39 00 00 00 00 00 02 79 01
			39 00 00 00 00 00 02 7A 9D
			39 00 00 00 00 00 02 7B 01
			39 00 00 00 00 00 02 7C A1
			39 00 00 00 00 00 02 7D 01
			39 00 00 00 00 00 02 7E A5
			39 00 00 00 00 00 02 7F 01
			39 00 00 00 00 00 02 80 A8
			39 00 00 00 00 00 02 81 01
			39 00 00 00 00 00 02 82 AC
			39 00 00 00 00 00 02 83 01
			39 00 00 00 00 00 02 84 BA
			39 00 00 00 00 00 02 85 01
			39 00 00 00 00 00 02 86 C8
			39 00 00 00 00 00 02 87 01
			39 00 00 00 00 00 02 88 E2
			39 00 00 00 00 00 02 89 01
			39 00 00 00 00 00 02 8A F8
			39 00 00 00 00 00 02 8B 02
			39 00 00 00 00 00 02 8C 24
			39 00 00 00 00 00 02 8D 02
			39 00 00 00 00 00 02 8E 4E
			39 00 00 00 00 00 02 8F 02
			39 00 00 00 00 00 02 90 4F
			39 00 00 00 00 00 02 91 02
			39 00 00 00 00 00 02 92 7C
			39 00 00 00 00 00 02 93 02
			39 00 00 00 00 00 02 94 B6
			39 00 00 00 00 00 02 95 02
			39 00 00 00 00 00 02 96 E1
			39 00 00 00 00 00 02 97 03
			39 00 00 00 00 00 02 98 25
			39 00 00 00 00 00 02 99 03
			39 00 00 00 00 00 02 9A 37
			39 00 00 00 00 00 02 9B 03
			39 00 00 00 00 00 02 9C 49
			39 00 00 00 00 00 02 9D 03
			39 00 00 00 00 00 02 9E 4A
			39 00 00 00 00 00 02 9F 03
			39 00 00 00 00 00 02 A0 4B
			39 00 00 00 00 00 02 A2 03
			39 00 00 00 00 00 02 A3 4C
			39 00 00 00 00 00 02 A4 03
			39 00 00 00 00 00 02 A5 61
			39 00 00 00 00 00 02 A6 03
			39 00 00 00 00 00 02 A7 7C
			39 00 00 00 00 00 02 A9 03
			39 00 00 00 00 00 02 AA A2
			39 00 00 00 00 00 02 AB 03
			39 00 00 00 00 00 02 AC C7
			39 00 00 00 00 00 02 AD 03
			39 00 00 00 00 00 02 AE CD
			//B(-) MCR cmd
			39 00 00 00 00 00 02 AF 01
			39 00 00 00 00 00 02 B0 8F
			39 00 00 00 00 00 02 B1 01
			39 00 00 00 00 00 02 B2 91
			39 00 00 00 00 00 02 B3 01
			39 00 00 00 00 00 02 B4 95
			39 00 00 00 00 00 02 B5 01
			39 00 00 00 00 00 02 B6 99
			39 00 00 00 00 00 02 B7 01
			39 00 00 00 00 00 02 B8 9D
			39 00 00 00 00 00 02 B9 01
			39 00 00 00 00 00 02 BA A1
			39 00 00 00 00 00 02 BB 01
			39 00 00 00 00 00 02 BC A5
			39 00 00 00 00 00 02 BD 01
			39 00 00 00 00 00 02 BE A8
			39 00 00 00 00 00 02 BF 01
			39 00 00 00 00 00 02 C0 AC
			39 00 00 00 00 00 02 C1 01
			39 00 00 00 00 00 02 C2 BA
			39 00 00 00 00 00 02 C3 01
			39 00 00 00 00 00 02 C4 C8
			39 00 00 00 00 00 02 C5 01
			39 00 00 00 00 00 02 C6 E2
			39 00 00 00 00 00 02 C7 01
			39 00 00 00 00 00 02 C8 F8
			39 00 00 00 00 00 02 C9 02
			39 00 00 00 00 00 02 CA 24
			39 00 00 00 00 00 02 CB 02
			39 00 00 00 00 00 02 CC 4E
			39 00 00 00 00 00 02 CD 02
			39 00 00 00 00 00 02 CE 4F
			39 00 00 00 00 00 02 CF 02
			39 00 00 00 00 00 02 D0 7C
			39 00 00 00 00 00 02 D1 02
			39 00 00 00 00 00 02 D2 B6
			39 00 00 00 00 00 02 D3 02
			39 00 00 00 00 00 02 D4 E1
			39 00 00 00 00 00 02 D5 03
			39 00 00 00 00 00 02 D6 25
			39 00 00 00 00 00 02 D7 03
			39 00 00 00 00 00 02 D8 37
			39 00 00 00 00 00 02 D9 03
			39 00 00 00 00 00 02 DA 49
			39 00 00 00 00 00 02 DB 03
			39 00 00 00 00 00 02 DC 4A
			39 00 00 00 00 00 02 DD 03
			39 00 00 00 00 00 02 DE 4B
			39 00 00 00 00 00 02 DF 03
			39 00 00 00 00 00 02 E0 4C
			39 00 00 00 00 00 02 E1 03
			39 00 00 00 00 00 02 E2 61
			39 00 00 00 00 00 02 E3 03
			39 00 00 00 00 00 02 E4 7C
			39 00 00 00 00 00 02 E5 03
			39 00 00 00 00 00 02 E6 A2
			39 00 00 00 00 00 02 E7 03
			39 00 00 00 00 00 02 E8 C7
			39 00 00 00 00 00 02 E9 03
			39 01 00 00 00 00 02 EA CD
			39 01 00 00 00 00 02 FF 00
			39 01 00 00 00 00 02 55 B3];
	lenovo,lcd-effect-comfort-mode-command-state = "dsi_hs_mode";



	//lenovo,lcd-effect-outside-mode-command = [];
	//lenovo,lcd-effect-outside-mode-command-state = "dsi_lp_mode";

	lenovo,lcd-effect-ultra-mode-command = [
		//T6920 03070323
			//page selection cmd start
			39 01 00 00 00 00 02 FF 01
			39 00 00 00 00 00 02 FB 01
			//page selection cmd end
			//R(+) MCR cmd
			39 00 00 00 00 00 02 75 00
			39 00 00 00 00 00 02 76 01
			39 00 00 00 00 00 02 77 00
			39 00 00 00 00 00 02 78 22
			39 00 00 00 00 00 02 79 00
			39 00 00 00 00 00 02 7A 4C
			39 00 00 00 00 00 02 7B 00
			39 00 00 00 00 00 02 7C 6B
			39 00 00 00 00 00 02 7D 00
			39 00 00 00 00 00 02 7E 84
			39 00 00 00 00 00 02 7F 00
			39 00 00 00 00 00 02 80 98
			39 00 00 00 00 00 02 81 00
			39 00 00 00 00 00 02 82 AB
			39 00 00 00 00 00 02 83 00
			39 00 00 00 00 00 02 84 BB
			39 00 00 00 00 00 02 85 00
			39 00 00 00 00 00 02 86 C9
			39 00 00 00 00 00 02 87 00
			39 00 00 00 00 00 02 88 FA
			39 00 00 00 00 00 02 89 01
			39 00 00 00 00 00 02 8A 21
			39 00 00 00 00 00 02 8B 01
			39 00 00 00 00 00 02 8C 5E
			39 00 00 00 00 00 02 8D 01
			39 00 00 00 00 00 02 8E 8E
			39 00 00 00 00 00 02 8F 01
			39 00 00 00 00 00 02 90 DA
			39 00 00 00 00 00 02 91 02
			39 00 00 00 00 00 02 92 16
			39 00 00 00 00 00 02 93 02
			39 00 00 00 00 00 02 94 18
			39 00 00 00 00 00 02 95 02
			39 00 00 00 00 00 02 96 50
			39 00 00 00 00 00 02 97 02
			39 00 00 00 00 00 02 98 8D
			39 00 00 00 00 00 02 99 02
			39 00 00 00 00 00 02 9A B4
			39 00 00 00 00 00 02 9B 02
			39 00 00 00 00 00 02 9C E9
			39 00 00 00 00 00 02 9D 03
			39 00 00 00 00 00 02 9E 0C
			39 00 00 00 00 00 02 9F 03
			39 00 00 00 00 00 02 A0 3B
			39 00 00 00 00 00 02 A2 03
			39 00 00 00 00 00 02 A3 4A
			39 00 00 00 00 00 02 A4 03
			39 00 00 00 00 00 02 A5 5A
			39 00 00 00 00 00 02 A6 03
			39 00 00 00 00 00 02 A7 69
			39 00 00 00 00 00 02 A9 03
			39 00 00 00 00 00 02 AA 7A
			39 00 00 00 00 00 02 AB 03
			39 00 00 00 00 00 02 AC 91
			39 00 00 00 00 00 02 AD 03
			39 00 00 00 00 00 02 AE AD
			39 00 00 00 00 00 02 AF 03
			39 00 00 00 00 00 02 B0 C9
			39 00 00 00 00 00 02 B1 03
			39 00 00 00 00 00 02 B2 CD
			//R(-) MCR cmd
			39 00 00 00 00 00 02 B3 00
			39 00 00 00 00 00 02 B4 01
			39 00 00 00 00 00 02 B5 00
			39 00 00 00 00 00 02 B6 22
			39 00 00 00 00 00 02 B7 00
			39 00 00 00 00 00 02 B8 4C
			39 00 00 00 00 00 02 B9 00
			39 00 00 00 00 00 02 BA 6B
			39 00 00 00 00 00 02 BB 00
			39 00 00 00 00 00 02 BC 84
			39 00 00 00 00 00 02 BD 00
			39 00 00 00 00 00 02 BE 98
			39 00 00 00 00 00 02 BF 00
			39 00 00 00 00 00 02 C0 AB
			39 00 00 00 00 00 02 C1 00
			39 00 00 00 00 00 02 C2 BB
			39 00 00 00 00 00 02 C3 00
			39 00 00 00 00 00 02 C4 C9
			39 00 00 00 00 00 02 C5 00
			39 00 00 00 00 00 02 C6 FA
			39 00 00 00 00 00 02 C7 01
			39 00 00 00 00 00 02 C8 21
			39 00 00 00 00 00 02 C9 01
			39 00 00 00 00 00 02 CA 5E
			39 00 00 00 00 00 02 CB 01
			39 00 00 00 00 00 02 CC 8E
			39 00 00 00 00 00 02 CD 01
			39 00 00 00 00 00 02 CE DA
			39 00 00 00 00 00 02 CF 02
			39 00 00 00 00 00 02 D0 16
			39 00 00 00 00 00 02 D1 02
			39 00 00 00 00 00 02 D2 18
			39 00 00 00 00 00 02 D3 02
			39 00 00 00 00 00 02 D4 50
			39 00 00 00 00 00 02 D5 02
			39 00 00 00 00 00 02 D6 8D
			39 00 00 00 00 00 02 D7 02
			39 00 00 00 00 00 02 D8 B4
			39 00 00 00 00 00 02 D9 02
			39 00 00 00 00 00 02 DA E9
			39 00 00 00 00 00 02 DB 03
			39 00 00 00 00 00 02 DC 0C
			39 00 00 00 00 00 02 DD 03
			39 00 00 00 00 00 02 DE 3B
			39 00 00 00 00 00 02 DF 03
			39 00 00 00 00 00 02 E0 4A
			39 00 00 00 00 00 02 E1 03
			39 00 00 00 00 00 02 E2 5A
			39 00 00 00 00 00 02 E3 03
			39 00 00 00 00 00 02 E4 69
			39 00 00 00 00 00 02 E5 03
			39 00 00 00 00 00 02 E6 7A
			39 00 00 00 00 00 02 E7 03
			39 00 00 00 00 00 02 E8 91
			39 00 00 00 00 00 02 E9 03
			39 00 00 00 00 00 02 EA AD
			39 00 00 00 00 00 02 EB 03
			39 00 00 00 00 00 02 EC C9
			39 00 00 00 00 00 02 ED 03
			39 01 00 00 00 00 02 EE CD
			//G(+) MCR cmd
			39 00 00 00 00 00 02 EF 00
			39 00 00 00 00 00 02 F0 F1
			39 00 00 00 00 00 02 F1 00
			39 00 00 00 00 00 02 F2 F6
			39 00 00 00 00 00 02 F3 01
			39 00 00 00 00 00 02 F4 00
			39 00 00 00 00 00 02 F5 01
			39 00 00 00 00 00 02 F6 09
			39 00 00 00 00 00 02 F7 01
			39 00 00 00 00 00 02 F8 12
			39 00 00 00 00 00 02 F9 01
			39 00 00 00 00 00 02 FA 1A
			//page selection cmd start
			39 00 00 00 00 00 02 FF 02
			//page selection cmd end
			09 00 00 00 00 00 02 00 00
			09 00 00 00 00 00 02 00 00
			09 00 00 00 00 00 02 00 00
			39 00 00 00 00 00 02 FB 01
			39 00 00 00 00 00 02 00 01
			39 00 00 00 00 00 02 01 22
			39 00 00 00 00 00 02 02 01
			39 00 00 00 00 00 02 03 2A
			39 00 00 00 00 00 02 04 01
			39 00 00 00 00 00 02 05 32
			39 00 00 00 00 00 02 06 01
			39 00 00 00 00 00 02 07 4D
			39 00 00 00 00 00 02 08 01
			39 00 00 00 00 00 02 09 66
			39 00 00 00 00 00 02 0A 01
			39 00 00 00 00 00 02 0B 92
			39 00 00 00 00 00 02 0C 01
			39 00 00 00 00 00 02 0D B6
			39 00 00 00 00 00 02 0E 01
			39 00 00 00 00 00 02 0F F4
			39 00 00 00 00 00 02 10 02
			39 00 00 00 00 00 02 11 2A
			39 00 00 00 00 00 02 12 02
			39 00 00 00 00 00 02 13 2B
			39 00 00 00 00 00 02 14 02
			39 00 00 00 00 00 02 15 5E
			39 00 00 00 00 00 02 16 02
			39 00 00 00 00 00 02 17 99
			39 00 00 00 00 00 02 18 02
			39 00 00 00 00 00 02 19 BF
			39 00 00 00 00 00 02 1A 02
			39 00 00 00 00 00 02 1B F5
			39 00 00 00 00 00 02 1C 03
			39 00 00 00 00 00 02 1D 16
			39 00 00 00 00 00 02 1E 03
			39 00 00 00 00 00 02 1F 43
			39 00 00 00 00 00 02 20 03
			39 00 00 00 00 00 02 21 55
			39 00 00 00 00 00 02 22 03
			39 00 00 00 00 00 02 23 66
			39 00 00 00 00 00 02 24 03
			39 00 00 00 00 00 02 25 71
			39 00 00 00 00 00 02 26 03
			39 00 00 00 00 00 02 27 82
			39 00 00 00 00 00 02 28 03
			39 00 00 00 00 00 02 29 9A
			39 00 00 00 00 00 02 2A 03
			39 00 00 00 00 00 02 2B B5
			39 00 00 00 00 00 02 2D 03
			39 00 00 00 00 00 02 2F CA
			39 00 00 00 00 00 02 30 03
			39 00 00 00 00 00 02 31 CD
			//G(-) MCR cmd
			39 00 00 00 00 00 02 32 00
			39 00 00 00 00 00 02 33 F1
			39 00 00 00 00 00 02 34 00
			39 00 00 00 00 00 02 35 F6
			39 00 00 00 00 00 02 36 01
			39 00 00 00 00 00 02 37 00
			39 00 00 00 00 00 02 38 01
			39 00 00 00 00 00 02 39 09
			39 00 00 00 00 00 02 3A 01
			39 00 00 00 00 00 02 3B 12
			39 00 00 00 00 00 02 3D 01
			39 00 00 00 00 00 02 3F 1A
			39 00 00 00 00 00 02 40 01
			39 00 00 00 00 00 02 41 22
			39 00 00 00 00 00 02 42 01
			39 00 00 00 00 00 02 43 2A
			39 00 00 00 00 00 02 44 01
			39 00 00 00 00 00 02 45 32
			39 00 00 00 00 00 02 46 01
			39 00 00 00 00 00 02 47 4D
			39 00 00 00 00 00 02 48 01
			39 00 00 00 00 00 02 49 66
			39 00 00 00 00 00 02 4A 01
			39 00 00 00 00 00 02 4B 92
			39 00 00 00 00 00 02 4C 01
			39 00 00 00 00 00 02 4D B6
			39 00 00 00 00 00 02 4E 01
			39 00 00 00 00 00 02 4F F4
			39 00 00 00 00 00 02 50 02
			39 00 00 00 00 00 02 51 2A
			39 00 00 00 00 00 02 52 02
			39 00 00 00 00 00 02 53 2B
			39 00 00 00 00 00 02 54 02
			39 00 00 00 00 00 02 55 5E
			39 00 00 00 00 00 02 56 02
			39 00 00 00 00 00 02 58 99
			39 00 00 00 00 00 02 59 02
			39 00 00 00 00 00 02 5A BF
			39 00 00 00 00 00 02 5B 02
			39 00 00 00 00 00 02 5C F5
			39 00 00 00 00 00 02 5D 03
			39 00 00 00 00 00 02 5E 16
			39 00 00 00 00 00 02 5F 03
			39 00 00 00 00 00 02 60 43
			39 00 00 00 00 00 02 61 03
			39 00 00 00 00 00 02 62 55
			39 00 00 00 00 00 02 63 03
			39 00 00 00 00 00 02 64 66
			39 00 00 00 00 00 02 65 03
			39 00 00 00 00 00 02 66 71
			39 00 00 00 00 00 02 67 03
			39 00 00 00 00 00 02 68 82
			39 00 00 00 00 00 02 69 03
			39 00 00 00 00 00 02 6A 9A
			39 00 00 00 00 00 02 6B 03
			39 00 00 00 00 00 02 6C B5
			39 00 00 00 00 00 02 6D 03
			39 00 00 00 00 00 02 6E CA
			39 00 00 00 00 00 02 6F 03
			39 01 00 00 00 00 02 70 CD
			//B(+) MCR cmd
			39 00 00 00 00 00 02 71 00
			39 00 00 00 00 00 02 72 AC
			39 00 00 00 00 00 02 73 00
			39 00 00 00 00 00 02 74 B3
			39 00 00 00 00 00 02 75 00
			39 00 00 00 00 00 02 76 C0
			39 00 00 00 00 00 02 77 00
			39 00 00 00 00 00 02 78 CC
			39 00 00 00 00 00 02 79 00
			39 00 00 00 00 00 02 7A D8
			39 00 00 00 00 00 02 7B 00
			39 00 00 00 00 00 02 7C E2
			39 00 00 00 00 00 02 7D 00
			39 00 00 00 00 00 02 7E EC
			39 00 00 00 00 00 02 7F 00
			39 00 00 00 00 00 02 80 F6
			39 00 00 00 00 00 02 81 01
			39 00 00 00 00 00 02 82 00
			39 00 00 00 00 00 02 83 01
			39 00 00 00 00 00 02 84 21
			39 00 00 00 00 00 02 85 01
			39 00 00 00 00 00 02 86 3F
			39 00 00 00 00 00 02 87 01
			39 00 00 00 00 00 02 88 73
			39 00 00 00 00 00 02 89 01
			39 00 00 00 00 00 02 8A 9C
			39 00 00 00 00 00 02 8B 01
			39 00 00 00 00 00 02 8C E3
			39 00 00 00 00 00 02 8D 02
			39 00 00 00 00 00 02 8E 1E
			39 00 00 00 00 00 02 8F 02
			39 00 00 00 00 00 02 90 1F
			39 00 00 00 00 00 02 91 02
			39 00 00 00 00 00 02 92 55
			39 00 00 00 00 00 02 93 02
			39 00 00 00 00 00 02 94 92
			39 00 00 00 00 00 02 95 02
			39 00 00 00 00 00 02 96 BA
			39 00 00 00 00 00 02 97 02
			39 00 00 00 00 00 02 98 F6
			39 00 00 00 00 00 02 99 03
			39 00 00 00 00 00 02 9A 26
			39 00 00 00 00 00 02 9B 03
			39 00 00 00 00 00 02 9C 4B
			39 00 00 00 00 00 02 9D 03
			39 00 00 00 00 00 02 9E 4C
			39 00 00 00 00 00 02 9F 03
			39 00 00 00 00 00 02 A0 4D
			39 00 00 00 00 00 02 A2 03
			39 00 00 00 00 00 02 A3 4E
			39 00 00 00 00 00 02 A4 03
			39 00 00 00 00 00 02 A5 5D
			39 00 00 00 00 00 02 A6 03
			39 00 00 00 00 00 02 A7 7B
			39 00 00 00 00 00 02 A9 03
			39 00 00 00 00 00 02 AA A0
			39 00 00 00 00 00 02 AB 03
			39 00 00 00 00 00 02 AC C5
			39 00 00 00 00 00 02 AD 03
			39 00 00 00 00 00 02 AE CD
			//B(-) MCR cmd
			39 00 00 00 00 00 02 AF 00
			39 00 00 00 00 00 02 B0 AC
			39 00 00 00 00 00 02 B1 00
			39 00 00 00 00 00 02 B2 B3
			39 00 00 00 00 00 02 B3 00
			39 00 00 00 00 00 02 B4 C0
			39 00 00 00 00 00 02 B5 00
			39 00 00 00 00 00 02 B6 CC
			39 00 00 00 00 00 02 B7 00
			39 00 00 00 00 00 02 B8 D8
			39 00 00 00 00 00 02 B9 00
			39 00 00 00 00 00 02 BA E2
			39 00 00 00 00 00 02 BB 00
			39 00 00 00 00 00 02 BC EC
			39 00 00 00 00 00 02 BD 00
			39 00 00 00 00 00 02 BE F6
			39 00 00 00 00 00 02 BF 01
			39 00 00 00 00 00 02 C0 00
			39 00 00 00 00 00 02 C1 01
			39 00 00 00 00 00 02 C2 21
			39 00 00 00 00 00 02 C3 01
			39 00 00 00 00 00 02 C4 3F
			39 00 00 00 00 00 02 C5 01
			39 00 00 00 00 00 02 C6 73
			39 00 00 00 00 00 02 C7 01
			39 00 00 00 00 00 02 C8 9C
			39 00 00 00 00 00 02 C9 01
			39 00 00 00 00 00 02 CA E3
			39 00 00 00 00 00 02 CB 02
			39 00 00 00 00 00 02 CC 1E
			39 00 00 00 00 00 02 CD 02
			39 00 00 00 00 00 02 CE 1F
			39 00 00 00 00 00 02 CF 02
			39 00 00 00 00 00 02 D0 55
			39 00 00 00 00 00 02 D1 02
			39 00 00 00 00 00 02 D2 92
			39 00 00 00 00 00 02 D3 02
			39 00 00 00 00 00 02 D4 BA
			39 00 00 00 00 00 02 D5 02
			39 00 00 00 00 00 02 D6 F6
			39 00 00 00 00 00 02 D7 03
			39 00 00 00 00 00 02 D8 26
			39 00 00 00 00 00 02 D9 03
			39 00 00 00 00 00 02 DA 4B
			39 00 00 00 00 00 02 DB 03
			39 00 00 00 00 00 02 DC 4C
			39 00 00 00 00 00 02 DD 03
			39 00 00 00 00 00 02 DE 4D
			39 00 00 00 00 00 02 DF 03
			39 00 00 00 00 00 02 E0 4E
			39 00 00 00 00 00 02 E1 03
			39 00 00 00 00 00 02 E2 5D
			39 00 00 00 00 00 02 E3 03
			39 00 00 00 00 00 02 E4 7B
			39 00 00 00 00 00 02 E5 03
			39 00 00 00 00 00 02 E6 A0
			39 00 00 00 00 00 02 E7 03
			39 00 00 00 00 00 02 E8 C5
			39 00 00 00 00 00 02 E9 03
			39 01 00 00 00 00 02 EA CD
			39 01 00 00 00 00 02 FF 00
			39 01 00 00 00 00 02 55 B3];
	lenovo,lcd-effect-ultra-mode-command-state = "dsi_hs_mode";

	lenovo,lcd-effect-camera-mode-command = [
		//T6920 03070323
			//page selection cmd start
			39 01 00 00 00 00 02 FF 01
			39 00 00 00 00 00 02 FB 01
			//page selection cmd end
			//R(+) MCR cmd
			39 00 00 00 00 00 02 75 00
			39 00 00 00 00 00 02 76 01
			39 00 00 00 00 00 02 77 00
			39 00 00 00 00 00 02 78 22
			39 00 00 00 00 00 02 79 00
			39 00 00 00 00 00 02 7A 4C
			39 00 00 00 00 00 02 7B 00
			39 00 00 00 00 00 02 7C 6B
			39 00 00 00 00 00 02 7D 00
			39 00 00 00 00 00 02 7E 84
			39 00 00 00 00 00 02 7F 00
			39 00 00 00 00 00 02 80 98
			39 00 00 00 00 00 02 81 00
			39 00 00 00 00 00 02 82 AB
			39 00 00 00 00 00 02 83 00
			39 00 00 00 00 00 02 84 BB
			39 00 00 00 00 00 02 85 00
			39 00 00 00 00 00 02 86 C9
			39 00 00 00 00 00 02 87 00
			39 00 00 00 00 00 02 88 FA
			39 00 00 00 00 00 02 89 01
			39 00 00 00 00 00 02 8A 21
			39 00 00 00 00 00 02 8B 01
			39 00 00 00 00 00 02 8C 5E
			39 00 00 00 00 00 02 8D 01
			39 00 00 00 00 00 02 8E 8E
			39 00 00 00 00 00 02 8F 01
			39 00 00 00 00 00 02 90 DA
			39 00 00 00 00 00 02 91 02
			39 00 00 00 00 00 02 92 16
			39 00 00 00 00 00 02 93 02
			39 00 00 00 00 00 02 94 18
			39 00 00 00 00 00 02 95 02
			39 00 00 00 00 00 02 96 50
			39 00 00 00 00 00 02 97 02
			39 00 00 00 00 00 02 98 8D
			39 00 00 00 00 00 02 99 02
			39 00 00 00 00 00 02 9A B4
			39 00 00 00 00 00 02 9B 02
			39 00 00 00 00 00 02 9C E9
			39 00 00 00 00 00 02 9D 03
			39 00 00 00 00 00 02 9E 0C
			39 00 00 00 00 00 02 9F 03
			39 00 00 00 00 00 02 A0 3B
			39 00 00 00 00 00 02 A2 03
			39 00 00 00 00 00 02 A3 4A
			39 00 00 00 00 00 02 A4 03
			39 00 00 00 00 00 02 A5 5A
			39 00 00 00 00 00 02 A6 03
			39 00 00 00 00 00 02 A7 69
			39 00 00 00 00 00 02 A9 03
			39 00 00 00 00 00 02 AA 7A
			39 00 00 00 00 00 02 AB 03
			39 00 00 00 00 00 02 AC 91
			39 00 00 00 00 00 02 AD 03
			39 00 00 00 00 00 02 AE AD
			39 00 00 00 00 00 02 AF 03
			39 00 00 00 00 00 02 B0 C9
			39 00 00 00 00 00 02 B1 03
			39 00 00 00 00 00 02 B2 CD
			//R(-) MCR cmd
			39 00 00 00 00 00 02 B3 00
			39 00 00 00 00 00 02 B4 01
			39 00 00 00 00 00 02 B5 00
			39 00 00 00 00 00 02 B6 22
			39 00 00 00 00 00 02 B7 00
			39 00 00 00 00 00 02 B8 4C
			39 00 00 00 00 00 02 B9 00
			39 00 00 00 00 00 02 BA 6B
			39 00 00 00 00 00 02 BB 00
			39 00 00 00 00 00 02 BC 84
			39 00 00 00 00 00 02 BD 00
			39 00 00 00 00 00 02 BE 98
			39 00 00 00 00 00 02 BF 00
			39 00 00 00 00 00 02 C0 AB
			39 00 00 00 00 00 02 C1 00
			39 00 00 00 00 00 02 C2 BB
			39 00 00 00 00 00 02 C3 00
			39 00 00 00 00 00 02 C4 C9
			39 00 00 00 00 00 02 C5 00
			39 00 00 00 00 00 02 C6 FA
			39 00 00 00 00 00 02 C7 01
			39 00 00 00 00 00 02 C8 21
			39 00 00 00 00 00 02 C9 01
			39 00 00 00 00 00 02 CA 5E
			39 00 00 00 00 00 02 CB 01
			39 00 00 00 00 00 02 CC 8E
			39 00 00 00 00 00 02 CD 01
			39 00 00 00 00 00 02 CE DA
			39 00 00 00 00 00 02 CF 02
			39 00 00 00 00 00 02 D0 16
			39 00 00 00 00 00 02 D1 02
			39 00 00 00 00 00 02 D2 18
			39 00 00 00 00 00 02 D3 02
			39 00 00 00 00 00 02 D4 50
			39 00 00 00 00 00 02 D5 02
			39 00 00 00 00 00 02 D6 8D
			39 00 00 00 00 00 02 D7 02
			39 00 00 00 00 00 02 D8 B4
			39 00 00 00 00 00 02 D9 02
			39 00 00 00 00 00 02 DA E9
			39 00 00 00 00 00 02 DB 03
			39 00 00 00 00 00 02 DC 0C
			39 00 00 00 00 00 02 DD 03
			39 00 00 00 00 00 02 DE 3B
			39 00 00 00 00 00 02 DF 03
			39 00 00 00 00 00 02 E0 4A
			39 00 00 00 00 00 02 E1 03
			39 00 00 00 00 00 02 E2 5A
			39 00 00 00 00 00 02 E3 03
			39 00 00 00 00 00 02 E4 69
			39 00 00 00 00 00 02 E5 03
			39 00 00 00 00 00 02 E6 7A
			39 00 00 00 00 00 02 E7 03
			39 00 00 00 00 00 02 E8 91
			39 00 00 00 00 00 02 E9 03
			39 00 00 00 00 00 02 EA AD
			39 00 00 00 00 00 02 EB 03
			39 00 00 00 00 00 02 EC C9
			39 00 00 00 00 00 02 ED 03
			39 01 00 00 00 00 02 EE CD
			//G(+) MCR cmd
			39 00 00 00 00 00 02 EF 00
			39 00 00 00 00 00 02 F0 F1
			39 00 00 00 00 00 02 F1 00
			39 00 00 00 00 00 02 F2 F6
			39 00 00 00 00 00 02 F3 01
			39 00 00 00 00 00 02 F4 00
			39 00 00 00 00 00 02 F5 01
			39 00 00 00 00 00 02 F6 09
			39 00 00 00 00 00 02 F7 01
			39 00 00 00 00 00 02 F8 12
			39 00 00 00 00 00 02 F9 01
			39 00 00 00 00 00 02 FA 1A
			//page selection cmd start
			39 00 00 00 00 00 02 FF 02
			//page selection cmd end
			09 00 00 00 00 00 02 00 00
			09 00 00 00 00 00 02 00 00
			09 00 00 00 00 00 02 00 00
			39 00 00 00 00 00 02 FB 01
			39 00 00 00 00 00 02 00 01
			39 00 00 00 00 00 02 01 22
			39 00 00 00 00 00 02 02 01
			39 00 00 00 00 00 02 03 2A
			39 00 00 00 00 00 02 04 01
			39 00 00 00 00 00 02 05 32
			39 00 00 00 00 00 02 06 01
			39 00 00 00 00 00 02 07 4D
			39 00 00 00 00 00 02 08 01
			39 00 00 00 00 00 02 09 66
			39 00 00 00 00 00 02 0A 01
			39 00 00 00 00 00 02 0B 92
			39 00 00 00 00 00 02 0C 01
			39 00 00 00 00 00 02 0D B6
			39 00 00 00 00 00 02 0E 01
			39 00 00 00 00 00 02 0F F4
			39 00 00 00 00 00 02 10 02
			39 00 00 00 00 00 02 11 2A
			39 00 00 00 00 00 02 12 02
			39 00 00 00 00 00 02 13 2B
			39 00 00 00 00 00 02 14 02
			39 00 00 00 00 00 02 15 5E
			39 00 00 00 00 00 02 16 02
			39 00 00 00 00 00 02 17 99
			39 00 00 00 00 00 02 18 02
			39 00 00 00 00 00 02 19 BF
			39 00 00 00 00 00 02 1A 02
			39 00 00 00 00 00 02 1B F5
			39 00 00 00 00 00 02 1C 03
			39 00 00 00 00 00 02 1D 16
			39 00 00 00 00 00 02 1E 03
			39 00 00 00 00 00 02 1F 43
			39 00 00 00 00 00 02 20 03
			39 00 00 00 00 00 02 21 55
			39 00 00 00 00 00 02 22 03
			39 00 00 00 00 00 02 23 66
			39 00 00 00 00 00 02 24 03
			39 00 00 00 00 00 02 25 71
			39 00 00 00 00 00 02 26 03
			39 00 00 00 00 00 02 27 82
			39 00 00 00 00 00 02 28 03
			39 00 00 00 00 00 02 29 9A
			39 00 00 00 00 00 02 2A 03
			39 00 00 00 00 00 02 2B B5
			39 00 00 00 00 00 02 2D 03
			39 00 00 00 00 00 02 2F CA
			39 00 00 00 00 00 02 30 03
			39 00 00 00 00 00 02 31 CD
			//G(-) MCR cmd
			39 00 00 00 00 00 02 32 00
			39 00 00 00 00 00 02 33 F1
			39 00 00 00 00 00 02 34 00
			39 00 00 00 00 00 02 35 F6
			39 00 00 00 00 00 02 36 01
			39 00 00 00 00 00 02 37 00
			39 00 00 00 00 00 02 38 01
			39 00 00 00 00 00 02 39 09
			39 00 00 00 00 00 02 3A 01
			39 00 00 00 00 00 02 3B 12
			39 00 00 00 00 00 02 3D 01
			39 00 00 00 00 00 02 3F 1A
			39 00 00 00 00 00 02 40 01
			39 00 00 00 00 00 02 41 22
			39 00 00 00 00 00 02 42 01
			39 00 00 00 00 00 02 43 2A
			39 00 00 00 00 00 02 44 01
			39 00 00 00 00 00 02 45 32
			39 00 00 00 00 00 02 46 01
			39 00 00 00 00 00 02 47 4D
			39 00 00 00 00 00 02 48 01
			39 00 00 00 00 00 02 49 66
			39 00 00 00 00 00 02 4A 01
			39 00 00 00 00 00 02 4B 92
			39 00 00 00 00 00 02 4C 01
			39 00 00 00 00 00 02 4D B6
			39 00 00 00 00 00 02 4E 01
			39 00 00 00 00 00 02 4F F4
			39 00 00 00 00 00 02 50 02
			39 00 00 00 00 00 02 51 2A
			39 00 00 00 00 00 02 52 02
			39 00 00 00 00 00 02 53 2B
			39 00 00 00 00 00 02 54 02
			39 00 00 00 00 00 02 55 5E
			39 00 00 00 00 00 02 56 02
			39 00 00 00 00 00 02 58 99
			39 00 00 00 00 00 02 59 02
			39 00 00 00 00 00 02 5A BF
			39 00 00 00 00 00 02 5B 02
			39 00 00 00 00 00 02 5C F5
			39 00 00 00 00 00 02 5D 03
			39 00 00 00 00 00 02 5E 16
			39 00 00 00 00 00 02 5F 03
			39 00 00 00 00 00 02 60 43
			39 00 00 00 00 00 02 61 03
			39 00 00 00 00 00 02 62 55
			39 00 00 00 00 00 02 63 03
			39 00 00 00 00 00 02 64 66
			39 00 00 00 00 00 02 65 03
			39 00 00 00 00 00 02 66 71
			39 00 00 00 00 00 02 67 03
			39 00 00 00 00 00 02 68 82
			39 00 00 00 00 00 02 69 03
			39 00 00 00 00 00 02 6A 9A
			39 00 00 00 00 00 02 6B 03
			39 00 00 00 00 00 02 6C B5
			39 00 00 00 00 00 02 6D 03
			39 00 00 00 00 00 02 6E CA
			39 00 00 00 00 00 02 6F 03
			39 01 00 00 00 00 02 70 CD
			//B(+) MCR cmd
			39 00 00 00 00 00 02 71 00
			39 00 00 00 00 00 02 72 AC
			39 00 00 00 00 00 02 73 00
			39 00 00 00 00 00 02 74 B3
			39 00 00 00 00 00 02 75 00
			39 00 00 00 00 00 02 76 C0
			39 00 00 00 00 00 02 77 00
			39 00 00 00 00 00 02 78 CC
			39 00 00 00 00 00 02 79 00
			39 00 00 00 00 00 02 7A D8
			39 00 00 00 00 00 02 7B 00
			39 00 00 00 00 00 02 7C E2
			39 00 00 00 00 00 02 7D 00
			39 00 00 00 00 00 02 7E EC
			39 00 00 00 00 00 02 7F 00
			39 00 00 00 00 00 02 80 F6
			39 00 00 00 00 00 02 81 01
			39 00 00 00 00 00 02 82 00
			39 00 00 00 00 00 02 83 01
			39 00 00 00 00 00 02 84 21
			39 00 00 00 00 00 02 85 01
			39 00 00 00 00 00 02 86 3F
			39 00 00 00 00 00 02 87 01
			39 00 00 00 00 00 02 88 73
			39 00 00 00 00 00 02 89 01
			39 00 00 00 00 00 02 8A 9C
			39 00 00 00 00 00 02 8B 01
			39 00 00 00 00 00 02 8C E3
			39 00 00 00 00 00 02 8D 02
			39 00 00 00 00 00 02 8E 1E
			39 00 00 00 00 00 02 8F 02
			39 00 00 00 00 00 02 90 1F
			39 00 00 00 00 00 02 91 02
			39 00 00 00 00 00 02 92 55
			39 00 00 00 00 00 02 93 02
			39 00 00 00 00 00 02 94 92
			39 00 00 00 00 00 02 95 02
			39 00 00 00 00 00 02 96 BA
			39 00 00 00 00 00 02 97 02
			39 00 00 00 00 00 02 98 F6
			39 00 00 00 00 00 02 99 03
			39 00 00 00 00 00 02 9A 26
			39 00 00 00 00 00 02 9B 03
			39 00 00 00 00 00 02 9C 4B
			39 00 00 00 00 00 02 9D 03
			39 00 00 00 00 00 02 9E 4C
			39 00 00 00 00 00 02 9F 03
			39 00 00 00 00 00 02 A0 4D
			39 00 00 00 00 00 02 A2 03
			39 00 00 00 00 00 02 A3 4E
			39 00 00 00 00 00 02 A4 03
			39 00 00 00 00 00 02 A5 5D
			39 00 00 00 00 00 02 A6 03
			39 00 00 00 00 00 02 A7 7B
			39 00 00 00 00 00 02 A9 03
			39 00 00 00 00 00 02 AA A0
			39 00 00 00 00 00 02 AB 03
			39 00 00 00 00 00 02 AC C5
			39 00 00 00 00 00 02 AD 03
			39 00 00 00 00 00 02 AE CD
			//B(-) MCR cmd
			39 00 00 00 00 00 02 AF 00
			39 00 00 00 00 00 02 B0 AC
			39 00 00 00 00 00 02 B1 00
			39 00 00 00 00 00 02 B2 B3
			39 00 00 00 00 00 02 B3 00
			39 00 00 00 00 00 02 B4 C0
			39 00 00 00 00 00 02 B5 00
			39 00 00 00 00 00 02 B6 CC
			39 00 00 00 00 00 02 B7 00
			39 00 00 00 00 00 02 B8 D8
			39 00 00 00 00 00 02 B9 00
			39 00 00 00 00 00 02 BA E2
			39 00 00 00 00 00 02 BB 00
			39 00 00 00 00 00 02 BC EC
			39 00 00 00 00 00 02 BD 00
			39 00 00 00 00 00 02 BE F6
			39 00 00 00 00 00 02 BF 01
			39 00 00 00 00 00 02 C0 00
			39 00 00 00 00 00 02 C1 01
			39 00 00 00 00 00 02 C2 21
			39 00 00 00 00 00 02 C3 01
			39 00 00 00 00 00 02 C4 3F
			39 00 00 00 00 00 02 C5 01
			39 00 00 00 00 00 02 C6 73
			39 00 00 00 00 00 02 C7 01
			39 00 00 00 00 00 02 C8 9C
			39 00 00 00 00 00 02 C9 01
			39 00 00 00 00 00 02 CA E3
			39 00 00 00 00 00 02 CB 02
			39 00 00 00 00 00 02 CC 1E
			39 00 00 00 00 00 02 CD 02
			39 00 00 00 00 00 02 CE 1F
			39 00 00 00 00 00 02 CF 02
			39 00 00 00 00 00 02 D0 55
			39 00 00 00 00 00 02 D1 02
			39 00 00 00 00 00 02 D2 92
			39 00 00 00 00 00 02 D3 02
			39 00 00 00 00 00 02 D4 BA
			39 00 00 00 00 00 02 D5 02
			39 00 00 00 00 00 02 D6 F6
			39 00 00 00 00 00 02 D7 03
			39 00 00 00 00 00 02 D8 26
			39 00 00 00 00 00 02 D9 03
			39 00 00 00 00 00 02 DA 4B
			39 00 00 00 00 00 02 DB 03
			39 00 00 00 00 00 02 DC 4C
			39 00 00 00 00 00 02 DD 03
			39 00 00 00 00 00 02 DE 4D
			39 00 00 00 00 00 02 DF 03
			39 00 00 00 00 00 02 E0 4E
			39 00 00 00 00 00 02 E1 03
			39 00 00 00 00 00 02 E2 5D
			39 00 00 00 00 00 02 E3 03
			39 00 00 00 00 00 02 E4 7B
			39 00 00 00 00 00 02 E5 03
			39 00 00 00 00 00 02 E6 A0
			39 00 00 00 00 00 02 E7 03
			39 00 00 00 00 00 02 E8 C5
			39 00 00 00 00 00 02 E9 03
			39 01 00 00 00 00 02 EA CD
			39 01 00 00 00 00 02 FF 00
			39 01 00 00 00 00 02 55 00];
	lenovo,lcd-effect-camera-mode-command-state = "dsi_hs_mode";

};

