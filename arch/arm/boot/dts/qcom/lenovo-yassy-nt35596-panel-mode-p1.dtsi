

&dsi_nt35596_yassy_1080p_video {

	lenovo,lcd-effect-custom-mode-command = [
		//T7190 0.3022 0.3220
		//page selection cmd start 1
		39 01 00 00 00 00 02 FF 01
		39 00 00 00 00 00 02 FB 01
		//page selection cmd end
		//R(+) MCR cmd
		39 00 00 00 00 00 02 75 00
		39 00 00 00 00 00 02 76 00
		39 00 00 00 00 00 02 77 00
		39 00 00 00 00 00 02 78 1B
		39 00 00 00 00 00 02 79 00
		39 00 00 00 00 00 02 7A 47
		39 00 00 00 00 00 02 7B 00
		39 00 00 00 00 00 02 7C 68
		39 00 00 00 00 00 02 7D 00
		39 00 00 00 00 00 02 7E 82
		39 00 00 00 00 00 02 7F 00
		39 00 00 00 00 00 02 80 99
		39 00 00 00 00 00 02 81 00
		39 00 00 00 00 00 02 82 AE
		39 00 00 00 00 00 02 83 00
		39 00 00 00 00 00 02 84 BF
		39 00 00 00 00 00 02 85 00
		39 00 00 00 00 00 02 86 D0
		39 00 00 00 00 00 02 87 01
		39 00 00 00 00 00 02 88 05
		39 00 00 00 00 00 02 89 01
		39 00 00 00 00 00 02 8A 2F
		39 00 00 00 00 00 02 8B 01
		39 00 00 00 00 00 02 8C 70
		39 00 00 00 00 00 02 8D 01
		39 00 00 00 00 00 02 8E A3
		39 00 00 00 00 00 02 8F 01
		39 00 00 00 00 00 02 90 F2
		39 00 00 00 00 00 02 91 02
		39 00 00 00 00 00 02 92 2D
		39 00 00 00 00 00 02 93 02
		39 00 00 00 00 00 02 94 2F
		39 00 00 00 00 00 02 95 02
		39 00 00 00 00 00 02 96 63
		39 00 00 00 00 00 02 97 02
		39 00 00 00 00 00 02 98 99
		39 00 00 00 00 00 02 99 02
		39 00 00 00 00 00 02 9A BA
		39 00 00 00 00 00 02 9B 02
		39 00 00 00 00 00 02 9C E9
		39 00 00 00 00 00 02 9D 03
		39 00 00 00 00 00 02 9E 09
		39 00 00 00 00 00 02 9F 03
		39 00 00 00 00 00 02 A0 34
		39 00 00 00 00 00 02 A2 03
		39 00 00 00 00 00 02 A3 41
		39 00 00 00 00 00 02 A4 03
		39 00 00 00 00 00 02 A5 50
		39 00 00 00 00 00 02 A6 03
		39 00 00 00 00 00 02 A7 60
		39 00 00 00 00 00 02 A9 03
		39 00 00 00 00 00 02 AA 72
		39 00 00 00 00 00 02 AB 03
		39 00 00 00 00 00 02 AC 89
		39 00 00 00 00 00 02 AD 03
		39 00 00 00 00 00 02 AE A2
		39 00 00 00 00 00 02 AF 03
		39 00 00 00 00 00 02 B0 FC
		39 00 00 00 00 00 02 B1 03
		39 00 00 00 00 00 02 B2 FF
		//R(-) MCR cmd
		39 00 00 00 00 00 02 B3 00
		39 00 00 00 00 00 02 B4 00
		39 00 00 00 00 00 02 B5 00
		39 00 00 00 00 00 02 B6 1B
		39 00 00 00 00 00 02 B7 00
		39 00 00 00 00 00 02 B8 47
		39 00 00 00 00 00 02 B9 00
		39 00 00 00 00 00 02 BA 68
		39 00 00 00 00 00 02 BB 00
		39 00 00 00 00 00 02 BC 82
		39 00 00 00 00 00 02 BD 00
		39 00 00 00 00 00 02 BE 99
		39 00 00 00 00 00 02 BF 00
		39 00 00 00 00 00 02 C0 AE
		39 00 00 00 00 00 02 C1 00
		39 00 00 00 00 00 02 C2 BF
		39 00 00 00 00 00 02 C3 00
		39 00 00 00 00 00 02 C4 D0
		39 00 00 00 00 00 02 C5 01
		39 00 00 00 00 00 02 C6 05
		39 00 00 00 00 00 02 C7 01
		39 00 00 00 00 00 02 C8 2F
		39 00 00 00 00 00 02 C9 01
		39 00 00 00 00 00 02 CA 70
		39 00 00 00 00 00 02 CB 01
		39 00 00 00 00 00 02 CC A3
		39 00 00 00 00 00 02 CD 01
		39 00 00 00 00 00 02 CE F2
		39 00 00 00 00 00 02 CF 02
		39 00 00 00 00 00 02 D0 2D
		39 00 00 00 00 00 02 D1 02
		39 00 00 00 00 00 02 D2 2F
		39 00 00 00 00 00 02 D3 02
		39 00 00 00 00 00 02 D4 63
		39 00 00 00 00 00 02 D5 02
		39 00 00 00 00 00 02 D6 99
		39 00 00 00 00 00 02 D7 02
		39 00 00 00 00 00 02 D8 BA
		39 00 00 00 00 00 02 D9 02
		39 00 00 00 00 00 02 DA E9
		39 00 00 00 00 00 02 DB 03
		39 00 00 00 00 00 02 DC 09
		39 00 00 00 00 00 02 DD 03
		39 00 00 00 00 00 02 DE 34
		39 00 00 00 00 00 02 DF 03
		39 00 00 00 00 00 02 E0 41
		39 00 00 00 00 00 02 E1 03
		39 00 00 00 00 00 02 E2 50
		39 00 00 00 00 00 02 E3 03
		39 00 00 00 00 00 02 E4 60
		39 00 00 00 00 00 02 E5 03
		39 00 00 00 00 00 02 E6 72
		39 00 00 00 00 00 02 E7 03
		39 00 00 00 00 00 02 E8 89
		39 00 00 00 00 00 02 E9 03
		39 00 00 00 00 00 02 EA A2
		39 00 00 00 00 00 02 EB 03
		39 00 00 00 00 00 02 EC FC
		39 00 00 00 00 00 02 ED 03
		39 00 00 00 00 00 02 EE FF
		//G(+) MCR cmd
		39 00 00 00 00 00 02 EF 00
		39 00 00 00 00 00 02 F0 7A
		39 00 00 00 00 00 02 F1 00
		39 00 00 00 00 00 02 F2 85
		39 00 00 00 00 00 02 F3 00
		39 00 00 00 00 00 02 F4 9C
		39 00 00 00 00 00 02 F5 00
		39 00 00 00 00 00 02 F6 AF
		39 00 00 00 00 00 02 F7 00
		39 00 00 00 00 00 02 F8 C1
		39 00 00 00 00 00 02 F9 00
		39 00 00 00 00 00 02 FA D0
		//page selection cmd start
		39 01 00 00 00 00 02 FF 02
		09 00 00 00 00 00 02 00 00
		09 00 00 00 00 00 02 00 00
		09 00 00 00 00 00 02 00 00
		39 00 00 00 00 00 02 FB 01
		//page selection cmd end
		39 00 00 00 00 00 02 00 00
		39 00 00 00 00 00 02 01 DF
		39 00 00 00 00 00 02 02 00
		39 00 00 00 00 00 02 03 EC
		39 00 00 00 00 00 02 04 00
		39 00 00 00 00 00 02 05 F9
		39 00 00 00 00 00 02 06 01
		39 00 00 00 00 00 02 07 25
		39 00 00 00 00 00 02 08 01
		39 00 00 00 00 00 02 09 48
		39 00 00 00 00 00 02 0A 01
		39 00 00 00 00 00 02 0B 82
		39 00 00 00 00 00 02 0C 01
		39 00 00 00 00 00 02 0D B1
		39 00 00 00 00 00 02 0E 01
		39 00 00 00 00 00 02 0F FA
		39 00 00 00 00 00 02 10 02
		39 00 00 00 00 00 02 11 33
		39 00 00 00 00 00 02 12 02
		39 00 00 00 00 00 02 13 35
		39 00 00 00 00 00 02 14 02
		39 00 00 00 00 00 02 15 67
		39 00 00 00 00 00 02 16 02
		39 00 00 00 00 00 02 17 9C
		39 00 00 00 00 00 02 18 02
		39 00 00 00 00 00 02 19 BD
		39 00 00 00 00 00 02 1A 02
		39 00 00 00 00 00 02 1B ED
		39 00 00 00 00 00 02 1C 03
		39 00 00 00 00 00 02 1D 0D
		39 00 00 00 00 00 02 1E 03
		39 00 00 00 00 00 02 1F 39
		39 00 00 00 00 00 02 20 03
		39 00 00 00 00 00 02 21 45
		39 00 00 00 00 00 02 22 03
		39 00 00 00 00 00 02 23 54
		39 00 00 00 00 00 02 24 03
		39 00 00 00 00 00 02 25 64
		39 00 00 00 00 00 02 26 03
		39 00 00 00 00 00 02 27 78
		39 00 00 00 00 00 02 28 03
		39 00 00 00 00 00 02 29 90
		39 00 00 00 00 00 02 2A 03
		39 00 00 00 00 00 02 2B A6
		39 00 00 00 00 00 02 2D 03
		39 00 00 00 00 00 02 2F C9
		39 00 00 00 00 00 02 30 03
		39 00 00 00 00 00 02 31 FF
		//G(-) MCR cmd
		39 00 00 00 00 00 02 32 00
		39 00 00 00 00 00 02 33 7A
		39 00 00 00 00 00 02 34 00
		39 00 00 00 00 00 02 35 85
		39 00 00 00 00 00 02 36 00
		39 00 00 00 00 00 02 37 9C
		39 00 00 00 00 00 02 38 00
		39 00 00 00 00 00 02 39 AF
		39 00 00 00 00 00 02 3A 00
		39 00 00 00 00 00 02 3B C1
		39 00 00 00 00 00 02 3D 00
		39 00 00 00 00 00 02 3F D0
		39 00 00 00 00 00 02 40 00
		39 00 00 00 00 00 02 41 DF
		39 00 00 00 00 00 02 42 00
		39 00 00 00 00 00 02 43 EC
		39 00 00 00 00 00 02 44 00
		39 00 00 00 00 00 02 45 F9
		39 00 00 00 00 00 02 46 01
		39 00 00 00 00 00 02 47 25
		39 00 00 00 00 00 02 48 01
		39 00 00 00 00 00 02 49 48
		39 00 00 00 00 00 02 4A 01
		39 00 00 00 00 00 02 4B 82
		39 00 00 00 00 00 02 4C 01
		39 00 00 00 00 00 02 4D B1
		39 00 00 00 00 00 02 4E 01
		39 00 00 00 00 00 02 4F FA
		39 00 00 00 00 00 02 50 02
		39 00 00 00 00 00 02 51 33
		39 00 00 00 00 00 02 52 02
		39 00 00 00 00 00 02 53 35
		39 00 00 00 00 00 02 54 02
		39 00 00 00 00 00 02 55 67
		39 00 00 00 00 00 02 56 02
		39 00 00 00 00 00 02 58 9C
		39 00 00 00 00 00 02 59 02
		39 00 00 00 00 00 02 5A BD
		39 00 00 00 00 00 02 5B 02
		39 00 00 00 00 00 02 5C ED
		39 00 00 00 00 00 02 5D 03
		39 00 00 00 00 00 02 5E 0D
		39 00 00 00 00 00 02 5F 03
		39 00 00 00 00 00 02 60 39
		39 00 00 00 00 00 02 61 03
		39 00 00 00 00 00 02 62 45
		39 00 00 00 00 00 02 63 03
		39 00 00 00 00 00 02 64 54
		39 00 00 00 00 00 02 65 03
		39 00 00 00 00 00 02 66 64
		39 00 00 00 00 00 02 67 03
		39 00 00 00 00 00 02 68 78
		39 00 00 00 00 00 02 69 03
		39 00 00 00 00 00 02 6A 90
		39 00 00 00 00 00 02 6B 03
		39 00 00 00 00 00 02 6C A6
		39 00 00 00 00 00 02 6D 03
		39 00 00 00 00 00 02 6E C9
		39 00 00 00 00 00 02 6F 03
		39 00 00 00 00 00 02 70 FF
		//B(+) MCR cmd
		39 00 00 00 00 00 02 71 00
		39 00 00 00 00 00 02 72 25
		39 00 00 00 00 00 02 73 00
		39 00 00 00 00 00 02 74 38
		39 00 00 00 00 00 02 75 00
		39 00 00 00 00 00 02 76 59
		39 00 00 00 00 00 02 77 00
		39 00 00 00 00 00 02 78 72
		39 00 00 00 00 00 02 79 00
		39 00 00 00 00 00 02 7A 89
		39 00 00 00 00 00 02 7B 00
		39 00 00 00 00 00 02 7C 9D
		39 00 00 00 00 00 02 7D 00
		39 00 00 00 00 00 02 7E B0
		39 00 00 00 00 00 02 7F 00
		39 00 00 00 00 00 02 80 C0
		39 00 00 00 00 00 02 81 00
		39 00 00 00 00 00 02 82 CF
		39 00 00 00 00 00 02 83 01
		39 00 00 00 00 00 02 84 03
		39 00 00 00 00 00 02 85 01
		39 00 00 00 00 00 02 86 2C
		39 00 00 00 00 00 02 87 01
		39 00 00 00 00 00 02 88 6D
		39 00 00 00 00 00 02 89 01
		39 00 00 00 00 00 02 8A A0
		39 00 00 00 00 00 02 8B 01
		39 00 00 00 00 00 02 8C EF
		39 00 00 00 00 00 02 8D 02
		39 00 00 00 00 00 02 8E 2C
		39 00 00 00 00 00 02 8F 02
		39 00 00 00 00 00 02 90 2E
		39 00 00 00 00 00 02 91 02
		39 00 00 00 00 00 02 92 63
		39 00 00 00 00 00 02 93 02
		39 00 00 00 00 00 02 94 9A
		39 00 00 00 00 00 02 95 02
		39 00 00 00 00 00 02 96 BC
		39 00 00 00 00 00 02 97 02
		39 00 00 00 00 00 02 98 F1
		39 00 00 00 00 00 02 99 03
		39 00 00 00 00 00 02 9A 17
		39 00 00 00 00 00 02 9B 03
		39 00 00 00 00 00 02 9C 62
		39 00 00 00 00 00 02 9D 03
		39 00 00 00 00 00 02 9E 8F
		39 00 00 00 00 00 02 9F 03
		39 00 00 00 00 00 02 A0 C6
		39 00 00 00 00 00 02 A2 03
		39 00 00 00 00 00 02 A3 D0
		39 00 00 00 00 00 02 A4 03
		39 00 00 00 00 00 02 A5 D2
		39 00 00 00 00 00 02 A6 03
		39 00 00 00 00 00 02 A7 D7
		39 00 00 00 00 00 02 A9 03
		39 00 00 00 00 00 02 AA E1
		39 00 00 00 00 00 02 AB 03
		39 00 00 00 00 00 02 AC E7
		39 00 00 00 00 00 02 AD 03
		39 00 00 00 00 00 02 AE FF
		//B(-) MCR cmd
		39 00 00 00 00 00 02 AF 00
		39 00 00 00 00 00 02 B0 25
		39 00 00 00 00 00 02 B1 00
		39 00 00 00 00 00 02 B2 38
		39 00 00 00 00 00 02 B3 00
		39 00 00 00 00 00 02 B4 59
		39 00 00 00 00 00 02 B5 00
		39 00 00 00 00 00 02 B6 72
		39 00 00 00 00 00 02 B7 00
		39 00 00 00 00 00 02 B8 89
		39 00 00 00 00 00 02 B9 00
		39 00 00 00 00 00 02 BA 9D
		39 00 00 00 00 00 02 BB 00
		39 00 00 00 00 00 02 BC B0
		39 00 00 00 00 00 02 BD 00
		39 00 00 00 00 00 02 BE C0
		39 00 00 00 00 00 02 BF 00
		39 00 00 00 00 00 02 C0 CF
		39 00 00 00 00 00 02 C1 01
		39 00 00 00 00 00 02 C2 03
		39 00 00 00 00 00 02 C3 01
		39 00 00 00 00 00 02 C4 2C
		39 00 00 00 00 00 02 C5 01
		39 00 00 00 00 00 02 C6 6D
		39 00 00 00 00 00 02 C7 01
		39 00 00 00 00 00 02 C8 A0
		39 00 00 00 00 00 02 C9 01
		39 00 00 00 00 00 02 CA EF
		39 00 00 00 00 00 02 CB 02
		39 00 00 00 00 00 02 CC 2C
		39 00 00 00 00 00 02 CD 02
		39 00 00 00 00 00 02 CE 2E
		39 00 00 00 00 00 02 CF 02
		39 00 00 00 00 00 02 D0 63
		39 00 00 00 00 00 02 D1 02
		39 00 00 00 00 00 02 D2 9A
		39 00 00 00 00 00 02 D3 02
		39 00 00 00 00 00 02 D4 BC
		39 00 00 00 00 00 02 D5 02
		39 00 00 00 00 00 02 D6 F1
		39 00 00 00 00 00 02 D7 03
		39 00 00 00 00 00 02 D8 17
		39 00 00 00 00 00 02 D9 03
		39 00 00 00 00 00 02 DA 62
		39 00 00 00 00 00 02 DB 03
		39 00 00 00 00 00 02 DC 8F
		39 00 00 00 00 00 02 DD 03
		39 00 00 00 00 00 02 DE C6
		39 00 00 00 00 00 02 DF 03
		39 00 00 00 00 00 02 E0 D0
		39 00 00 00 00 00 02 E1 03
		39 00 00 00 00 00 02 E2 D2
		39 00 00 00 00 00 02 E3 03
		39 00 00 00 00 00 02 E4 D7
		39 00 00 00 00 00 02 E5 03
		39 00 00 00 00 00 02 E6 E1
		39 00 00 00 00 00 02 E7 03
		39 00 00 00 00 00 02 E8 E7
		39 00 00 00 00 00 02 E9 03
		39 00 00 00 00 00 02 EA FF
		39 01 00 00 00 00 02 FF 00
		39 01 00 00 00 00 02 55 B3
	];
	lenovo,lcd-effect-custom-mode-command-state = "dsi_hs_mode";

	lenovo,lcd-effect-default-mode-command = [
//T7190 0.3022 0.3220
		//page selection cmd start 1
		39 01 00 00 00 00 02 FF 01
		39 00 00 00 00 00 02 FB 01
		//page selection cmd end
		//R(+) MCR cmd
		39 00 00 00 00 00 02 75 00
		39 00 00 00 00 00 02 76 00
		39 00 00 00 00 00 02 77 00
		39 00 00 00 00 00 02 78 1B
		39 00 00 00 00 00 02 79 00
		39 00 00 00 00 00 02 7A 47
		39 00 00 00 00 00 02 7B 00
		39 00 00 00 00 00 02 7C 68
		39 00 00 00 00 00 02 7D 00
		39 00 00 00 00 00 02 7E 82
		39 00 00 00 00 00 02 7F 00
		39 00 00 00 00 00 02 80 99
		39 00 00 00 00 00 02 81 00
		39 00 00 00 00 00 02 82 AE
		39 00 00 00 00 00 02 83 00
		39 00 00 00 00 00 02 84 BF
		39 00 00 00 00 00 02 85 00
		39 00 00 00 00 00 02 86 D0
		39 00 00 00 00 00 02 87 01
		39 00 00 00 00 00 02 88 05
		39 00 00 00 00 00 02 89 01
		39 00 00 00 00 00 02 8A 2F
		39 00 00 00 00 00 02 8B 01
		39 00 00 00 00 00 02 8C 70
		39 00 00 00 00 00 02 8D 01
		39 00 00 00 00 00 02 8E A3
		39 00 00 00 00 00 02 8F 01
		39 00 00 00 00 00 02 90 F2
		39 00 00 00 00 00 02 91 02
		39 00 00 00 00 00 02 92 2D
		39 00 00 00 00 00 02 93 02
		39 00 00 00 00 00 02 94 2F
		39 00 00 00 00 00 02 95 02
		39 00 00 00 00 00 02 96 63
		39 00 00 00 00 00 02 97 02
		39 00 00 00 00 00 02 98 99
		39 00 00 00 00 00 02 99 02
		39 00 00 00 00 00 02 9A BA
		39 00 00 00 00 00 02 9B 02
		39 00 00 00 00 00 02 9C E9
		39 00 00 00 00 00 02 9D 03
		39 00 00 00 00 00 02 9E 09
		39 00 00 00 00 00 02 9F 03
		39 00 00 00 00 00 02 A0 34
		39 00 00 00 00 00 02 A2 03
		39 00 00 00 00 00 02 A3 41
		39 00 00 00 00 00 02 A4 03
		39 00 00 00 00 00 02 A5 50
		39 00 00 00 00 00 02 A6 03
		39 00 00 00 00 00 02 A7 60
		39 00 00 00 00 00 02 A9 03
		39 00 00 00 00 00 02 AA 72
		39 00 00 00 00 00 02 AB 03
		39 00 00 00 00 00 02 AC 89
		39 00 00 00 00 00 02 AD 03
		39 00 00 00 00 00 02 AE A2
		39 00 00 00 00 00 02 AF 03
		39 00 00 00 00 00 02 B0 FC
		39 00 00 00 00 00 02 B1 03
		39 00 00 00 00 00 02 B2 FF
		//R(-) MCR cmd
		39 00 00 00 00 00 02 B3 00
		39 00 00 00 00 00 02 B4 00
		39 00 00 00 00 00 02 B5 00
		39 00 00 00 00 00 02 B6 1B
		39 00 00 00 00 00 02 B7 00
		39 00 00 00 00 00 02 B8 47
		39 00 00 00 00 00 02 B9 00
		39 00 00 00 00 00 02 BA 68
		39 00 00 00 00 00 02 BB 00
		39 00 00 00 00 00 02 BC 82
		39 00 00 00 00 00 02 BD 00
		39 00 00 00 00 00 02 BE 99
		39 00 00 00 00 00 02 BF 00
		39 00 00 00 00 00 02 C0 AE
		39 00 00 00 00 00 02 C1 00
		39 00 00 00 00 00 02 C2 BF
		39 00 00 00 00 00 02 C3 00
		39 00 00 00 00 00 02 C4 D0
		39 00 00 00 00 00 02 C5 01
		39 00 00 00 00 00 02 C6 05
		39 00 00 00 00 00 02 C7 01
		39 00 00 00 00 00 02 C8 2F
		39 00 00 00 00 00 02 C9 01
		39 00 00 00 00 00 02 CA 70
		39 00 00 00 00 00 02 CB 01
		39 00 00 00 00 00 02 CC A3
		39 00 00 00 00 00 02 CD 01
		39 00 00 00 00 00 02 CE F2
		39 00 00 00 00 00 02 CF 02
		39 00 00 00 00 00 02 D0 2D
		39 00 00 00 00 00 02 D1 02
		39 00 00 00 00 00 02 D2 2F
		39 00 00 00 00 00 02 D3 02
		39 00 00 00 00 00 02 D4 63
		39 00 00 00 00 00 02 D5 02
		39 00 00 00 00 00 02 D6 99
		39 00 00 00 00 00 02 D7 02
		39 00 00 00 00 00 02 D8 BA
		39 00 00 00 00 00 02 D9 02
		39 00 00 00 00 00 02 DA E9
		39 00 00 00 00 00 02 DB 03
		39 00 00 00 00 00 02 DC 09
		39 00 00 00 00 00 02 DD 03
		39 00 00 00 00 00 02 DE 34
		39 00 00 00 00 00 02 DF 03
		39 00 00 00 00 00 02 E0 41
		39 00 00 00 00 00 02 E1 03
		39 00 00 00 00 00 02 E2 50
		39 00 00 00 00 00 02 E3 03
		39 00 00 00 00 00 02 E4 60
		39 00 00 00 00 00 02 E5 03
		39 00 00 00 00 00 02 E6 72
		39 00 00 00 00 00 02 E7 03
		39 00 00 00 00 00 02 E8 89
		39 00 00 00 00 00 02 E9 03
		39 00 00 00 00 00 02 EA A2
		39 00 00 00 00 00 02 EB 03
		39 00 00 00 00 00 02 EC FC
		39 00 00 00 00 00 02 ED 03
		39 00 00 00 00 00 02 EE FF
		//G(+) MCR cmd
		39 00 00 00 00 00 02 EF 00
		39 00 00 00 00 00 02 F0 7A
		39 00 00 00 00 00 02 F1 00
		39 00 00 00 00 00 02 F2 85
		39 00 00 00 00 00 02 F3 00
		39 00 00 00 00 00 02 F4 9C
		39 00 00 00 00 00 02 F5 00
		39 00 00 00 00 00 02 F6 AF
		39 00 00 00 00 00 02 F7 00
		39 00 00 00 00 00 02 F8 C1
		39 00 00 00 00 00 02 F9 00
		39 00 00 00 00 00 02 FA D0
		//page selection cmd start
		39 01 00 00 00 00 02 FF 02
		09 00 00 00 00 00 02 00 00
		09 00 00 00 00 00 02 00 00
		09 00 00 00 00 00 02 00 00
		39 00 00 00 00 00 02 FB 01
		//page selection cmd end
		39 00 00 00 00 00 02 00 00
		39 00 00 00 00 00 02 01 DF
		39 00 00 00 00 00 02 02 00
		39 00 00 00 00 00 02 03 EC
		39 00 00 00 00 00 02 04 00
		39 00 00 00 00 00 02 05 F9
		39 00 00 00 00 00 02 06 01
		39 00 00 00 00 00 02 07 25
		39 00 00 00 00 00 02 08 01
		39 00 00 00 00 00 02 09 48
		39 00 00 00 00 00 02 0A 01
		39 00 00 00 00 00 02 0B 82
		39 00 00 00 00 00 02 0C 01
		39 00 00 00 00 00 02 0D B1
		39 00 00 00 00 00 02 0E 01
		39 00 00 00 00 00 02 0F FA
		39 00 00 00 00 00 02 10 02
		39 00 00 00 00 00 02 11 33
		39 00 00 00 00 00 02 12 02
		39 00 00 00 00 00 02 13 35
		39 00 00 00 00 00 02 14 02
		39 00 00 00 00 00 02 15 67
		39 00 00 00 00 00 02 16 02
		39 00 00 00 00 00 02 17 9C
		39 00 00 00 00 00 02 18 02
		39 00 00 00 00 00 02 19 BD
		39 00 00 00 00 00 02 1A 02
		39 00 00 00 00 00 02 1B ED
		39 00 00 00 00 00 02 1C 03
		39 00 00 00 00 00 02 1D 0D
		39 00 00 00 00 00 02 1E 03
		39 00 00 00 00 00 02 1F 39
		39 00 00 00 00 00 02 20 03
		39 00 00 00 00 00 02 21 45
		39 00 00 00 00 00 02 22 03
		39 00 00 00 00 00 02 23 54
		39 00 00 00 00 00 02 24 03
		39 00 00 00 00 00 02 25 64
		39 00 00 00 00 00 02 26 03
		39 00 00 00 00 00 02 27 78
		39 00 00 00 00 00 02 28 03
		39 00 00 00 00 00 02 29 90
		39 00 00 00 00 00 02 2A 03
		39 00 00 00 00 00 02 2B A6
		39 00 00 00 00 00 02 2D 03
		39 00 00 00 00 00 02 2F C9
		39 00 00 00 00 00 02 30 03
		39 00 00 00 00 00 02 31 FF
		//G(-) MCR cmd
		39 00 00 00 00 00 02 32 00
		39 00 00 00 00 00 02 33 7A
		39 00 00 00 00 00 02 34 00
		39 00 00 00 00 00 02 35 85
		39 00 00 00 00 00 02 36 00
		39 00 00 00 00 00 02 37 9C
		39 00 00 00 00 00 02 38 00
		39 00 00 00 00 00 02 39 AF
		39 00 00 00 00 00 02 3A 00
		39 00 00 00 00 00 02 3B C1
		39 00 00 00 00 00 02 3D 00
		39 00 00 00 00 00 02 3F D0
		39 00 00 00 00 00 02 40 00
		39 00 00 00 00 00 02 41 DF
		39 00 00 00 00 00 02 42 00
		39 00 00 00 00 00 02 43 EC
		39 00 00 00 00 00 02 44 00
		39 00 00 00 00 00 02 45 F9
		39 00 00 00 00 00 02 46 01
		39 00 00 00 00 00 02 47 25
		39 00 00 00 00 00 02 48 01
		39 00 00 00 00 00 02 49 48
		39 00 00 00 00 00 02 4A 01
		39 00 00 00 00 00 02 4B 82
		39 00 00 00 00 00 02 4C 01
		39 00 00 00 00 00 02 4D B1
		39 00 00 00 00 00 02 4E 01
		39 00 00 00 00 00 02 4F FA
		39 00 00 00 00 00 02 50 02
		39 00 00 00 00 00 02 51 33
		39 00 00 00 00 00 02 52 02
		39 00 00 00 00 00 02 53 35
		39 00 00 00 00 00 02 54 02
		39 00 00 00 00 00 02 55 67
		39 00 00 00 00 00 02 56 02
		39 00 00 00 00 00 02 58 9C
		39 00 00 00 00 00 02 59 02
		39 00 00 00 00 00 02 5A BD
		39 00 00 00 00 00 02 5B 02
		39 00 00 00 00 00 02 5C ED
		39 00 00 00 00 00 02 5D 03
		39 00 00 00 00 00 02 5E 0D
		39 00 00 00 00 00 02 5F 03
		39 00 00 00 00 00 02 60 39
		39 00 00 00 00 00 02 61 03
		39 00 00 00 00 00 02 62 45
		39 00 00 00 00 00 02 63 03
		39 00 00 00 00 00 02 64 54
		39 00 00 00 00 00 02 65 03
		39 00 00 00 00 00 02 66 64
		39 00 00 00 00 00 02 67 03
		39 00 00 00 00 00 02 68 78
		39 00 00 00 00 00 02 69 03
		39 00 00 00 00 00 02 6A 90
		39 00 00 00 00 00 02 6B 03
		39 00 00 00 00 00 02 6C A6
		39 00 00 00 00 00 02 6D 03
		39 00 00 00 00 00 02 6E C9
		39 00 00 00 00 00 02 6F 03
		39 00 00 00 00 00 02 70 FF
		//B(+) MCR cmd
		39 00 00 00 00 00 02 71 00
		39 00 00 00 00 00 02 72 25
		39 00 00 00 00 00 02 73 00
		39 00 00 00 00 00 02 74 38
		39 00 00 00 00 00 02 75 00
		39 00 00 00 00 00 02 76 59
		39 00 00 00 00 00 02 77 00
		39 00 00 00 00 00 02 78 72
		39 00 00 00 00 00 02 79 00
		39 00 00 00 00 00 02 7A 89
		39 00 00 00 00 00 02 7B 00
		39 00 00 00 00 00 02 7C 9D
		39 00 00 00 00 00 02 7D 00
		39 00 00 00 00 00 02 7E B0
		39 00 00 00 00 00 02 7F 00
		39 00 00 00 00 00 02 80 C0
		39 00 00 00 00 00 02 81 00
		39 00 00 00 00 00 02 82 CF
		39 00 00 00 00 00 02 83 01
		39 00 00 00 00 00 02 84 03
		39 00 00 00 00 00 02 85 01
		39 00 00 00 00 00 02 86 2C
		39 00 00 00 00 00 02 87 01
		39 00 00 00 00 00 02 88 6D
		39 00 00 00 00 00 02 89 01
		39 00 00 00 00 00 02 8A A0
		39 00 00 00 00 00 02 8B 01
		39 00 00 00 00 00 02 8C EF
		39 00 00 00 00 00 02 8D 02
		39 00 00 00 00 00 02 8E 2C
		39 00 00 00 00 00 02 8F 02
		39 00 00 00 00 00 02 90 2E
		39 00 00 00 00 00 02 91 02
		39 00 00 00 00 00 02 92 63
		39 00 00 00 00 00 02 93 02
		39 00 00 00 00 00 02 94 9A
		39 00 00 00 00 00 02 95 02
		39 00 00 00 00 00 02 96 BC
		39 00 00 00 00 00 02 97 02
		39 00 00 00 00 00 02 98 F1
		39 00 00 00 00 00 02 99 03
		39 00 00 00 00 00 02 9A 17
		39 00 00 00 00 00 02 9B 03
		39 00 00 00 00 00 02 9C 62
		39 00 00 00 00 00 02 9D 03
		39 00 00 00 00 00 02 9E 8F
		39 00 00 00 00 00 02 9F 03
		39 00 00 00 00 00 02 A0 C6
		39 00 00 00 00 00 02 A2 03
		39 00 00 00 00 00 02 A3 D0
		39 00 00 00 00 00 02 A4 03
		39 00 00 00 00 00 02 A5 D2
		39 00 00 00 00 00 02 A6 03
		39 00 00 00 00 00 02 A7 D7
		39 00 00 00 00 00 02 A9 03
		39 00 00 00 00 00 02 AA E1
		39 00 00 00 00 00 02 AB 03
		39 00 00 00 00 00 02 AC E7
		39 00 00 00 00 00 02 AD 03
		39 00 00 00 00 00 02 AE FF
		//B(-) MCR cmd
		39 00 00 00 00 00 02 AF 00
		39 00 00 00 00 00 02 B0 25
		39 00 00 00 00 00 02 B1 00
		39 00 00 00 00 00 02 B2 38
		39 00 00 00 00 00 02 B3 00
		39 00 00 00 00 00 02 B4 59
		39 00 00 00 00 00 02 B5 00
		39 00 00 00 00 00 02 B6 72
		39 00 00 00 00 00 02 B7 00
		39 00 00 00 00 00 02 B8 89
		39 00 00 00 00 00 02 B9 00
		39 00 00 00 00 00 02 BA 9D
		39 00 00 00 00 00 02 BB 00
		39 00 00 00 00 00 02 BC B0
		39 00 00 00 00 00 02 BD 00
		39 00 00 00 00 00 02 BE C0
		39 00 00 00 00 00 02 BF 00
		39 00 00 00 00 00 02 C0 CF
		39 00 00 00 00 00 02 C1 01
		39 00 00 00 00 00 02 C2 03
		39 00 00 00 00 00 02 C3 01
		39 00 00 00 00 00 02 C4 2C
		39 00 00 00 00 00 02 C5 01
		39 00 00 00 00 00 02 C6 6D
		39 00 00 00 00 00 02 C7 01
		39 00 00 00 00 00 02 C8 A0
		39 00 00 00 00 00 02 C9 01
		39 00 00 00 00 00 02 CA EF
		39 00 00 00 00 00 02 CB 02
		39 00 00 00 00 00 02 CC 2C
		39 00 00 00 00 00 02 CD 02
		39 00 00 00 00 00 02 CE 2E
		39 00 00 00 00 00 02 CF 02
		39 00 00 00 00 00 02 D0 63
		39 00 00 00 00 00 02 D1 02
		39 00 00 00 00 00 02 D2 9A
		39 00 00 00 00 00 02 D3 02
		39 00 00 00 00 00 02 D4 BC
		39 00 00 00 00 00 02 D5 02
		39 00 00 00 00 00 02 D6 F1
		39 00 00 00 00 00 02 D7 03
		39 00 00 00 00 00 02 D8 17
		39 00 00 00 00 00 02 D9 03
		39 00 00 00 00 00 02 DA 62
		39 00 00 00 00 00 02 DB 03
		39 00 00 00 00 00 02 DC 8F
		39 00 00 00 00 00 02 DD 03
		39 00 00 00 00 00 02 DE C6
		39 00 00 00 00 00 02 DF 03
		39 00 00 00 00 00 02 E0 D0
		39 00 00 00 00 00 02 E1 03
		39 00 00 00 00 00 02 E2 D2
		39 00 00 00 00 00 02 E3 03
		39 00 00 00 00 00 02 E4 D7
		39 00 00 00 00 00 02 E5 03
		39 00 00 00 00 00 02 E6 E1
		39 00 00 00 00 00 02 E7 03
		39 00 00 00 00 00 02 E8 E7
		39 00 00 00 00 00 02 E9 03
		39 00 00 00 00 00 02 EA FF
		39 01 00 00 00 00 02 FF 00
		39 01 00 00 00 00 02 55 B3
		];
	lenovo,lcd-effect-default-mode-command-state = "dsi_hs_mode";


	lenovo,lcd-effect-comfort-mode-command = [
		//T5780 0.3262 0.3427
		//page selection cmd start
		39 01 00 00 00 00 02 FF 01
		39 00 00 00 00 00 02 FB 01
		//page selection cmd end
		//R(+) MCR cmd
		39 00 00 00 00 00 02 75 00
		39 00 00 00 00 00 02 76 00
		39 00 00 00 00 00 02 77 00
		39 00 00 00 00 00 02 78 1B
		39 00 00 00 00 00 02 79 00
		39 00 00 00 00 00 02 7A 47
		39 00 00 00 00 00 02 7B 00
		39 00 00 00 00 00 02 7C 68
		39 00 00 00 00 00 02 7D 00
		39 00 00 00 00 00 02 7E 82
		39 00 00 00 00 00 02 7F 00
		39 00 00 00 00 00 02 80 99
		39 00 00 00 00 00 02 81 00
		39 00 00 00 00 00 02 82 AE
		39 00 00 00 00 00 02 83 00
		39 00 00 00 00 00 02 84 BF
		39 00 00 00 00 00 02 85 00
		39 00 00 00 00 00 02 86 D0
		39 00 00 00 00 00 02 87 01
		39 00 00 00 00 00 02 88 05
		39 00 00 00 00 00 02 89 01
		39 00 00 00 00 00 02 8A 2F
		39 00 00 00 00 00 02 8B 01
		39 00 00 00 00 00 02 8C 70
		39 00 00 00 00 00 02 8D 01
		39 00 00 00 00 00 02 8E A3
		39 00 00 00 00 00 02 8F 01
		39 00 00 00 00 00 02 90 F2
		39 00 00 00 00 00 02 91 02
		39 00 00 00 00 00 02 92 2E
		39 00 00 00 00 00 02 93 02
		39 00 00 00 00 00 02 94 2F
		39 00 00 00 00 00 02 95 02
		39 00 00 00 00 00 02 96 63
		39 00 00 00 00 00 02 97 02
		39 00 00 00 00 00 02 98 99
		39 00 00 00 00 00 02 99 02
		39 00 00 00 00 00 02 9A BB
		39 00 00 00 00 00 02 9B 02
		39 00 00 00 00 00 02 9C E9
		39 00 00 00 00 00 02 9D 03
		39 00 00 00 00 00 02 9E 09
		39 00 00 00 00 00 02 9F 03
		39 00 00 00 00 00 02 A0 2E
		39 00 00 00 00 00 02 A2 03
		39 00 00 00 00 00 02 A3 3C
		39 00 00 00 00 00 02 A4 03
		39 00 00 00 00 00 02 A5 4B
		39 00 00 00 00 00 02 A6 03
		39 00 00 00 00 00 02 A7 5C
		39 00 00 00 00 00 02 A9 03
		39 00 00 00 00 00 02 AA 6F
		39 00 00 00 00 00 02 AB 03
		39 00 00 00 00 00 02 AC 84
		39 00 00 00 00 00 02 AD 03
		39 00 00 00 00 00 02 AE 9E
		39 00 00 00 00 00 02 AF 03
		39 00 00 00 00 00 02 B0 C0
		39 00 00 00 00 00 02 B1 03
		39 00 00 00 00 00 02 B2 FF
		//R(-) MCR cmd
		39 00 00 00 00 00 02 B3 00
		39 00 00 00 00 00 02 B4 00
		39 00 00 00 00 00 02 B5 00
		39 00 00 00 00 00 02 B6 1B
		39 00 00 00 00 00 02 B7 00
		39 00 00 00 00 00 02 B8 47
		39 00 00 00 00 00 02 B9 00
		39 00 00 00 00 00 02 BA 68
		39 00 00 00 00 00 02 BB 00
		39 00 00 00 00 00 02 BC 82
		39 00 00 00 00 00 02 BD 00
		39 00 00 00 00 00 02 BE 99
		39 00 00 00 00 00 02 BF 00
		39 00 00 00 00 00 02 C0 AE
		39 00 00 00 00 00 02 C1 00
		39 00 00 00 00 00 02 C2 BF
		39 00 00 00 00 00 02 C3 00
		39 00 00 00 00 00 02 C4 D0
		39 00 00 00 00 00 02 C5 01
		39 00 00 00 00 00 02 C6 05
		39 00 00 00 00 00 02 C7 01
		39 00 00 00 00 00 02 C8 2F
		39 00 00 00 00 00 02 C9 01
		39 00 00 00 00 00 02 CA 70
		39 00 00 00 00 00 02 CB 01
		39 00 00 00 00 00 02 CC A3
		39 00 00 00 00 00 02 CD 01
		39 00 00 00 00 00 02 CE F2
		39 00 00 00 00 00 02 CF 02
		39 00 00 00 00 00 02 D0 2E
		39 00 00 00 00 00 02 D1 02
		39 00 00 00 00 00 02 D2 2F
		39 00 00 00 00 00 02 D3 02
		39 00 00 00 00 00 02 D4 63
		39 00 00 00 00 00 02 D5 02
		39 00 00 00 00 00 02 D6 99
		39 00 00 00 00 00 02 D7 02
		39 00 00 00 00 00 02 D8 BB
		39 00 00 00 00 00 02 D9 02
		39 00 00 00 00 00 02 DA E9
		39 00 00 00 00 00 02 DB 03
		39 00 00 00 00 00 02 DC 09
		39 00 00 00 00 00 02 DD 03
		39 00 00 00 00 00 02 DE 2E
		39 00 00 00 00 00 02 DF 03
		39 00 00 00 00 00 02 E0 3C
		39 00 00 00 00 00 02 E1 03
		39 00 00 00 00 00 02 E2 4B
		39 00 00 00 00 00 02 E3 03
		39 00 00 00 00 00 02 E4 5C
		39 00 00 00 00 00 02 E5 03
		39 00 00 00 00 00 02 E6 6F
		39 00 00 00 00 00 02 E7 03
		39 00 00 00 00 00 02 E8 84
		39 00 00 00 00 00 02 E9 03
		39 00 00 00 00 00 02 EA 9E
		39 00 00 00 00 00 02 EB 03
		39 00 00 00 00 00 02 EC C0
		39 00 00 00 00 00 02 ED 03
		39 00 00 00 00 00 02 EE FF
		//G(+) MCR cmd
		39 00 00 00 00 00 02 EF 01
		39 00 00 00 00 00 02 F0 1B
		39 00 00 00 00 00 02 F1 01
		39 00 00 00 00 00 02 F2 20
		39 00 00 00 00 00 02 F3 01
		39 00 00 00 00 00 02 F4 29
		39 00 00 00 00 00 02 F5 01
		39 00 00 00 00 00 02 F6 31
		39 00 00 00 00 00 02 F7 01
		39 00 00 00 00 00 02 F8 39
		39 00 00 00 00 00 02 F9 01
		39 00 00 00 00 00 02 FA 41
		//page selection cmd start
		39 01 00 00 00 00 02 FF 02
		09 00 00 00 00 00 02 00 00
		09 00 00 00 00 00 02 00 00
		09 00 00 00 00 00 02 00 00
		39 00 00 00 00 00 02 FB 01
		//page selection cmd end
		39 00 00 00 00 00 02 00 01
		39 00 00 00 00 00 02 01 49
		39 00 00 00 00 00 02 02 01
		39 00 00 00 00 00 02 03 50
		39 00 00 00 00 00 02 04 01
		39 00 00 00 00 00 02 05 58
		39 00 00 00 00 00 02 06 01
		39 00 00 00 00 00 02 07 72
		39 00 00 00 00 00 02 08 01
		39 00 00 00 00 00 02 09 8B
		39 00 00 00 00 00 02 0A 01
		39 00 00 00 00 00 02 0B B4
		39 00 00 00 00 00 02 0C 01
		39 00 00 00 00 00 02 0D D8
		39 00 00 00 00 00 02 0E 02
		39 00 00 00 00 00 02 0F 12
		39 00 00 00 00 00 02 10 02
		39 00 00 00 00 00 02 11 43
		39 00 00 00 00 00 02 12 02
		39 00 00 00 00 00 02 13 44
		39 00 00 00 00 00 02 14 02
		39 00 00 00 00 00 02 15 71
		39 00 00 00 00 00 02 16 02
		39 00 00 00 00 00 02 17 A5
		39 00 00 00 00 00 02 18 02
		39 00 00 00 00 00 02 19 C7
		39 00 00 00 00 00 02 1A 02
		39 00 00 00 00 00 02 1B F6
		39 00 00 00 00 00 02 1C 03
		39 00 00 00 00 00 02 1D 16
		39 00 00 00 00 00 02 1E 03
		39 00 00 00 00 00 02 1F 3D
		39 00 00 00 00 00 02 20 03
		39 00 00 00 00 00 02 21 4A
		39 00 00 00 00 00 02 22 03
		39 00 00 00 00 00 02 23 58
		39 00 00 00 00 00 02 24 03
		39 00 00 00 00 00 02 25 68
		39 00 00 00 00 00 02 26 03
		39 00 00 00 00 00 02 27 7A
		39 00 00 00 00 00 02 28 03
		39 00 00 00 00 00 02 29 8E
		39 00 00 00 00 00 02 2A 03
		39 00 00 00 00 00 02 2B A7
		39 00 00 00 00 00 02 2D 03
		39 00 00 00 00 00 02 2F C6
		39 00 00 00 00 00 02 30 03
		39 00 00 00 00 00 02 31 FF
		//G(-) MCR cmd
		39 00 00 00 00 00 02 32 01
		39 00 00 00 00 00 02 33 1B
		39 00 00 00 00 00 02 34 01
		39 00 00 00 00 00 02 35 20
		39 00 00 00 00 00 02 36 01
		39 00 00 00 00 00 02 37 29
		39 00 00 00 00 00 02 38 01
		39 00 00 00 00 00 02 39 31
		39 00 00 00 00 00 02 3A 01
		39 00 00 00 00 00 02 3B 39
		39 00 00 00 00 00 02 3D 01
		39 00 00 00 00 00 02 3F 41
		39 00 00 00 00 00 02 40 01
		39 00 00 00 00 00 02 41 49
		39 00 00 00 00 00 02 42 01
		39 00 00 00 00 00 02 43 50
		39 00 00 00 00 00 02 44 01
		39 00 00 00 00 00 02 45 58
		39 00 00 00 00 00 02 46 01
		39 00 00 00 00 00 02 47 72
		39 00 00 00 00 00 02 48 01
		39 00 00 00 00 00 02 49 8B
		39 00 00 00 00 00 02 4A 01
		39 00 00 00 00 00 02 4B B4
		39 00 00 00 00 00 02 4C 01
		39 00 00 00 00 00 02 4D D8
		39 00 00 00 00 00 02 4E 02
		39 00 00 00 00 00 02 4F 12
		39 00 00 00 00 00 02 50 02
		39 00 00 00 00 00 02 51 43
		39 00 00 00 00 00 02 52 02
		39 00 00 00 00 00 02 53 44
		39 00 00 00 00 00 02 54 02
		39 00 00 00 00 00 02 55 71
		39 00 00 00 00 00 02 56 02
		39 00 00 00 00 00 02 58 A5
		39 00 00 00 00 00 02 59 02
		39 00 00 00 00 00 02 5A C7
		39 00 00 00 00 00 02 5B 02
		39 00 00 00 00 00 02 5C F6
		39 00 00 00 00 00 02 5D 03
		39 00 00 00 00 00 02 5E 16
		39 00 00 00 00 00 02 5F 03
		39 00 00 00 00 00 02 60 3D
		39 00 00 00 00 00 02 61 03
		39 00 00 00 00 00 02 62 4A
		39 00 00 00 00 00 02 63 03
		39 00 00 00 00 00 02 64 58
		39 00 00 00 00 00 02 65 03
		39 00 00 00 00 00 02 66 68
		39 00 00 00 00 00 02 67 03
		39 00 00 00 00 00 02 68 7A
		39 00 00 00 00 00 02 69 03
		39 00 00 00 00 00 02 6A 8E
		39 00 00 00 00 00 02 6B 03
		39 00 00 00 00 00 02 6C A7
		39 00 00 00 00 00 02 6D 03
		39 00 00 00 00 00 02 6E C6
		39 00 00 00 00 00 02 6F 03
		39 00 00 00 00 00 02 70 FF
		//B(+) MCR cmd
		39 00 00 00 00 00 02 71 01
		39 00 00 00 00 00 02 72 58
		39 00 00 00 00 00 02 73 01
		39 00 00 00 00 00 02 74 5B
		39 00 00 00 00 00 02 75 01
		39 00 00 00 00 00 02 76 61
		39 00 00 00 00 00 02 77 01
		39 00 00 00 00 00 02 78 68
		39 00 00 00 00 00 02 79 01
		39 00 00 00 00 00 02 7A 6E
		39 00 00 00 00 00 02 7B 01
		39 00 00 00 00 00 02 7C 73
		39 00 00 00 00 00 02 7D 01
		39 00 00 00 00 00 02 7E 79
		39 00 00 00 00 00 02 7F 01
		39 00 00 00 00 00 02 80 7F
		39 00 00 00 00 00 02 81 01
		39 00 00 00 00 00 02 82 84
		39 00 00 00 00 00 02 83 01
		39 00 00 00 00 00 02 84 99
		39 00 00 00 00 00 02 85 01
		39 00 00 00 00 00 02 86 AD
		39 00 00 00 00 00 02 87 01
		39 00 00 00 00 00 02 88 CF
		39 00 00 00 00 00 02 89 01
		39 00 00 00 00 00 02 8A ED
		39 00 00 00 00 00 02 8B 02
		39 00 00 00 00 00 02 8C 21
		39 00 00 00 00 00 02 8D 02
		39 00 00 00 00 00 02 8E 4F
		39 00 00 00 00 00 02 8F 02
		39 00 00 00 00 00 02 90 50
		39 00 00 00 00 00 02 91 02
		39 00 00 00 00 00 02 92 7B
		39 00 00 00 00 00 02 93 02
		39 00 00 00 00 00 02 94 AF
		39 00 00 00 00 00 02 95 02
		39 00 00 00 00 00 02 96 D3
		39 00 00 00 00 00 02 97 03
		39 00 00 00 00 00 02 98 09
		39 00 00 00 00 00 02 99 03
		39 00 00 00 00 00 02 9A 35
		39 00 00 00 00 00 02 9B 03
		39 00 00 00 00 00 02 9C C6
		39 00 00 00 00 00 02 9D 03
		39 00 00 00 00 00 02 9E CD
		39 00 00 00 00 00 02 9F 03
		39 00 00 00 00 00 02 A0 D0
		39 00 00 00 00 00 02 A2 03
		39 00 00 00 00 00 02 A3 D4
		39 00 00 00 00 00 02 A4 03
		39 00 00 00 00 00 02 A5 E2
		39 00 00 00 00 00 02 A6 03
		39 00 00 00 00 00 02 A7 E7
		39 00 00 00 00 00 02 A9 03
		39 00 00 00 00 00 02 AA F5
		39 00 00 00 00 00 02 AB 03
		39 00 00 00 00 00 02 AC FE
		39 00 00 00 00 00 02 AD 03
		39 00 00 00 00 00 02 AE FF
		//B(-) MCR cmd
		39 00 00 00 00 00 02 AF 01
		39 00 00 00 00 00 02 B0 58
		39 00 00 00 00 00 02 B1 01
		39 00 00 00 00 00 02 B2 5B
		39 00 00 00 00 00 02 B3 01
		39 00 00 00 00 00 02 B4 61
		39 00 00 00 00 00 02 B5 01
		39 00 00 00 00 00 02 B6 68
		39 00 00 00 00 00 02 B7 01
		39 00 00 00 00 00 02 B8 6E
		39 00 00 00 00 00 02 B9 01
		39 00 00 00 00 00 02 BA 73
		39 00 00 00 00 00 02 BB 01
		39 00 00 00 00 00 02 BC 79
		39 00 00 00 00 00 02 BD 01
		39 00 00 00 00 00 02 BE 7F
		39 00 00 00 00 00 02 BF 01
		39 00 00 00 00 00 02 C0 84
		39 00 00 00 00 00 02 C1 01
		39 00 00 00 00 00 02 C2 99
		39 00 00 00 00 00 02 C3 01
		39 00 00 00 00 00 02 C4 AD
		39 00 00 00 00 00 02 C5 01
		39 00 00 00 00 00 02 C6 CF
		39 00 00 00 00 00 02 C7 01
		39 00 00 00 00 00 02 C8 ED
		39 00 00 00 00 00 02 C9 02
		39 00 00 00 00 00 02 CA 21
		39 00 00 00 00 00 02 CB 02
		39 00 00 00 00 00 02 CC 4F
		39 00 00 00 00 00 02 CD 02
		39 00 00 00 00 00 02 CE 50
		39 00 00 00 00 00 02 CF 02
		39 00 00 00 00 00 02 D0 7B
		39 00 00 00 00 00 02 D1 02
		39 00 00 00 00 00 02 D2 AF
		39 00 00 00 00 00 02 D3 02
		39 00 00 00 00 00 02 D4 D3
		39 00 00 00 00 00 02 D5 03
		39 00 00 00 00 00 02 D6 09
		39 00 00 00 00 00 02 D7 03
		39 00 00 00 00 00 02 D8 35
		39 00 00 00 00 00 02 D9 03
		39 00 00 00 00 00 02 DA C6
		39 00 00 00 00 00 02 DB 03
		39 00 00 00 00 00 02 DC CD
		39 00 00 00 00 00 02 DD 03
		39 00 00 00 00 00 02 DE D0
		39 00 00 00 00 00 02 DF 03
		39 00 00 00 00 00 02 E0 D4
		39 00 00 00 00 00 02 E1 03
		39 00 00 00 00 00 02 E2 E2
		39 00 00 00 00 00 02 E3 03
		39 00 00 00 00 00 02 E4 E7
		39 00 00 00 00 00 02 E5 03
		39 00 00 00 00 00 02 E6 F5
		39 00 00 00 00 00 02 E7 03
		39 00 00 00 00 00 02 E8 FE
		39 00 00 00 00 00 02 E9 03
		39 00 00 00 00 00 02 EA FF
		39 01 00 00 00 00 02 FF 00
		39 01 00 00 00 00 02 55 B3
			];
	lenovo,lcd-effect-comfort-mode-command-state = "dsi_hs_mode";



	//lenovo,lcd-effect-outside-mode-command = [];
	//lenovo,lcd-effect-outside-mode-command-state = "dsi_lp_mode";

	lenovo,lcd-effect-ultra-mode-command = [
//T7190 0.3022 0.3220
		//page selection cmd start 1
		39 01 00 00 00 00 02 FF 01
		39 00 00 00 00 00 02 FB 01
		//page selection cmd end
		//R(+) MCR cmd
		39 00 00 00 00 00 02 75 00
		39 00 00 00 00 00 02 76 00
		39 00 00 00 00 00 02 77 00
		39 00 00 00 00 00 02 78 1B
		39 00 00 00 00 00 02 79 00
		39 00 00 00 00 00 02 7A 47
		39 00 00 00 00 00 02 7B 00
		39 00 00 00 00 00 02 7C 68
		39 00 00 00 00 00 02 7D 00
		39 00 00 00 00 00 02 7E 82
		39 00 00 00 00 00 02 7F 00
		39 00 00 00 00 00 02 80 99
		39 00 00 00 00 00 02 81 00
		39 00 00 00 00 00 02 82 AE
		39 00 00 00 00 00 02 83 00
		39 00 00 00 00 00 02 84 BF
		39 00 00 00 00 00 02 85 00
		39 00 00 00 00 00 02 86 D0
		39 00 00 00 00 00 02 87 01
		39 00 00 00 00 00 02 88 05
		39 00 00 00 00 00 02 89 01
		39 00 00 00 00 00 02 8A 2F
		39 00 00 00 00 00 02 8B 01
		39 00 00 00 00 00 02 8C 70
		39 00 00 00 00 00 02 8D 01
		39 00 00 00 00 00 02 8E A3
		39 00 00 00 00 00 02 8F 01
		39 00 00 00 00 00 02 90 F2
		39 00 00 00 00 00 02 91 02
		39 00 00 00 00 00 02 92 2D
		39 00 00 00 00 00 02 93 02
		39 00 00 00 00 00 02 94 2F
		39 00 00 00 00 00 02 95 02
		39 00 00 00 00 00 02 96 63
		39 00 00 00 00 00 02 97 02
		39 00 00 00 00 00 02 98 99
		39 00 00 00 00 00 02 99 02
		39 00 00 00 00 00 02 9A BA
		39 00 00 00 00 00 02 9B 02
		39 00 00 00 00 00 02 9C E9
		39 00 00 00 00 00 02 9D 03
		39 00 00 00 00 00 02 9E 09
		39 00 00 00 00 00 02 9F 03
		39 00 00 00 00 00 02 A0 34
		39 00 00 00 00 00 02 A2 03
		39 00 00 00 00 00 02 A3 41
		39 00 00 00 00 00 02 A4 03
		39 00 00 00 00 00 02 A5 50
		39 00 00 00 00 00 02 A6 03
		39 00 00 00 00 00 02 A7 60
		39 00 00 00 00 00 02 A9 03
		39 00 00 00 00 00 02 AA 72
		39 00 00 00 00 00 02 AB 03
		39 00 00 00 00 00 02 AC 89
		39 00 00 00 00 00 02 AD 03
		39 00 00 00 00 00 02 AE A2
		39 00 00 00 00 00 02 AF 03
		39 00 00 00 00 00 02 B0 FC
		39 00 00 00 00 00 02 B1 03
		39 00 00 00 00 00 02 B2 FF
		//R(-) MCR cmd
		39 00 00 00 00 00 02 B3 00
		39 00 00 00 00 00 02 B4 00
		39 00 00 00 00 00 02 B5 00
		39 00 00 00 00 00 02 B6 1B
		39 00 00 00 00 00 02 B7 00
		39 00 00 00 00 00 02 B8 47
		39 00 00 00 00 00 02 B9 00
		39 00 00 00 00 00 02 BA 68
		39 00 00 00 00 00 02 BB 00
		39 00 00 00 00 00 02 BC 82
		39 00 00 00 00 00 02 BD 00
		39 00 00 00 00 00 02 BE 99
		39 00 00 00 00 00 02 BF 00
		39 00 00 00 00 00 02 C0 AE
		39 00 00 00 00 00 02 C1 00
		39 00 00 00 00 00 02 C2 BF
		39 00 00 00 00 00 02 C3 00
		39 00 00 00 00 00 02 C4 D0
		39 00 00 00 00 00 02 C5 01
		39 00 00 00 00 00 02 C6 05
		39 00 00 00 00 00 02 C7 01
		39 00 00 00 00 00 02 C8 2F
		39 00 00 00 00 00 02 C9 01
		39 00 00 00 00 00 02 CA 70
		39 00 00 00 00 00 02 CB 01
		39 00 00 00 00 00 02 CC A3
		39 00 00 00 00 00 02 CD 01
		39 00 00 00 00 00 02 CE F2
		39 00 00 00 00 00 02 CF 02
		39 00 00 00 00 00 02 D0 2D
		39 00 00 00 00 00 02 D1 02
		39 00 00 00 00 00 02 D2 2F
		39 00 00 00 00 00 02 D3 02
		39 00 00 00 00 00 02 D4 63
		39 00 00 00 00 00 02 D5 02
		39 00 00 00 00 00 02 D6 99
		39 00 00 00 00 00 02 D7 02
		39 00 00 00 00 00 02 D8 BA
		39 00 00 00 00 00 02 D9 02
		39 00 00 00 00 00 02 DA E9
		39 00 00 00 00 00 02 DB 03
		39 00 00 00 00 00 02 DC 09
		39 00 00 00 00 00 02 DD 03
		39 00 00 00 00 00 02 DE 34
		39 00 00 00 00 00 02 DF 03
		39 00 00 00 00 00 02 E0 41
		39 00 00 00 00 00 02 E1 03
		39 00 00 00 00 00 02 E2 50
		39 00 00 00 00 00 02 E3 03
		39 00 00 00 00 00 02 E4 60
		39 00 00 00 00 00 02 E5 03
		39 00 00 00 00 00 02 E6 72
		39 00 00 00 00 00 02 E7 03
		39 00 00 00 00 00 02 E8 89
		39 00 00 00 00 00 02 E9 03
		39 00 00 00 00 00 02 EA A2
		39 00 00 00 00 00 02 EB 03
		39 00 00 00 00 00 02 EC FC
		39 00 00 00 00 00 02 ED 03
		39 00 00 00 00 00 02 EE FF
		//G(+) MCR cmd
		39 00 00 00 00 00 02 EF 00
		39 00 00 00 00 00 02 F0 7A
		39 00 00 00 00 00 02 F1 00
		39 00 00 00 00 00 02 F2 85
		39 00 00 00 00 00 02 F3 00
		39 00 00 00 00 00 02 F4 9C
		39 00 00 00 00 00 02 F5 00
		39 00 00 00 00 00 02 F6 AF
		39 00 00 00 00 00 02 F7 00
		39 00 00 00 00 00 02 F8 C1
		39 00 00 00 00 00 02 F9 00
		39 00 00 00 00 00 02 FA D0
		//page selection cmd start
		39 01 00 00 00 00 02 FF 02
		09 00 00 00 00 00 02 00 00
		09 00 00 00 00 00 02 00 00
		09 00 00 00 00 00 02 00 00
		39 00 00 00 00 00 02 FB 01
		//page selection cmd end
		39 00 00 00 00 00 02 00 00
		39 00 00 00 00 00 02 01 DF
		39 00 00 00 00 00 02 02 00
		39 00 00 00 00 00 02 03 EC
		39 00 00 00 00 00 02 04 00
		39 00 00 00 00 00 02 05 F9
		39 00 00 00 00 00 02 06 01
		39 00 00 00 00 00 02 07 25
		39 00 00 00 00 00 02 08 01
		39 00 00 00 00 00 02 09 48
		39 00 00 00 00 00 02 0A 01
		39 00 00 00 00 00 02 0B 82
		39 00 00 00 00 00 02 0C 01
		39 00 00 00 00 00 02 0D B1
		39 00 00 00 00 00 02 0E 01
		39 00 00 00 00 00 02 0F FA
		39 00 00 00 00 00 02 10 02
		39 00 00 00 00 00 02 11 33
		39 00 00 00 00 00 02 12 02
		39 00 00 00 00 00 02 13 35
		39 00 00 00 00 00 02 14 02
		39 00 00 00 00 00 02 15 67
		39 00 00 00 00 00 02 16 02
		39 00 00 00 00 00 02 17 9C
		39 00 00 00 00 00 02 18 02
		39 00 00 00 00 00 02 19 BD
		39 00 00 00 00 00 02 1A 02
		39 00 00 00 00 00 02 1B ED
		39 00 00 00 00 00 02 1C 03
		39 00 00 00 00 00 02 1D 0D
		39 00 00 00 00 00 02 1E 03
		39 00 00 00 00 00 02 1F 39
		39 00 00 00 00 00 02 20 03
		39 00 00 00 00 00 02 21 45
		39 00 00 00 00 00 02 22 03
		39 00 00 00 00 00 02 23 54
		39 00 00 00 00 00 02 24 03
		39 00 00 00 00 00 02 25 64
		39 00 00 00 00 00 02 26 03
		39 00 00 00 00 00 02 27 78
		39 00 00 00 00 00 02 28 03
		39 00 00 00 00 00 02 29 90
		39 00 00 00 00 00 02 2A 03
		39 00 00 00 00 00 02 2B A6
		39 00 00 00 00 00 02 2D 03
		39 00 00 00 00 00 02 2F C9
		39 00 00 00 00 00 02 30 03
		39 00 00 00 00 00 02 31 FF
		//G(-) MCR cmd
		39 00 00 00 00 00 02 32 00
		39 00 00 00 00 00 02 33 7A
		39 00 00 00 00 00 02 34 00
		39 00 00 00 00 00 02 35 85
		39 00 00 00 00 00 02 36 00
		39 00 00 00 00 00 02 37 9C
		39 00 00 00 00 00 02 38 00
		39 00 00 00 00 00 02 39 AF
		39 00 00 00 00 00 02 3A 00
		39 00 00 00 00 00 02 3B C1
		39 00 00 00 00 00 02 3D 00
		39 00 00 00 00 00 02 3F D0
		39 00 00 00 00 00 02 40 00
		39 00 00 00 00 00 02 41 DF
		39 00 00 00 00 00 02 42 00
		39 00 00 00 00 00 02 43 EC
		39 00 00 00 00 00 02 44 00
		39 00 00 00 00 00 02 45 F9
		39 00 00 00 00 00 02 46 01
		39 00 00 00 00 00 02 47 25
		39 00 00 00 00 00 02 48 01
		39 00 00 00 00 00 02 49 48
		39 00 00 00 00 00 02 4A 01
		39 00 00 00 00 00 02 4B 82
		39 00 00 00 00 00 02 4C 01
		39 00 00 00 00 00 02 4D B1
		39 00 00 00 00 00 02 4E 01
		39 00 00 00 00 00 02 4F FA
		39 00 00 00 00 00 02 50 02
		39 00 00 00 00 00 02 51 33
		39 00 00 00 00 00 02 52 02
		39 00 00 00 00 00 02 53 35
		39 00 00 00 00 00 02 54 02
		39 00 00 00 00 00 02 55 67
		39 00 00 00 00 00 02 56 02
		39 00 00 00 00 00 02 58 9C
		39 00 00 00 00 00 02 59 02
		39 00 00 00 00 00 02 5A BD
		39 00 00 00 00 00 02 5B 02
		39 00 00 00 00 00 02 5C ED
		39 00 00 00 00 00 02 5D 03
		39 00 00 00 00 00 02 5E 0D
		39 00 00 00 00 00 02 5F 03
		39 00 00 00 00 00 02 60 39
		39 00 00 00 00 00 02 61 03
		39 00 00 00 00 00 02 62 45
		39 00 00 00 00 00 02 63 03
		39 00 00 00 00 00 02 64 54
		39 00 00 00 00 00 02 65 03
		39 00 00 00 00 00 02 66 64
		39 00 00 00 00 00 02 67 03
		39 00 00 00 00 00 02 68 78
		39 00 00 00 00 00 02 69 03
		39 00 00 00 00 00 02 6A 90
		39 00 00 00 00 00 02 6B 03
		39 00 00 00 00 00 02 6C A6
		39 00 00 00 00 00 02 6D 03
		39 00 00 00 00 00 02 6E C9
		39 00 00 00 00 00 02 6F 03
		39 00 00 00 00 00 02 70 FF
		//B(+) MCR cmd
		39 00 00 00 00 00 02 71 00
		39 00 00 00 00 00 02 72 25
		39 00 00 00 00 00 02 73 00
		39 00 00 00 00 00 02 74 38
		39 00 00 00 00 00 02 75 00
		39 00 00 00 00 00 02 76 59
		39 00 00 00 00 00 02 77 00
		39 00 00 00 00 00 02 78 72
		39 00 00 00 00 00 02 79 00
		39 00 00 00 00 00 02 7A 89
		39 00 00 00 00 00 02 7B 00
		39 00 00 00 00 00 02 7C 9D
		39 00 00 00 00 00 02 7D 00
		39 00 00 00 00 00 02 7E B0
		39 00 00 00 00 00 02 7F 00
		39 00 00 00 00 00 02 80 C0
		39 00 00 00 00 00 02 81 00
		39 00 00 00 00 00 02 82 CF
		39 00 00 00 00 00 02 83 01
		39 00 00 00 00 00 02 84 03
		39 00 00 00 00 00 02 85 01
		39 00 00 00 00 00 02 86 2C
		39 00 00 00 00 00 02 87 01
		39 00 00 00 00 00 02 88 6D
		39 00 00 00 00 00 02 89 01
		39 00 00 00 00 00 02 8A A0
		39 00 00 00 00 00 02 8B 01
		39 00 00 00 00 00 02 8C EF
		39 00 00 00 00 00 02 8D 02
		39 00 00 00 00 00 02 8E 2C
		39 00 00 00 00 00 02 8F 02
		39 00 00 00 00 00 02 90 2E
		39 00 00 00 00 00 02 91 02
		39 00 00 00 00 00 02 92 63
		39 00 00 00 00 00 02 93 02
		39 00 00 00 00 00 02 94 9A
		39 00 00 00 00 00 02 95 02
		39 00 00 00 00 00 02 96 BC
		39 00 00 00 00 00 02 97 02
		39 00 00 00 00 00 02 98 F1
		39 00 00 00 00 00 02 99 03
		39 00 00 00 00 00 02 9A 17
		39 00 00 00 00 00 02 9B 03
		39 00 00 00 00 00 02 9C 62
		39 00 00 00 00 00 02 9D 03
		39 00 00 00 00 00 02 9E 8F
		39 00 00 00 00 00 02 9F 03
		39 00 00 00 00 00 02 A0 C6
		39 00 00 00 00 00 02 A2 03
		39 00 00 00 00 00 02 A3 D0
		39 00 00 00 00 00 02 A4 03
		39 00 00 00 00 00 02 A5 D2
		39 00 00 00 00 00 02 A6 03
		39 00 00 00 00 00 02 A7 D7
		39 00 00 00 00 00 02 A9 03
		39 00 00 00 00 00 02 AA E1
		39 00 00 00 00 00 02 AB 03
		39 00 00 00 00 00 02 AC E7
		39 00 00 00 00 00 02 AD 03
		39 00 00 00 00 00 02 AE FF
		//B(-) MCR cmd
		39 00 00 00 00 00 02 AF 00
		39 00 00 00 00 00 02 B0 25
		39 00 00 00 00 00 02 B1 00
		39 00 00 00 00 00 02 B2 38
		39 00 00 00 00 00 02 B3 00
		39 00 00 00 00 00 02 B4 59
		39 00 00 00 00 00 02 B5 00
		39 00 00 00 00 00 02 B6 72
		39 00 00 00 00 00 02 B7 00
		39 00 00 00 00 00 02 B8 89
		39 00 00 00 00 00 02 B9 00
		39 00 00 00 00 00 02 BA 9D
		39 00 00 00 00 00 02 BB 00
		39 00 00 00 00 00 02 BC B0
		39 00 00 00 00 00 02 BD 00
		39 00 00 00 00 00 02 BE C0
		39 00 00 00 00 00 02 BF 00
		39 00 00 00 00 00 02 C0 CF
		39 00 00 00 00 00 02 C1 01
		39 00 00 00 00 00 02 C2 03
		39 00 00 00 00 00 02 C3 01
		39 00 00 00 00 00 02 C4 2C
		39 00 00 00 00 00 02 C5 01
		39 00 00 00 00 00 02 C6 6D
		39 00 00 00 00 00 02 C7 01
		39 00 00 00 00 00 02 C8 A0
		39 00 00 00 00 00 02 C9 01
		39 00 00 00 00 00 02 CA EF
		39 00 00 00 00 00 02 CB 02
		39 00 00 00 00 00 02 CC 2C
		39 00 00 00 00 00 02 CD 02
		39 00 00 00 00 00 02 CE 2E
		39 00 00 00 00 00 02 CF 02
		39 00 00 00 00 00 02 D0 63
		39 00 00 00 00 00 02 D1 02
		39 00 00 00 00 00 02 D2 9A
		39 00 00 00 00 00 02 D3 02
		39 00 00 00 00 00 02 D4 BC
		39 00 00 00 00 00 02 D5 02
		39 00 00 00 00 00 02 D6 F1
		39 00 00 00 00 00 02 D7 03
		39 00 00 00 00 00 02 D8 17
		39 00 00 00 00 00 02 D9 03
		39 00 00 00 00 00 02 DA 62
		39 00 00 00 00 00 02 DB 03
		39 00 00 00 00 00 02 DC 8F
		39 00 00 00 00 00 02 DD 03
		39 00 00 00 00 00 02 DE C6
		39 00 00 00 00 00 02 DF 03
		39 00 00 00 00 00 02 E0 D0
		39 00 00 00 00 00 02 E1 03
		39 00 00 00 00 00 02 E2 D2
		39 00 00 00 00 00 02 E3 03
		39 00 00 00 00 00 02 E4 D7
		39 00 00 00 00 00 02 E5 03
		39 00 00 00 00 00 02 E6 E1
		39 00 00 00 00 00 02 E7 03
		39 00 00 00 00 00 02 E8 E7
		39 00 00 00 00 00 02 E9 03
		39 00 00 00 00 00 02 EA FF
		39 01 00 00 00 00 02 FF 00
		39 01 00 00 00 00 02 55 B3
		];
	lenovo,lcd-effect-ultra-mode-command-state = "dsi_hs_mode";

	lenovo,lcd-effect-camera-mode-command = [
		//T7190 0.3022 0.3220
		//page selection cmd start 1
		39 01 00 00 00 00 02 FF 01
		39 00 00 00 00 00 02 FB 01
		//page selection cmd end
		//R(+) MCR cmd
		39 00 00 00 00 00 02 75 00
		39 00 00 00 00 00 02 76 00
		39 00 00 00 00 00 02 77 00
		39 00 00 00 00 00 02 78 1B
		39 00 00 00 00 00 02 79 00
		39 00 00 00 00 00 02 7A 47
		39 00 00 00 00 00 02 7B 00
		39 00 00 00 00 00 02 7C 68
		39 00 00 00 00 00 02 7D 00
		39 00 00 00 00 00 02 7E 82
		39 00 00 00 00 00 02 7F 00
		39 00 00 00 00 00 02 80 99
		39 00 00 00 00 00 02 81 00
		39 00 00 00 00 00 02 82 AE
		39 00 00 00 00 00 02 83 00
		39 00 00 00 00 00 02 84 BF
		39 00 00 00 00 00 02 85 00
		39 00 00 00 00 00 02 86 D0
		39 00 00 00 00 00 02 87 01
		39 00 00 00 00 00 02 88 05
		39 00 00 00 00 00 02 89 01
		39 00 00 00 00 00 02 8A 2F
		39 00 00 00 00 00 02 8B 01
		39 00 00 00 00 00 02 8C 70
		39 00 00 00 00 00 02 8D 01
		39 00 00 00 00 00 02 8E A3
		39 00 00 00 00 00 02 8F 01
		39 00 00 00 00 00 02 90 F2
		39 00 00 00 00 00 02 91 02
		39 00 00 00 00 00 02 92 2D
		39 00 00 00 00 00 02 93 02
		39 00 00 00 00 00 02 94 2F
		39 00 00 00 00 00 02 95 02
		39 00 00 00 00 00 02 96 63
		39 00 00 00 00 00 02 97 02
		39 00 00 00 00 00 02 98 99
		39 00 00 00 00 00 02 99 02
		39 00 00 00 00 00 02 9A BA
		39 00 00 00 00 00 02 9B 02
		39 00 00 00 00 00 02 9C E9
		39 00 00 00 00 00 02 9D 03
		39 00 00 00 00 00 02 9E 09
		39 00 00 00 00 00 02 9F 03
		39 00 00 00 00 00 02 A0 34
		39 00 00 00 00 00 02 A2 03
		39 00 00 00 00 00 02 A3 41
		39 00 00 00 00 00 02 A4 03
		39 00 00 00 00 00 02 A5 50
		39 00 00 00 00 00 02 A6 03
		39 00 00 00 00 00 02 A7 60
		39 00 00 00 00 00 02 A9 03
		39 00 00 00 00 00 02 AA 72
		39 00 00 00 00 00 02 AB 03
		39 00 00 00 00 00 02 AC 89
		39 00 00 00 00 00 02 AD 03
		39 00 00 00 00 00 02 AE A2
		39 00 00 00 00 00 02 AF 03
		39 00 00 00 00 00 02 B0 FC
		39 00 00 00 00 00 02 B1 03
		39 00 00 00 00 00 02 B2 FF
		//R(-) MCR cmd
		39 00 00 00 00 00 02 B3 00
		39 00 00 00 00 00 02 B4 00
		39 00 00 00 00 00 02 B5 00
		39 00 00 00 00 00 02 B6 1B
		39 00 00 00 00 00 02 B7 00
		39 00 00 00 00 00 02 B8 47
		39 00 00 00 00 00 02 B9 00
		39 00 00 00 00 00 02 BA 68
		39 00 00 00 00 00 02 BB 00
		39 00 00 00 00 00 02 BC 82
		39 00 00 00 00 00 02 BD 00
		39 00 00 00 00 00 02 BE 99
		39 00 00 00 00 00 02 BF 00
		39 00 00 00 00 00 02 C0 AE
		39 00 00 00 00 00 02 C1 00
		39 00 00 00 00 00 02 C2 BF
		39 00 00 00 00 00 02 C3 00
		39 00 00 00 00 00 02 C4 D0
		39 00 00 00 00 00 02 C5 01
		39 00 00 00 00 00 02 C6 05
		39 00 00 00 00 00 02 C7 01
		39 00 00 00 00 00 02 C8 2F
		39 00 00 00 00 00 02 C9 01
		39 00 00 00 00 00 02 CA 70
		39 00 00 00 00 00 02 CB 01
		39 00 00 00 00 00 02 CC A3
		39 00 00 00 00 00 02 CD 01
		39 00 00 00 00 00 02 CE F2
		39 00 00 00 00 00 02 CF 02
		39 00 00 00 00 00 02 D0 2D
		39 00 00 00 00 00 02 D1 02
		39 00 00 00 00 00 02 D2 2F
		39 00 00 00 00 00 02 D3 02
		39 00 00 00 00 00 02 D4 63
		39 00 00 00 00 00 02 D5 02
		39 00 00 00 00 00 02 D6 99
		39 00 00 00 00 00 02 D7 02
		39 00 00 00 00 00 02 D8 BA
		39 00 00 00 00 00 02 D9 02
		39 00 00 00 00 00 02 DA E9
		39 00 00 00 00 00 02 DB 03
		39 00 00 00 00 00 02 DC 09
		39 00 00 00 00 00 02 DD 03
		39 00 00 00 00 00 02 DE 34
		39 00 00 00 00 00 02 DF 03
		39 00 00 00 00 00 02 E0 41
		39 00 00 00 00 00 02 E1 03
		39 00 00 00 00 00 02 E2 50
		39 00 00 00 00 00 02 E3 03
		39 00 00 00 00 00 02 E4 60
		39 00 00 00 00 00 02 E5 03
		39 00 00 00 00 00 02 E6 72
		39 00 00 00 00 00 02 E7 03
		39 00 00 00 00 00 02 E8 89
		39 00 00 00 00 00 02 E9 03
		39 00 00 00 00 00 02 EA A2
		39 00 00 00 00 00 02 EB 03
		39 00 00 00 00 00 02 EC FC
		39 00 00 00 00 00 02 ED 03
		39 00 00 00 00 00 02 EE FF
		//G(+) MCR cmd
		39 00 00 00 00 00 02 EF 00
		39 00 00 00 00 00 02 F0 7A
		39 00 00 00 00 00 02 F1 00
		39 00 00 00 00 00 02 F2 85
		39 00 00 00 00 00 02 F3 00
		39 00 00 00 00 00 02 F4 9C
		39 00 00 00 00 00 02 F5 00
		39 00 00 00 00 00 02 F6 AF
		39 00 00 00 00 00 02 F7 00
		39 00 00 00 00 00 02 F8 C1
		39 00 00 00 00 00 02 F9 00
		39 00 00 00 00 00 02 FA D0
		//page selection cmd start
		39 01 00 00 00 00 02 FF 02
		09 00 00 00 00 00 02 00 00
		09 00 00 00 00 00 02 00 00
		09 00 00 00 00 00 02 00 00
		39 00 00 00 00 00 02 FB 01
		//page selection cmd end
		39 00 00 00 00 00 02 00 00
		39 00 00 00 00 00 02 01 DF
		39 00 00 00 00 00 02 02 00
		39 00 00 00 00 00 02 03 EC
		39 00 00 00 00 00 02 04 00
		39 00 00 00 00 00 02 05 F9
		39 00 00 00 00 00 02 06 01
		39 00 00 00 00 00 02 07 25
		39 00 00 00 00 00 02 08 01
		39 00 00 00 00 00 02 09 48
		39 00 00 00 00 00 02 0A 01
		39 00 00 00 00 00 02 0B 82
		39 00 00 00 00 00 02 0C 01
		39 00 00 00 00 00 02 0D B1
		39 00 00 00 00 00 02 0E 01
		39 00 00 00 00 00 02 0F FA
		39 00 00 00 00 00 02 10 02
		39 00 00 00 00 00 02 11 33
		39 00 00 00 00 00 02 12 02
		39 00 00 00 00 00 02 13 35
		39 00 00 00 00 00 02 14 02
		39 00 00 00 00 00 02 15 67
		39 00 00 00 00 00 02 16 02
		39 00 00 00 00 00 02 17 9C
		39 00 00 00 00 00 02 18 02
		39 00 00 00 00 00 02 19 BD
		39 00 00 00 00 00 02 1A 02
		39 00 00 00 00 00 02 1B ED
		39 00 00 00 00 00 02 1C 03
		39 00 00 00 00 00 02 1D 0D
		39 00 00 00 00 00 02 1E 03
		39 00 00 00 00 00 02 1F 39
		39 00 00 00 00 00 02 20 03
		39 00 00 00 00 00 02 21 45
		39 00 00 00 00 00 02 22 03
		39 00 00 00 00 00 02 23 54
		39 00 00 00 00 00 02 24 03
		39 00 00 00 00 00 02 25 64
		39 00 00 00 00 00 02 26 03
		39 00 00 00 00 00 02 27 78
		39 00 00 00 00 00 02 28 03
		39 00 00 00 00 00 02 29 90
		39 00 00 00 00 00 02 2A 03
		39 00 00 00 00 00 02 2B A6
		39 00 00 00 00 00 02 2D 03
		39 00 00 00 00 00 02 2F C9
		39 00 00 00 00 00 02 30 03
		39 00 00 00 00 00 02 31 FF
		//G(-) MCR cmd
		39 00 00 00 00 00 02 32 00
		39 00 00 00 00 00 02 33 7A
		39 00 00 00 00 00 02 34 00
		39 00 00 00 00 00 02 35 85
		39 00 00 00 00 00 02 36 00
		39 00 00 00 00 00 02 37 9C
		39 00 00 00 00 00 02 38 00
		39 00 00 00 00 00 02 39 AF
		39 00 00 00 00 00 02 3A 00
		39 00 00 00 00 00 02 3B C1
		39 00 00 00 00 00 02 3D 00
		39 00 00 00 00 00 02 3F D0
		39 00 00 00 00 00 02 40 00
		39 00 00 00 00 00 02 41 DF
		39 00 00 00 00 00 02 42 00
		39 00 00 00 00 00 02 43 EC
		39 00 00 00 00 00 02 44 00
		39 00 00 00 00 00 02 45 F9
		39 00 00 00 00 00 02 46 01
		39 00 00 00 00 00 02 47 25
		39 00 00 00 00 00 02 48 01
		39 00 00 00 00 00 02 49 48
		39 00 00 00 00 00 02 4A 01
		39 00 00 00 00 00 02 4B 82
		39 00 00 00 00 00 02 4C 01
		39 00 00 00 00 00 02 4D B1
		39 00 00 00 00 00 02 4E 01
		39 00 00 00 00 00 02 4F FA
		39 00 00 00 00 00 02 50 02
		39 00 00 00 00 00 02 51 33
		39 00 00 00 00 00 02 52 02
		39 00 00 00 00 00 02 53 35
		39 00 00 00 00 00 02 54 02
		39 00 00 00 00 00 02 55 67
		39 00 00 00 00 00 02 56 02
		39 00 00 00 00 00 02 58 9C
		39 00 00 00 00 00 02 59 02
		39 00 00 00 00 00 02 5A BD
		39 00 00 00 00 00 02 5B 02
		39 00 00 00 00 00 02 5C ED
		39 00 00 00 00 00 02 5D 03
		39 00 00 00 00 00 02 5E 0D
		39 00 00 00 00 00 02 5F 03
		39 00 00 00 00 00 02 60 39
		39 00 00 00 00 00 02 61 03
		39 00 00 00 00 00 02 62 45
		39 00 00 00 00 00 02 63 03
		39 00 00 00 00 00 02 64 54
		39 00 00 00 00 00 02 65 03
		39 00 00 00 00 00 02 66 64
		39 00 00 00 00 00 02 67 03
		39 00 00 00 00 00 02 68 78
		39 00 00 00 00 00 02 69 03
		39 00 00 00 00 00 02 6A 90
		39 00 00 00 00 00 02 6B 03
		39 00 00 00 00 00 02 6C A6
		39 00 00 00 00 00 02 6D 03
		39 00 00 00 00 00 02 6E C9
		39 00 00 00 00 00 02 6F 03
		39 00 00 00 00 00 02 70 FF
		//B(+) MCR cmd
		39 00 00 00 00 00 02 71 00
		39 00 00 00 00 00 02 72 25
		39 00 00 00 00 00 02 73 00
		39 00 00 00 00 00 02 74 38
		39 00 00 00 00 00 02 75 00
		39 00 00 00 00 00 02 76 59
		39 00 00 00 00 00 02 77 00
		39 00 00 00 00 00 02 78 72
		39 00 00 00 00 00 02 79 00
		39 00 00 00 00 00 02 7A 89
		39 00 00 00 00 00 02 7B 00
		39 00 00 00 00 00 02 7C 9D
		39 00 00 00 00 00 02 7D 00
		39 00 00 00 00 00 02 7E B0
		39 00 00 00 00 00 02 7F 00
		39 00 00 00 00 00 02 80 C0
		39 00 00 00 00 00 02 81 00
		39 00 00 00 00 00 02 82 CF
		39 00 00 00 00 00 02 83 01
		39 00 00 00 00 00 02 84 03
		39 00 00 00 00 00 02 85 01
		39 00 00 00 00 00 02 86 2C
		39 00 00 00 00 00 02 87 01
		39 00 00 00 00 00 02 88 6D
		39 00 00 00 00 00 02 89 01
		39 00 00 00 00 00 02 8A A0
		39 00 00 00 00 00 02 8B 01
		39 00 00 00 00 00 02 8C EF
		39 00 00 00 00 00 02 8D 02
		39 00 00 00 00 00 02 8E 2C
		39 00 00 00 00 00 02 8F 02
		39 00 00 00 00 00 02 90 2E
		39 00 00 00 00 00 02 91 02
		39 00 00 00 00 00 02 92 63
		39 00 00 00 00 00 02 93 02
		39 00 00 00 00 00 02 94 9A
		39 00 00 00 00 00 02 95 02
		39 00 00 00 00 00 02 96 BC
		39 00 00 00 00 00 02 97 02
		39 00 00 00 00 00 02 98 F1
		39 00 00 00 00 00 02 99 03
		39 00 00 00 00 00 02 9A 17
		39 00 00 00 00 00 02 9B 03
		39 00 00 00 00 00 02 9C 62
		39 00 00 00 00 00 02 9D 03
		39 00 00 00 00 00 02 9E 8F
		39 00 00 00 00 00 02 9F 03
		39 00 00 00 00 00 02 A0 C6
		39 00 00 00 00 00 02 A2 03
		39 00 00 00 00 00 02 A3 D0
		39 00 00 00 00 00 02 A4 03
		39 00 00 00 00 00 02 A5 D2
		39 00 00 00 00 00 02 A6 03
		39 00 00 00 00 00 02 A7 D7
		39 00 00 00 00 00 02 A9 03
		39 00 00 00 00 00 02 AA E1
		39 00 00 00 00 00 02 AB 03
		39 00 00 00 00 00 02 AC E7
		39 00 00 00 00 00 02 AD 03
		39 00 00 00 00 00 02 AE FF
		//B(-) MCR cmd
		39 00 00 00 00 00 02 AF 00
		39 00 00 00 00 00 02 B0 25
		39 00 00 00 00 00 02 B1 00
		39 00 00 00 00 00 02 B2 38
		39 00 00 00 00 00 02 B3 00
		39 00 00 00 00 00 02 B4 59
		39 00 00 00 00 00 02 B5 00
		39 00 00 00 00 00 02 B6 72
		39 00 00 00 00 00 02 B7 00
		39 00 00 00 00 00 02 B8 89
		39 00 00 00 00 00 02 B9 00
		39 00 00 00 00 00 02 BA 9D
		39 00 00 00 00 00 02 BB 00
		39 00 00 00 00 00 02 BC B0
		39 00 00 00 00 00 02 BD 00
		39 00 00 00 00 00 02 BE C0
		39 00 00 00 00 00 02 BF 00
		39 00 00 00 00 00 02 C0 CF
		39 00 00 00 00 00 02 C1 01
		39 00 00 00 00 00 02 C2 03
		39 00 00 00 00 00 02 C3 01
		39 00 00 00 00 00 02 C4 2C
		39 00 00 00 00 00 02 C5 01
		39 00 00 00 00 00 02 C6 6D
		39 00 00 00 00 00 02 C7 01
		39 00 00 00 00 00 02 C8 A0
		39 00 00 00 00 00 02 C9 01
		39 00 00 00 00 00 02 CA EF
		39 00 00 00 00 00 02 CB 02
		39 00 00 00 00 00 02 CC 2C
		39 00 00 00 00 00 02 CD 02
		39 00 00 00 00 00 02 CE 2E
		39 00 00 00 00 00 02 CF 02
		39 00 00 00 00 00 02 D0 63
		39 00 00 00 00 00 02 D1 02
		39 00 00 00 00 00 02 D2 9A
		39 00 00 00 00 00 02 D3 02
		39 00 00 00 00 00 02 D4 BC
		39 00 00 00 00 00 02 D5 02
		39 00 00 00 00 00 02 D6 F1
		39 00 00 00 00 00 02 D7 03
		39 00 00 00 00 00 02 D8 17
		39 00 00 00 00 00 02 D9 03
		39 00 00 00 00 00 02 DA 62
		39 00 00 00 00 00 02 DB 03
		39 00 00 00 00 00 02 DC 8F
		39 00 00 00 00 00 02 DD 03
		39 00 00 00 00 00 02 DE C6
		39 00 00 00 00 00 02 DF 03
		39 00 00 00 00 00 02 E0 D0
		39 00 00 00 00 00 02 E1 03
		39 00 00 00 00 00 02 E2 D2
		39 00 00 00 00 00 02 E3 03
		39 00 00 00 00 00 02 E4 D7
		39 00 00 00 00 00 02 E5 03
		39 00 00 00 00 00 02 E6 E1
		39 00 00 00 00 00 02 E7 03
		39 00 00 00 00 00 02 E8 E7
		39 00 00 00 00 00 02 E9 03
		39 00 00 00 00 00 02 EA FF
		39 01 00 00 00 00 02 FF 00
		39 01 00 00 00 00 02 55 00
		];
	lenovo,lcd-effect-camera-mode-command-state = "dsi_hs_mode";

};

