/* Copyright (c) 2013-2014, The Linux Foundation. All rights reserved.
 *
 * This program is free software; you can redistribute it and/or modify
 * it under the terms of the GNU General Public License version 2 and
 * only version 2 as published by the Free Software Foundation.
 *
 * This program is distributed in the hope that it will be useful,
 * but WITHOUT ANY WARRANTY; without even the implied warranty of
 * MERCHANTABILITY or FITNESS FOR A PARTICULAR PURPOSE.  See the
 * GNU General Public License for more details.
 */

/*---------------------------------------------------------------------------
 * This file is autogenerated file using gcdb parser. Please do not edit it.
 * Update input XML file to add a new entry or update variable in this file
 * VERSION = "1.0"
 *---------------------------------------------------------------------------*/
&mdss_mdp {
	dsi_boe_1080_cmd: qcom,mdss_dsi_otm1902c_1080p_cmd {
		qcom,mdss-dsi-panel-name = "boe 1080p cmd mode dsi panel";
		qcom,mdss-dsi-panel-controller = <&mdss_dsi0>;
		qcom,mdss-dsi-panel-type = "dsi_cmd_mode";
		qcom,mdss-dsi-panel-destination = "display_1";
		qcom,mdss-dsi-panel-framerate = <60>;
		qcom,mdss-dsi-virtual-channel-id = <0>;
		qcom,mdss-dsi-stream = <0>;
		qcom,mdss-dsi-panel-width = <1080>;
		qcom,mdss-dsi-panel-height = <1920>;
		qcom,mdss-dsi-h-front-porch = <100>;
		qcom,mdss-dsi-h-back-porch = <60>;
		qcom,mdss-dsi-h-pulse-width = <47>;
		qcom,mdss-dsi-h-sync-skew = <0>;
		qcom,mdss-dsi-v-back-porch = <16>;
		qcom,mdss-dsi-v-front-porch = <10>;
		qcom,mdss-dsi-v-pulse-width = <2>;
		qcom,mdss-dsi-h-left-border = <0>;
		qcom,mdss-dsi-h-right-border = <0>;
		qcom,mdss-dsi-v-top-border = <0>;
		qcom,mdss-dsi-v-bottom-border = <0>;
		qcom,mdss-dsi-bpp = <24>;
		qcom,mdss-dsi-underflow-color = <0xff>;
		qcom,mdss-dsi-border-color = <0>;
		qcom,mdss-dsi-on-command = [
            23 00 00 00 00 00 02 00 00
            29 00 00 00 00 00 04 FF 19 06 01
            23 00 00 00 00 00 02 00 80
            29 00 00 00 00 00 03 FF 19 06
            23 00 00 00 00 00 02 00 A0
            29 00 00 00 00 00 04 C1 00 c0 10
            23 00 00 00 00 00 02 00 91
            29 00 00 00 00 00 03 c5 14 28
            23 00 00 00 00 00 02 00 95
            23 00 00 00 00 00 02 c5 11
           // 23 00 00 00 00 00 02 00 00
           // 29 00 00 00 00 00 09 d9 00 9f 00 9f 00 9f 00 9f
            23 00 00 00 00 00 02 00 90
            29 00 00 00 00 00 02 D6 60
            23 00 00 00 00 00 02 00 01
            29 00 00 00 00 00 02 C6 12
            23 00 00 00 00 00 02 00 00
            29 00 00 00 00 00 13 C8 da 7c 57 57 45 23 12 11 11 21 21 33 23 33 34 44 63 74
            29 00 00 00 00 00 02 00 01
            29 00 00 00 00 00 02 C6 00

            23 00 00 00 00 00 02 00 00
            29 00 00 00 00 00 02 82 00

            23 00 00 00 00 00 02 00 82
            23 00 00 00 00 00 02 c6 02

            23 00 00 00 00 00 02 00 81
            23 00 00 00 00 00 02 a5 01
	
            23 00 00 00 00 00 02 00 a5
            23 00 00 00 00 00 02 c5 11
	
            23 00 00 00 00 00 02 00 90 
            29 00 00 00 00 00 05 F5 09 16 09 16
	
            23 00 00 00 00 00 02 00 A7           
            23 00 00 00 00 00 02 F5 1A 
        
            23 00 00 00 00 00 02 00 9D           
            23 00 00 00 00 00 02 F5 1A   
                 
            23 00 00 00 00 00 02 00 A5             
            23 00 00 00 00 00 02 F5 16  

            23 00 00 00 00 00 02 00 8D                
            23 00 00 00 00 00 02 F5 17 
	
            23 00 00 00 00 00 02 00 E3         
            23 00 00 00 00 00 02 F5 11 
        
            23 00 00 00 00 00 02 00 ED                
            23 00 00 00 00 00 02 F5 16
        
            23 00 00 00 00 00 02 00 E5         
            23 00 00 00 00 00 02 F5 16 
        
            23 00 00 00 00 00 02 00 81         
            23 00 00 00 00 00 02 F5 16
        
            23 00 00 00 00 00 02 00 83         
            23 00 00 00 00 00 02 F5 16
            
            23 00 00 00 00 00 02 00 E1         
            23 00 00 00 00 00 02 F5 16
	
            23 00 00 00 00 00 02 00 80
            29 00 00 00 00 00 0D D8 00 00 00 00 00 00 00 00 00 00 00 00

	23 00 00 00 00 00 02 00 90
	29 00 00 00 00 00 0D D8 00 00 00 00 00 00 00 00 00 00 00 00

	23 00 00 00 00 00 02 00 A0
	29 00 00 00 00 00 0D D8 00 01 02 03 04 05 09 0a 0e 30 45 5F

	23 00 00 00 00 00 02 00 B0
	29 00 00 00 00 00 0D D8 00 80 81 82 82 83 84 84 86 8c 90 93

	23 00 00 00 00 00 02 00 C0
	29 00 00 00 00 00 0D D8 81 82 83 84 88 8a 8d 90 94 9a 9d a0

	23 00 00 00 00 00 02 00 D0
	29 00 00 00 00 00 0D D8 02 02 02 03 04 05 07 0b 0d 11 1a 24

	23 00 00 00 00 00 02 00 C0
	29 00 00 00 00 00 05 D7 82 80 C0 FF
	23 00 00 00 00 00 02 84 80

            23 00 00 00 00 00 02 00 80
            29 00 00 00 00 00 03 c1 55 55
            23 00 00 00 00 00 02 00 94
            23 00 00 00 00 00 02 c5 64
            23 00 00 00 00 00 02 00 a4
            23 00 00 00 00 00 02 c5 64
            23 00 00 00 00 00 02 00 c1
            23 00 00 00 00 00 02 c5 b5
            23 00 00 00 00 00 02 00 b3
            23 00 00 00 00 00 02 c0 88
            23 00 00 00 00 00 02 00 b4
            23 00 00 00 00 00 02 c0 00           
			23 00 00 00 00 00 02 00 00
            29 00 00 00 00 00 03 d8 23 23            
            23 00 00 00 00 00 02 00 80
            23 00 00 00 00 00 02 C4 81
            23 00 00 00 00 00 02 00 a0
            23 00 00 00 00 00 02 b3 33
            23 00 00 00 00 00 02 00 a6
            23 00 00 00 00 00 02 b3 30
            23 00 00 00 00 00 02 00 e0
            29 00 00 00 00 00 0B B4 1c 19 3f 01 64 5c 01 a0 5f a0
            23 00 00 00 00 00 02 00 f0
            23 00 00 00 00 00 02 b4 64
            23 00 00 00 00 00 02 00 80
            29 00 00 00 00 00 0F c0 00 71 00 0a 0a 00 71 0a 0a 00 71 00 0a 0a
            23 00 00 00 00 00 02 00 90
            29 00 00 00 00 00 07 c0 00 00 00 02 00 04
            23 00 00 00 00 00 02 00 a0
            29 00 00 00 00 00 10 c0 00 00 02 00 04 15 04 00 00 11 00 00 00 11 00
            23 00 00 00 00 00 02 00 d0
            29 00 00 00 00 00 10 c0 00 00 02 00 04 15 04 00 00 00 00 00 00 00 00
            23 00 00 00 00 00 02 00 80
            29 00 00 00 00 00 0D c2 83 01 00 00 82 01 00 00 00 00 00 00
            23 00 00 00 00 00 02 00 90
            29 00 00 00 00 00 0D c2 00 00 00 00 00 00 00 00 00 00 00 00
            23 00 00 00 00 00 02 00 a0
            29 00 00 00 00 00 0E c2 00 00 00 00 00 00 00 00 00 00 00 00 00
            23 00 00 00 00 00 02 00 b0
            29 00 00 00 00 00 10 c2 82 02 00 00 88 81 02 00 00 88 00 02 00 00 88
            23 00 00 00 00 00 02 00 c0
            29 00 00 00 00 00 10 c2 01 02 00 00 88 00 00 00 00 00 00 00 00 00 00
            23 00 00 00 00 00 02 00 d0
            29 00 00 00 00 00 10 c2 00 00 00 00 00 00 00 00 00 00 33 33 33 33 00
            23 00 00 00 00 00 02 00 80
            29 00 00 00 00 00 10 c3 00 00 00 00 00 00 00 00 00 00 00 00 00 00 00
            23 00 00 00 00 00 02 00 a0
            29 00 00 00 00 00 0D c3 83 01 00 00 82 01 00 00 00 00 00 00
            23 00 00 00 00 00 02 00 b0
            29 00 00 00 00 00 0F c3 00 00 00 00 82 02 00 00 88 81 02 00 00 88
            23 00 00 00 00 00 02 00 c0
            29 00 00 00 00 00 10 c3 00 02 00 00 88 01 02 00 00 88 00 00 00 00 00
            23 00 00 00 00 00 02 00 d0
            29 00 00 00 00 00 10 c3 00 00 00 00 00 00 00 00 00 00 00 00 00 00 00
            23 00 00 00 00 00 02 00 e0
            29 00 00 00 00 00 06 c3 33 33 33 33 00
            23 00 00 00 00 00 02 00 80
            29 00 00 00 00 00 0C cb 00 00 00 00 30 00 03 00 00 00 70
            23 00 00 00 00 00 02 00 90
            29 00 00 00 00 00 10 cb 00 00 00 00 00 00 00 00 00 00 00 00 00 00 00
            23 00 00 00 00 00 02 00 a0
            29 00 00 00 00 00 10 cb 00 00 00 bf 00 00 00 00 00 ff 00 00 00 00 00
            23 00 00 00 00 00 02 00 b0
            29 00 00 00 00 00 0D cb 00 00 00 00 00 00 00 00 00 00 77 77
            23 00 00 00 00 00 02 00 c0
            29 00 00 00 00 00 10 cb 01 01 01 01 01 01 01 01 01 01 01 01 01 01 01
            23 00 00 00 00 00 02 00 d0
            29 00 00 00 00 00 10 cb 01 01 01 f3 01 01 01 01 00 f3 00 00 01 00 01
            23 00 00 00 00 00 02 00 e0
            29 00 00 00 00 00 0D cb 00 01 00 01 00 01 00 01 00 00 77 07
            23 00 00 00 00 00 02 00 f0
            29 00 00 00 00 00 0C cb ff ff ff ff ff ff 03 33 03 00 70
            23 00 00 00 00 00 02 00 80
            29 00 00 00 00 00 0D cc 09 08 19 18 0f 0e 0d 0c 07 07 07 07                     
            23 00 00 00 00 00 02 00 90
            29 00 00 00 00 00 0D cc 08 09 18 19 0c 0d 0e 0f 07 07 07 07
            23 00 00 00 00 00 02 00 a0
            29 00 00 00 00 00 10 cc 14 15 16 17 1c 1d 1e 1f 01 04 20 07 07 07 00
            23 00 00 00 00 00 02 00 b0
            29 00 00 00 00 00 0A cc 01 02 03 04 05 06 07 07 00

            23 00 00 00 00 00 02 00 c0
            29 00 00 00 00 00 10 cc 00 00 00 00 00 00 00 00 00 00 00 00 00 00 00
            23 00 00 00 00 00 02 00 d0
            29 00 00 00 00 00 10 cc 00 00 00 00 00 00 00 00 00 00 00 00 00 00 00
            23 00 00 00 00 00 02 00 e0
            29 00 00 00 00 00 10 cc 00 00 00 00 00 00 00 00 00 00 00 00 00 00 00

            23 00 00 00 00 00 02 00 80
            29 00 00 00 00 00 10 cd 1a 01 12 11 1a 05 18 07 1a 1a 23 23 23 1f 1e
            23 00 00 00 00 00 02 00 90
            29 00 00 00 00 00 04 cd 1d 23 23 
            23 00 00 00 00 00 02 00 a0
            29 00 00 00 00 00 10 cd 1a 02 12 11 1a 06 18 08 1a 1a 23 23 23 1f 1e
            23 00 00 00 00 00 02 00 b0
            29 00 00 00 00 00 04 cd 1d 23 23
            23 00 00 00 00 00 02 00 80
            29 00 00 00 00 00 0B A4 af 00 20 04 00 17 15 03 60 00
            23 00 00 00 00 00 02 00 90
            29 00 00 00 00 00 04 A4 00 00 00
            23 00 00 00 00 00 02 00 80
            29 00 00 00 00 00 0D A7 ff 0f 1e 00 1F 00 01 98 00 00 00 00
            23 00 00 00 00 00 02 00 90
            29 00 00 00 00 00 0B A7 1C 1F 3B 00 00 be 90 ce 05 f0
            23 00 00 00 00 00 02 00 A0
            23 00 00 00 00 00 02 A7 30
            23 00 00 00 00 00 02 00 B0
            29 00 00 00 00 00 06 A7 01 1e 1F 00 00
            23 00 00 00 00 00 02 00 C0
            29 00 00 00 00 00 0D A7 ff 0f 1e 00 1e 00 01 18 00 00 00 00
            23 00 00 00 00 00 02 00 D0
            29 00 00 00 00 00 0B A7 ff ff 1C 00 01 7c 81 7c 0b e0
            23 00 00 00 00 00 02 00 E0
            23 00 00 00 00 00 02 A7 30
            23 00 00 00 00 00 02 00 F0
            29 00 00 00 00 00 06 A7 01 3D 3E 00 00
            23 00 00 00 00 00 02 00 80
            29 00 00 00 00 00 0D A9 00 00 00 00 00 00 00 00 00 00 00 00
            23 00 00 00 00 00 02 00 90
            29 00 00 00 00 00 0B A9 00 00 00 00 00 00 00 00 00 00
            23 00 00 00 00 00 02 00 A0
            23 00 00 00 00 00 02 A9 00
            23 00 00 00 00 00 02 00 B0
            29 00 00 00 00 00 06 A9 00 00 00 00 00
            23 00 00 00 00 00 02 00 C0
            29 00 00 00 00 00 0F A9 ff 3a 49 00 1e 00 01 00 00 00 00 00 00 77
            23 00 00 00 00 00 02 00 D0
            29 00 00 00 00 00 0B A9 ff ff 1d 00 01 7c 81 7c 0b e0
            23 00 00 00 00 00 02 00 E0
            23 00 00 00 00 00 02 A9 30
            23 00 00 00 00 00 02 00 F0
            29 00 00 00 00 00 06 A9 00 3c 3c 00 00
            23 00 00 00 00 00 02 00 B0
            29 00 00 00 00 00 09 A4 05 f0 0b e0 00 00 0b e0
            23 00 00 00 00 00 02 00 80
            29 00 00 00 00 00 10 AB 05 14 00 00 ff 6a 00 00 00 00 00 00 00 00 00
            23 00 00 00 00 00 02 00 A0
            29 00 00 00 00 00 10 AB 00 00 00 00 00 00 00 07 00 00 00 00 01 00 00
            23 00 00 00 00 00 02 00 B0
            29 00 00 00 00 00 0D AB 00 00 40 01 01 00 44 04 00 00 00 00
            23 00 00 00 00 00 02 00 93
            23 00 00 00 00 00 02 b3 01
            23 00 00 00 00 00 02 00 80
            29 00 00 00 00 00 08 ce 00 00 00 00 00 00 00
            23 00 00 00 00 00 02 00 87
            29 00 00 00 00 00 08 ce 00 00 33 00 33 00 00
            23 00 00 00 00 00 02 00 f0
            29 00 00 00 00 00 05 ce 00 00 00 00
            23 00 00 00 00 00 02 00 90
            29 00 00 00 00 00 10 ce 00 00 00 f0 00 00 00 00 fc 00 fc 00 00 00 00
            23 00 00 00 00 00 02 00 a0
            29 00 00 00 00 00 08 ce 00 00 40 40 40 00 00
            23 00 00 00 00 00 02 00 b0
            29 00 00 00 00 00 10 ce 01 01 01 01 01 01 01 01 f1 01 f1 01 01 01 01
            23 00 00 00 00 00 02 00 c0
            29 00 00 00 00 00 08 ce 01 01 01 01 01 01 01
            23 00 00 00 00 00 02 00 d0
            29 00 00 00 00 00 10 ce 04 04 04 04 04 04 04 04 f7 04 f7 04 04 00 00
            23 00 00 00 00 00 02 00 e0
            29 00 00 00 00 00 08 ce 00 00 15 15 15 04 04
            23 00 00 00 00 00 02 00 f4
            23 00 00 00 00 00 02 ce 25
            23 00 00 00 00 00 02 00 00
            29 00 00 00 00 00 19 e1 5e 5f 60 62 64 66 6a 71 73 7a 7d 7f 7d 79 72 62 50 3c 30 28 1e 0f 03 00
            23 00 00 00 00 00 02 00 00
            29 00 00 00 00 00 19 e2 5e 5f 60 62 64 66 6a 71 73 7a 7d 7f 7d 79 72 62 50 3c 30 28 1e 0f 03 00
            23 00 00 00 00 00 02 00 00
            29 00 00 00 00 00 19 e3 34 37 3a 3f 43 47 4f 5b 61 6d 74 79 82 7e 76 66 52 3f 32 2a 20 12 04 00
            23 00 00 00 00 00 02 00 00
            29 00 00 00 00 00 19 e4 34 37 3a 3f 43 47 4f 5b 61 6d 74 79 82 7e 76 66 52 3f 32 2a 20 12 04 00
            23 00 00 00 00 00 02 00 00
            29 00 00 00 00 00 19 e5 00 0a 10 1a 22 2a 36 4a 55 66 70 76 84 80 78 68 54 41 33 2b 21 14 04 00
            23 00 00 00 00 00 02 00 00
            29 00 00 00 00 00 19 e6 00 0a 10 1a 22 2a 36 4a 55 66 70 76 84 80 78 68 54 41 33 2b 21 14 04 00

            23 00 00 00 00 00 02 00 00
            29 00 00 00 00 00 22 ec 40 44 44 44 44 44 44 44 44 44 44 44 44 44 44 44 44 44 44 44 44 44 44 44 44 44 44 44 44 44 44 44 04
            23 00 00 00 00 00 02 00 00
            29 00 00 00 00 00 22 ed 40 44 44 44 44 44 44 44 44 44 44 44 44 44 44 44 44 44 44 44 44 44 44 44 44 44 44 44 44 44 44 44 04
            23 00 00 00 00 00 02 00 00
            29 00 00 00 00 00 22 ee 40 44 44 44 44 44 44 44 44 44 44 44 44 44 44 44 44 44 44 44 44 44 44 44 44 44 44 44 44 44 44 44 04
            23 00 00 00 00 00 02 00 90
            23 00 00 00 00 00 02 B0 00


            29 00 00 00 00 00 02 53 2C
            29 00 00 00 00 00 02 00 00
            29 01 00 00 05 00 02 FB 01
            23 00 00 00 00 00 02 00 80
            29 01 00 00 00 00 03 FF 00 00
            23 00 00 00 00 00 02 00 00
            29 00 00 00 00 00 04 FF 00 00 00
            15 00 00 00 00 00 02 35 00
            39 00 00 00 00 00 03 44 03 02
            29 01 00 00 00 00 03 99 95 27
	    05 01 00 00 78 00 01 11
	    05 01 00 00 28 00 01 29
	    29 01 00 00 00 00 03 99 00 00
			];
		qcom,mdss-dsi-off-command = [39 01 00 00 00 00 02 51 00
				 05 01 00 00 20 00 02 28 00
				 05 01 00 00 79 00 02 10 00];
		qcom,mdss-dsi-on-command-state = "dsi_lp_mode";
		qcom,mdss-dsi-off-command-state = "dsi_hs_mode";
		qcom,mdss-dsi-panel-status-command = [06 01 00 01 05 00 02 0A 08];
		qcom,mdss-dsi-panel-status-command-state = "dsi_hs_mode";
		qcom,mdss-dsi-panel-status-check-mode = "reg_read";
		qcom,mdss-dsi-panel-status-value = <0x9c>;
		qcom,mdss-dsi-h-sync-pulse = <0>;
		qcom,mdss-dsi-traffic-mode = "non_burst_sync_event";
		qcom,mdss-dsi-te-pin-select = <1>;
		qcom,mdss-dsi-te-dcs-command = <1>;
		qcom,mdss-dsi-te-check-enable;
		qcom,mdss-dsi-te-using-te-pin;
		qcom,mdss-dsi-bllp-eof-power-mode;
		qcom,mdss-dsi-bllp-power-mode;
		qcom,mdss-dsi-lane-0-state;
		qcom,mdss-dsi-lane-1-state;
        qcom,mdss-dsi-lane-2-state;
        qcom,mdss-dsi-lane-3-state;
		qcom,mdss-tear-check-sync-threshold-start=<10>;
		qcom,mdss-tear-check-sync-threshold-continue=<4>;
		qcom,mdss-tear-check-start-pos=<0x78A>;
        qcom,mdss-dsi-panel-timings = [e7 36 24 00 66 6a 2a 3a 2d 03 04 00];
		//qcom,mdss-dsi-panel-clockrate = <895000000>;
		qcom,mdss-dsi-t-clk-post = <0x04>;
		qcom,mdss-dsi-t-clk-pre = <0x28>;
		qcom,mdss-dsi-bl-min-level = <1>;
		qcom,mdss-dsi-bl-max-level = <255>;
		qcom,mdss-dsi-dma-trigger = "trigger_sw";
		qcom,mdss-dsi-mdp-trigger = "none";
		qcom,mdss-dsi-bl-pmic-control-type = "bl_ctrl_dcs";
		qcom,mdss-dsi-reset-sequence = <1 20>, <0 200>, <1 20>;
        qcom,mdss-dsi-lp11-init;
		qcom,mdss-pan-physical-width-dimension = <61>;
		qcom,mdss-pan-physical-height-dimension = <110>;
                qcom,mdss-dsi-hfp-power-mode;
                qcom,mdss-dsi-hsa-power-mode;
                qcom,mdss-dsi-hbp-power-mode;
                qcom,ulps-enabled;
                qcom,suspend-ulps-enabled;
                qcom,esd-check-enabled;
		//qcom,mdss-dsi-panel-status-check-mode = "te_check";
		//qcom,esd-check-enabled;
	};
};
