## drivers/input/touchscreen/lenovo/gt1151/Kconfig
```kconfig
#
# Goodix GT11XX Touchscreen driver
#

config TOUCHSCREEN_GT11XX_S
	bool "Goodix touchpanel GT1151 series"
	depends on I2C
	help
	  Say Y here if you have a Goodix GT11XX touchscreen.
	  Gt11XX controllers are multi touch controllers which can
	  report 5 touches at a time.

          If unsure, say N.

config GT1151_TOUCHPANEL_DRIVER 
	tristate "Goodix GT11XX touchpanel driver"
	depends on TOUCHSCREEN_GT11XX_S
	default n
	help
	  This is the main file for touchpanel driver for Goodix GT11XX
	  touchscreens.

	  Say Y here if you have a Goodix GT11XX touchscreen connected
	  to your system.

	  If unsure, say N.

	  To compile this driver as a module, choose M here: the
	  module will be called gt11XX_update.

config GT1151_TOUCHPANEL_UPDATE
	tristate "Goodix GT11XX touchpanel auto update support"
	depends on GT1151_TOUCHPANEL_DRIVER
	default n
	help
	  This enables support for firmware update for Goodix GT11XX
	  touchscreens.

	  Say Y here if you have a Goodix GT11XX touchscreen connected
	  to your system.

	  If unsure, say N.

	  To compile this driver as a module, choose M here: the
	  module will be called gt11XX_update.

config GT1151_TOUCHPANEL_DEBUG
	tristate "Goodix GT11XX Tools for debuging"
	depends on GT1151_TOUCHPANEL_DRIVER
	default n
	help
	  This is application debug interface support for Goodix GT11XX
	  touchscreens.

	  Say Y here if you want to have a Android app debug interface
	  to your system.

	  If unsure, say N.

	  To compile this driver as a module, choose M here: the
	  module will be called gt11XX_update.
```

## drivers/power/lenovo/Kconfig
```kconfig
config BATTERY_BQ27530
	tristate "BQ27530 battery driver"
	depends on I2C
	help
	Say Y here to enable support for batteries with BQ27x00 (I2C/HDQ) chips.

config CHARGER_BQ24192
	tristate "BQ24192 charger driver"
	depends on I2C
	help
	Say Y here to enable support for batteries with BQ27x00 (I2C/HDQ) chips.

config CHARGER_BQ2589X
	tristate "BQ2589x charger driver"
	depends on I2C
	help
	Say Y here to enable support for batteries with BQ27x00 (I2C/HDQ) chips.

config LENOVO_FAST_CHARGER
	tristate "lenovo fast charger driver"
	help
	Say Y here to enable support for lenovo fast charger.
```

## drivers/video/msm/mdss/lenovo_lcd_effect/Kconfig
```kconfig
config FB_LENOVO_LCM_EFFECT_CABC_INVERSE
	depends on FB_LENOVO_LCM_EFFECT
	bool "lenovo lcm effect setting for cabc/inverse"
	default n
	---help---
	The function provides support set lcm effect.

config FB_LENOVO_LCM_EFFECT_UI
	depends on FB_LENOVO_LCM_EFFECT
	bool "lenovo lcm effect setting for UI"
	default n
	---help---
	The function provides support set lcm effect.
```
